VERSION "created by canmatrix"

NS_ :

BS_:

BU_: FC HAD

BO_ 1152 FCM_FS_1: 64 FC
 SG_ FC_lateral1 : 0|10@1+ (0.1,-51.2) [-51.2|51.1] "m" HAD
 SG_ FC_longitudinal1 : 10|11@1+ (0.1,-102.4) [-102.4|102.3] "m" HAD
 SG_ FC_lateral2 : 21|10@1+ (0.1,-51.2) [-51.2|51.1] "m" HAD
 SG_ FC_longitudinal2 : 31|11@1+ (0.1,-102.4) [-102.4|102.3] "m" HAD
 SG_ FC_lateral3 : 42|10@1+ (0.1,-51.2) [-51.2|51.1] "m" HAD
 SG_ FC_longitudinal3 : 52|11@1+ (0.1,-102.4) [-102.4|102.3] "m" HAD
 SG_ FC_lateral4 : 63|10@1+ (0.1,-51.2) [-51.2|51.1] "m" HAD
 SG_ FC_longitudinal4 : 73|11@1+ (0.1,-102.4) [-102.4|102.3] "m" HAD
 SG_ FC_lateral5 : 84|10@1+ (0.1,-51.2) [-51.2|51.1] "m" HAD
 SG_ FC_longitudinal5 : 94|11@1+ (0.1,-102.4) [-102.4|102.3] "m" HAD
 SG_ FC_lateral6 : 105|10@1+ (0.1,-51.2) [-51.2|51.1] "m" HAD
 SG_ FC_longitudinal6 : 115|11@1+ (0.1,-102.4) [-102.4|102.3] "m" HAD
 SG_ FC_lateral7 : 126|10@1+ (0.1,-51.2) [-51.2|51.1] "m" HAD
 SG_ FC_longitudinal7 : 136|11@1+ (0.1,-102.4) [-102.4|102.3] "m" HAD
 SG_ FC_lateral8 : 147|10@1+ (0.1,-51.2) [-51.2|51.1] "m" HAD
 SG_ FC_longitudinal8 : 157|11@1+ (0.1,-102.4) [-102.4|102.3] "m" HAD
 SG_ FC_lateral9 : 168|10@1+ (0.1,-51.2) [-51.2|51.1] "m" HAD
 SG_ FC_longitudinal9 : 178|11@1+ (0.1,-102.4) [-102.4|102.3] "m" HAD
 SG_ FC_lateral10 : 189|10@1+ (0.1,-51.2) [-51.2|51.1] "m" HAD
 SG_ FC_longitudinal10 : 199|11@1+ (0.1,-102.4) [-102.4|102.3] "m" HAD
 SG_ FC_lateral11 : 210|10@1+ (0.1,-51.2) [-51.2|51.1] "m" HAD
 SG_ FC_longitudinal11 : 220|11@1+ (0.1,-102.4) [-102.4|102.3] "m" HAD
 SG_ FC_lateral12 : 231|10@1+ (0.1,-51.2) [-51.2|51.1] "m" HAD
 SG_ FC_longitudinal12 : 241|11@1+ (0.1,-102.4) [-102.4|102.3] "m" HAD
 SG_ FC_lateral13 : 252|10@1+ (0.1,-51.2) [-51.2|51.1] "m" HAD
 SG_ FC_longitudinal13 : 262|11@1+ (0.1,-102.4) [-102.4|102.3] "m" HAD
 SG_ FC_lateral14 : 273|10@1+ (0.1,-51.2) [-51.2|51.1] "m" HAD
 SG_ FC_longitudinal14 : 283|11@1+ (0.1,-102.4) [-102.4|102.3] "m" HAD
 SG_ FC_lateral15 : 294|10@1+ (0.1,-51.2) [-51.2|51.1] "m" HAD
 SG_ FC_longitudinal15 : 304|11@1+ (0.1,-102.4) [-102.4|102.3] "m" HAD
 SG_ FC_lateral16 : 315|10@1+ (0.1,-51.2) [-51.2|51.1] "m" HAD
 SG_ FC_longitudinal16 : 325|11@1+ (0.1,-102.4) [-102.4|102.3] "m" HAD
 SG_ FC_lateral17 : 336|10@1+ (0.1,-51.2) [-51.2|51.1] "m" HAD
 SG_ FC_longitudinal17 : 346|11@1+ (0.1,-102.4) [-102.4|102.3] "m" HAD
 SG_ FC_lateral18 : 357|10@1+ (0.1,-51.2) [-51.2|51.1] "m" HAD
 SG_ FC_longitudinal18 : 367|11@1+ (0.1,-102.4) [-102.4|102.3] "m" HAD
 SG_ FC_lateral19 : 378|10@1+ (0.1,-51.2) [-51.2|51.1] "m" HAD
 SG_ FC_longitudinal19 : 388|11@1+ (0.1,-102.4) [-102.4|102.3] "m" HAD
 SG_ FC_lateral20 : 399|10@1+ (0.1,-51.2) [-51.2|51.1] "m" HAD
 SG_ FC_longitudinal20 : 409|11@1+ (0.1,-102.4) [-102.4|102.3] "m" HAD
 SG_ FC_lateral21 : 420|10@1+ (0.1,-51.2) [-51.2|51.1] "m" HAD
 SG_ FC_longitudinal21 : 430|11@1+ (0.1,-102.4) [-102.4|102.3] "m" HAD
 SG_ FC_RollingCounter_480 : 441|4@1+ (1,0) [0|15] "" HAD
 SG_ FC_CRCChecksum_480 : 448|16@1+ (1,0) [0|65535] "" HAD

BO_ 1153 FCM_FS_2: 64 FC
 SG_ FC_lateral22 : 0|10@1+ (0.1,-51.2) [-51.2|51.1] "m" HAD
 SG_ FC_longitudinal22 : 10|11@1+ (0.1,-102.4) [-102.4|102.3] "m" HAD
 SG_ FC_lateral23 : 21|10@1+ (0.1,-51.2) [-51.2|51.1] "m" HAD
 SG_ FC_longitudinal23 : 31|11@1+ (0.1,-102.4) [-102.4|102.3] "m" HAD
 SG_ FC_lateral24 : 42|10@1+ (0.1,-51.2) [-51.2|51.1] "m" HAD
 SG_ FC_longitudinal24 : 52|11@1+ (0.1,-102.4) [-102.4|102.3] "m" HAD
 SG_ FC_lateral25 : 63|10@1+ (0.1,-51.2) [-51.2|51.1] "m" HAD
 SG_ FC_longitudinal25 : 73|11@1+ (0.1,-102.4) [-102.4|102.3] "m" HAD
 SG_ FC_lateral26 : 84|10@1+ (0.1,-51.2) [-51.2|51.1] "m" HAD
 SG_ FC_longitudinal26 : 94|11@1+ (0.1,-102.4) [-102.4|102.3] "m" HAD
 SG_ FC_lateral27 : 105|10@1+ (0.1,-51.2) [-51.2|51.1] "m" HAD
 SG_ FC_longitudinal27 : 115|11@1+ (0.1,-102.4) [-102.4|102.3] "m" HAD
 SG_ FC_lateral28 : 126|10@1+ (0.1,-51.2) [-51.2|51.1] "m" HAD
 SG_ FC_longitudinal28 : 136|11@1+ (0.1,-102.4) [-102.4|102.3] "m" HAD
 SG_ FC_lateral29 : 147|10@1+ (0.1,-51.2) [-51.2|51.1] "m" HAD
 SG_ FC_longitudinal29 : 157|11@1+ (0.1,-102.4) [-102.4|102.3] "m" HAD
 SG_ FC_lateral30 : 168|10@1+ (0.1,-51.2) [-51.2|51.1] "m" HAD
 SG_ FC_longitudinal30 : 178|11@1+ (0.1,-102.4) [-102.4|102.3] "m" HAD
 SG_ FC_lateral31 : 189|10@1+ (0.1,-51.2) [-51.2|51.1] "m" HAD
 SG_ FC_longitudinal31 : 199|11@1+ (0.1,-102.4) [-102.4|102.3] "m" HAD
 SG_ FC_lateral32 : 210|10@1+ (0.1,-51.2) [-51.2|51.1] "m" HAD
 SG_ FC_longitudinal32 : 220|11@1+ (0.1,-102.4) [-102.4|102.3] "m" HAD
 SG_ FC_lateral33 : 231|10@1+ (0.1,-51.2) [-51.2|51.1] "m" HAD
 SG_ FC_longitudinal33 : 241|11@1+ (0.1,-102.4) [-102.4|102.3] "m" HAD
 SG_ FC_lateral34 : 252|10@1+ (0.1,-51.2) [-51.2|51.1] "m" HAD
 SG_ FC_longitudinal34 : 262|11@1+ (0.1,-102.4) [-102.4|102.3] "m" HAD
 SG_ FC_lateral35 : 273|10@1+ (0.1,-51.2) [-51.2|51.1] "m" HAD
 SG_ FC_longitudinal35 : 283|11@1+ (0.1,-102.4) [-102.4|102.3] "m" HAD
 SG_ FC_lateral36 : 294|10@1+ (0.1,-51.2) [-51.2|51.1] "m" HAD
 SG_ FC_longitudinal36 : 304|11@1+ (0.1,-102.4) [-102.4|102.3] "m" HAD
 SG_ FC_lateral37 : 315|10@1+ (0.1,-51.2) [-51.2|51.1] "m" HAD
 SG_ FC_longitudinal37 : 325|11@1+ (0.1,-102.4) [-102.4|102.3] "m" HAD
 SG_ FC_lateral38 : 336|10@1+ (0.1,-51.2) [-51.2|51.1] "m" HAD
 SG_ FC_longitudinal38 : 346|11@1+ (0.1,-102.4) [-102.4|102.3] "m" HAD
 SG_ FC_lateral39 : 357|10@1+ (0.1,-51.2) [-51.2|51.1] "m" HAD
 SG_ FC_longitudinal39 : 367|11@1+ (0.1,-102.4) [-102.4|102.3] "m" HAD
 SG_ FC_lateral40 : 378|10@1+ (0.1,-51.2) [-51.2|51.1] "m" HAD
 SG_ FC_longitudinal40 : 388|11@1+ (0.1,-102.4) [-102.4|102.3] "m" HAD
 SG_ FC_lateral41 : 399|10@1+ (0.1,-51.2) [-51.2|51.1] "m" HAD
 SG_ FC_longitudinal41 : 409|11@1+ (0.1,-102.4) [-102.4|102.3] "m" HAD
 SG_ FC_lateral42 : 420|10@1+ (0.1,-51.2) [-51.2|51.1] "m" HAD
 SG_ FC_longitudinal42 : 430|11@1+ (0.1,-102.4) [-102.4|102.3] "m" HAD
 SG_ FC_RollingCounter_481 : 441|4@1+ (1,0) [0|15] "" HAD
 SG_ FC_CRCChecksum_481 : 448|16@1+ (1,0) [0|65535] "" HAD

BO_ 1154 FCM_FS_3: 64 FC
 SG_ FC_lateral43 : 0|10@1+ (0.1,-51.2) [-51.2|51.1] "m" HAD
 SG_ FC_longitudinal43 : 10|11@1+ (0.1,-102.4) [-102.4|102.3] "m" HAD
 SG_ FC_lateral44 : 21|10@1+ (0.1,-51.2) [-51.2|51.1] "m" HAD
 SG_ FC_longitudinal44 : 31|11@1+ (0.1,-102.4) [-102.4|102.3] "m" HAD
 SG_ FC_lateral45 : 42|10@1+ (0.1,-51.2) [-51.2|51.1] "m" HAD
 SG_ FC_longitudinal45 : 52|11@1+ (0.1,-102.4) [-102.4|102.3] "m" HAD
 SG_ FC_lateral46 : 63|10@1+ (0.1,-51.2) [-51.2|51.1] "m" HAD
 SG_ FC_longitudinal46 : 73|11@1+ (0.1,-102.4) [-102.4|102.3] "m" HAD
 SG_ FC_lateral47 : 84|10@1+ (0.1,-51.2) [-51.2|51.1] "m" HAD
 SG_ FC_longitudinal47 : 94|11@1+ (0.1,-102.4) [-102.4|102.3] "m" HAD
 SG_ FC_lateral48 : 105|10@1+ (0.1,-51.2) [-51.2|51.1] "m" HAD
 SG_ FC_longitudinal48 : 115|11@1+ (0.1,-102.4) [-102.4|102.3] "m" HAD
 SG_ FC_lateral49 : 126|10@1+ (0.1,-51.2) [-51.2|51.1] "m" HAD
 SG_ FC_longitudinal49 : 136|11@1+ (0.1,-102.4) [-102.4|102.3] "m" HAD
 SG_ FC_lateral50 : 147|10@1+ (0.1,-51.2) [-51.2|51.1] "m" HAD
 SG_ FC_longitudinal50 : 157|11@1+ (0.1,-102.4) [-102.4|102.3] "m" HAD
 SG_ FC_lateral51 : 168|10@1+ (0.1,-51.2) [-51.2|51.1] "m" HAD
 SG_ FC_longitudinal51 : 178|11@1+ (0.1,-102.4) [-102.4|102.3] "m" HAD
 SG_ FC_lateral52 : 189|10@1+ (0.1,-51.2) [-51.2|51.1] "m" HAD
 SG_ FC_longitudinal52 : 199|11@1+ (0.1,-102.4) [-102.4|102.3] "m" HAD
 SG_ FC_lateral53 : 210|10@1+ (0.1,-51.2) [-51.2|51.1] "m" HAD
 SG_ FC_longitudinal53 : 220|11@1+ (0.1,-102.4) [-102.4|102.3] "m" HAD
 SG_ FC_lateral54 : 231|10@1+ (0.1,-51.2) [-51.2|51.1] "m" HAD
 SG_ FC_longitudinal54 : 241|11@1+ (0.1,-102.4) [-102.4|102.3] "m" HAD
 SG_ FC_lateral55 : 252|10@1+ (0.1,-51.2) [-51.2|51.1] "m" HAD
 SG_ FC_longitudinal55 : 262|11@1+ (0.1,-102.4) [-102.4|102.3] "m" HAD
 SG_ FC_lateral56 : 273|10@1+ (0.1,-51.2) [-51.2|51.1] "m" HAD
 SG_ FC_longitudinal56 : 283|11@1+ (0.1,-102.4) [-102.4|102.3] "m" HAD
 SG_ FC_lateral57 : 294|10@1+ (0.1,-51.2) [-51.2|51.1] "m" HAD
 SG_ FC_longitudinal57 : 304|11@1+ (0.1,-102.4) [-102.4|102.3] "m" HAD
 SG_ FC_lateral58 : 315|10@1+ (0.1,-51.2) [-51.2|51.1] "m" HAD
 SG_ FC_longitudinal58 : 325|11@1+ (0.1,-102.4) [-102.4|102.3] "m" HAD
 SG_ FC_lateral59 : 336|10@1+ (0.1,-51.2) [-51.2|51.1] "m" HAD
 SG_ FC_longitudinal59 : 346|11@1+ (0.1,-102.4) [-102.4|102.3] "m" HAD
 SG_ FC_lateral60 : 357|10@1+ (0.1,-51.2) [-51.2|51.1] "m" HAD
 SG_ FC_longitudinal60 : 367|11@1+ (0.1,-102.4) [-102.4|102.3] "m" HAD
 SG_ FC_lateral61 : 378|10@1+ (0.1,-51.2) [-51.2|51.1] "m" HAD
 SG_ FC_longitudinal61 : 388|11@1+ (0.1,-102.4) [-102.4|102.3] "m" HAD
 SG_ FC_lateral62 : 399|10@1+ (0.1,-51.2) [-51.2|51.1] "m" HAD
 SG_ FC_longitudinal62 : 409|11@1+ (0.1,-102.4) [-102.4|102.3] "m" HAD
 SG_ FC_lateral63 : 420|10@1+ (0.1,-51.2) [-51.2|51.1] "m" HAD
 SG_ FC_longitudinal63 : 430|11@1+ (0.1,-102.4) [-102.4|102.3] "m" HAD
 SG_ FC_lateral64 : 441|10@1+ (0.1,-51.2) [-51.2|51.1] "m" HAD
 SG_ FC_longitudinal64 : 451|11@1+ (0.1,-102.4) [-102.4|102.3] "m" HAD
 SG_ FC_RollingCounter_482 : 464|4@1+ (1,0) [0|15] "" HAD
 SG_ FC_CRCChecksum_482 : 472|16@1+ (1,0) [0|65535] "" HAD

BO_ 1155 FCM_FS_4: 64 FC
 SG_ FC_Type_Point1 : 0|3@1+ (1,0) [0|7] "" HAD
 SG_ FC_Type_Point2 : 3|3@1+ (1,0) [0|7] "" HAD
 SG_ FC_Type_Point3 : 8|3@1+ (1,0) [0|7] "" HAD
 SG_ FC_Type_Point4 : 11|3@1+ (1,0) [0|7] "" HAD
 SG_ FC_Type_Point5 : 16|3@1+ (1,0) [0|7] "" HAD
 SG_ FC_Type_Point6 : 19|3@1+ (1,0) [0|7] "" HAD
 SG_ FC_Type_Point7 : 24|3@1+ (1,0) [0|7] "" HAD
 SG_ FC_Type_Point8 : 27|3@1+ (1,0) [0|7] "" HAD
 SG_ FC_Type_Point9 : 32|3@1+ (1,0) [0|7] "" HAD
 SG_ FC_Type_Point10 : 35|3@1+ (1,0) [0|7] "" HAD
 SG_ FC_Type_Point11 : 40|3@1+ (1,0) [0|7] "" HAD
 SG_ FC_Type_Point12 : 43|3@1+ (1,0) [0|7] "" HAD
 SG_ FC_Type_Point13 : 48|3@1+ (1,0) [0|7] "" HAD
 SG_ FC_Type_Point14 : 51|3@1+ (1,0) [0|7] "" HAD
 SG_ FC_Type_Point15 : 56|3@1+ (1,0) [0|7] "" HAD
 SG_ FC_Type_Point16 : 59|3@1+ (1,0) [0|7] "" HAD
 SG_ FC_Type_Point17 : 64|3@1+ (1,0) [0|7] "" HAD
 SG_ FC_Type_Point18 : 67|3@1+ (1,0) [0|7] "" HAD
 SG_ FC_Type_Point19 : 72|3@1+ (1,0) [0|7] "" HAD
 SG_ FC_Type_Point20 : 75|3@1+ (1,0) [0|7] "" HAD
 SG_ FC_Type_Point21 : 80|3@1+ (1,0) [0|7] "" HAD
 SG_ FC_Type_Point22 : 83|3@1+ (1,0) [0|7] "" HAD
 SG_ FC_Type_Point23 : 88|3@1+ (1,0) [0|7] "" HAD
 SG_ FC_Type_Point24 : 91|3@1+ (1,0) [0|7] "" HAD
 SG_ FC_Type_Point25 : 96|3@1+ (1,0) [0|7] "" HAD
 SG_ FC_Type_Point26 : 99|3@1+ (1,0) [0|7] "" HAD
 SG_ FC_Type_Point27 : 104|3@1+ (1,0) [0|7] "" HAD
 SG_ FC_Type_Point28 : 107|3@1+ (1,0) [0|7] "" HAD
 SG_ FC_Type_Point29 : 112|3@1+ (1,0) [0|7] "" HAD
 SG_ FC_Type_Point30 : 115|3@1+ (1,0) [0|7] "" HAD
 SG_ FC_Type_Point31 : 120|3@1+ (1,0) [0|7] "" HAD
 SG_ FC_Type_Point32 : 123|3@1+ (1,0) [0|7] "" HAD
 SG_ FC_Type_Point33 : 128|3@1+ (1,0) [0|7] "" HAD
 SG_ FC_Type_Point34 : 131|3@1+ (1,0) [0|7] "" HAD
 SG_ FC_Type_Point35 : 136|3@1+ (1,0) [0|7] "" HAD
 SG_ FC_Type_Point36 : 139|3@1+ (1,0) [0|7] "" HAD
 SG_ FC_Type_Point37 : 144|3@1+ (1,0) [0|7] "" HAD
 SG_ FC_Type_Point38 : 147|3@1+ (1,0) [0|7] "" HAD
 SG_ FC_Type_Point39 : 152|3@1+ (1,0) [0|7] "" HAD
 SG_ FC_Type_Point40 : 155|3@1+ (1,0) [0|7] "" HAD
 SG_ FC_Type_Point41 : 160|3@1+ (1,0) [0|7] "" HAD
 SG_ FC_Type_Point42 : 163|3@1+ (1,0) [0|7] "" HAD
 SG_ FC_Type_Point43 : 168|3@1+ (1,0) [0|7] "" HAD
 SG_ FC_Type_Point44 : 171|3@1+ (1,0) [0|7] "" HAD
 SG_ FC_Type_Point45 : 176|3@1+ (1,0) [0|7] "" HAD
 SG_ FC_Type_Point46 : 179|3@1+ (1,0) [0|7] "" HAD
 SG_ FC_Type_Point47 : 184|3@1+ (1,0) [0|7] "" HAD
 SG_ FC_Type_Point48 : 187|3@1+ (1,0) [0|7] "" HAD
 SG_ FC_Type_Point49 : 192|3@1+ (1,0) [0|7] "" HAD
 SG_ FC_Type_Point50 : 195|3@1+ (1,0) [0|7] "" HAD
 SG_ FC_Type_Point51 : 200|3@1+ (1,0) [0|7] "" HAD
 SG_ FC_Type_Point52 : 203|3@1+ (1,0) [0|7] "" HAD
 SG_ FC_Type_Point53 : 208|3@1+ (1,0) [0|7] "" HAD
 SG_ FC_Type_Point54 : 211|3@1+ (1,0) [0|7] "" HAD
 SG_ FC_Type_Point55 : 216|3@1+ (1,0) [0|7] "" HAD
 SG_ FC_Type_Point56 : 219|3@1+ (1,0) [0|7] "" HAD
 SG_ FC_Type_Point57 : 224|3@1+ (1,0) [0|7] "" HAD
 SG_ FC_Type_Point58 : 227|3@1+ (1,0) [0|7] "" HAD
 SG_ FC_Type_Point59 : 232|3@1+ (1,0) [0|7] "" HAD
 SG_ FC_Type_Point60 : 235|3@1+ (1,0) [0|7] "" HAD
 SG_ FC_Type_Point61 : 240|3@1+ (1,0) [0|7] "" HAD
 SG_ FC_Type_Point62 : 243|3@1+ (1,0) [0|7] "" HAD
 SG_ FC_Type_Point63 : 248|3@1+ (1,0) [0|7] "" HAD
 SG_ FC_Type_Point64 : 251|3@1+ (1,0) [0|7] "" HAD
 SG_ FC_RollingCounter_483 : 254|4@1+ (1,0) [0|15] "" HAD
 SG_ FC_CRCChecksum_483 : 264|16@1+ (1,0) [0|65535] "" HAD

BO_ 1124 FCM_CIPV: 64 FC
 SG_ FC_CIPV_ID : 0|8@1+ (1,0) [0|255] "" HAD
 SG_ FC_CIPVFlag : 8|1@1+ (1,0) [0|1] "" HAD
 SG_ FC_MCP_ID : 16|8@1+ (1,0) [0|255] "" HAD
 SG_ FC_MCPFlag : 24|1@1+ (1,0) [0|1] "" HAD
 SG_ FC_CIPV_TTC : 25|10@1+ (0.01,0) [0|10] "sec" HAD
 SG_ FC_CIPV_TTC_Valid : 35|1@1+ (1,0) [0|1] "" HAD
 SG_ FC_RollingCounter_464 : 36|4@1+ (1,0) [0|15] "" HAD
 SG_ FC_CRCChecksum_464 : 40|16@1+ (1,0) [0|65535] "" HAD

BO_ 1104 FCM_OD_1: 64 FC
 SG_ FC_Obj1_Track_ID : 0|8@1+ (1,0) [0|255] "" HAD
 SG_ FC_Obj1_Valid : 8|2@1+ (1,0) [0|2] "" HAD
 SG_ FC_Obj1_Track_Age : 16|16@1+ (1,0) [0|65535] "" HAD
 SG_ FC_Obj1_Confidence : 257|7@1+ (1,0) [0|100] "%" HAD
 SG_ FC_Obj1_MotionCategory : 10|4@1+ (1,0) [0|13] "" HAD
 SG_ FC_Obj1_MotionType : 32|3@1+ (1,0) [0|7] "" HAD
 SG_ FC_Obj1_MeasureStatus : 35|3@1+ (1,0) [0|7] "" HAD
 SG_ FC_Obj1_Class : 38|3@1+ (1,0) [0|7] "" HAD
 SG_ FC_Obj1_VehSubType : 41|3@1+ (1,0) [0|7] "" HAD
 SG_ FC_Obj1_PedSubType : 44|2@1+ (1,0) [0|3] "" HAD
 SG_ FC_Obj1_LaneAssignment : 46|3@1+ (1,0) [0|5] "" HAD
 SG_ FC_Obj1_Height : 49|9@1+ (0.02,0) [0|10.24] "m" HAD
 SG_ FC_Obj1_Height_Vnce : 58|9@1+ (0.02,0) [0|10.24] "m" HAD
 SG_ FC_Obj1_Length : 67|9@1+ (0.05,0) [0|25.6] "m" HAD
 SG_ FC_Obj1_Length_Vnce : 76|9@1+ (0.05,0) [0|25.6] "m" HAD
 SG_ FC_Obj1_Width : 85|9@1+ (0.02,0) [0|10.24] "m" HAD
 SG_ FC_Obj1_Width_Vnce : 94|9@1+ (0.02,0) [0|10.24] "m" HAD
 SG_ FC_Obj1_TurnLight : 103|3@1+ (1,0) [0|4] "" HAD
 SG_ FC_Obj1_Brakelight_Info : 106|1@1+ (1,0) [0|1] "" HAD
 SG_ FC_Obj1_TTC : 107|10@1+ (0.01,0) [0|10] "sec" HAD
 SG_ FC_Obj1_Dx : 117|13@1+ (0.0625,-250) [-250|250] "m" HAD
 SG_ FC_Obj1_Dx_STD : 130|13@1+ (0.0625,0) [0|250] "m" HAD
 SG_ FC_Obj1_Dy : 143|13@1+ (0.0625,-250) [-250|250] "m" HAD
 SG_ FC_Obj1_Dy_STD : 156|13@1+ (0.0625,0) [0|250] "m" HAD
 SG_ FC_Obj1_RelVx : 169|12@1+ (0.05,-102.4) [-102.4|102.35] "m/s" HAD
 SG_ FC_Obj1_RelVx_STD : 181|12@1+ (0.05,0) [0|102.35] "m/s" HAD
 SG_ FC_Obj1_RelVy : 193|12@1+ (0.05,-50) [-50|50] "m/s" HAD
 SG_ FC_Obj1_RelVy_STD : 205|12@1+ (0.05,0) [0|50] "m/s" HAD
 SG_ FC_Obj1_RelAx : 217|10@1+ (0.03,-14.97) [-14.97|14.97] "m/s2" HAD
 SG_ FC_Obj1_RelAx_STD : 227|10@1+ (0.03,0) [0|14.97] "m/s2" HAD
 SG_ FC_Obj1_RelAy : 237|10@1+ (0.03,-14.97) [-14.97|14.97] "m/s2" HAD
 SG_ FC_Obj1_RelAy_STD : 247|10@1+ (0.03,0) [0|14.97] "m/s2" HAD
 SG_ FC_Obj1_HeadingAngle : 264|16@1+ (0.01,-327.68) [-327.68|327.67] "degree" HAD
 SG_ FC_Obj1_HeadingAngle_Vnce : 280|16@1+ (0.01,0) [0|327.67] "degree" HAD
 SG_ FC_Obj1_WorldinfoYaw : 296|16@1+ (0.01,-327.68) [-327.68|327.67] "degree" HAD
 SG_ FC_Obj1_WorldinfoYaw_Vnce : 312|16@1+ (0.01,0) [0|327.67] "degree" HAD
 SG_ FC_Obj1_AbsVx : 328|12@1+ (0.05,-102.4) [-102.4|102.35] "m/s" HAD
 SG_ FC_Obj1_AbsVy : 340|12@1+ (0.05,-50) [-50|50] "m/s" HAD
 SG_ FC_Obj1_CutInFlag : 352|2@1+ (1,0) [0|2] "" HAD
 SG_ FC_Obj1_CornerPoint_x : 354|13@1+ (0.0625,-250) [-250|250] "m" HAD
 SG_ FC_Obj1_CornerPoint_y : 368|13@1+ (0.0625,-250) [-250|250] "m" HAD
 SG_ FC_Obj1_CutInLane : 384|13@1+ (0.01,-40.96) [-40.96|40.95] "m" HAD
 SG_ FC_Obj1_DistInLane : 400|11@1+ (0.01,-10) [-10|10] "" HAD
 SG_ FC_RollingCounter_450 : 411|4@1+ (1,0) [0|15] "" HAD
 SG_ FC_CRCChecksum_450 : 416|16@1+ (1,0) [0|65535] "" HAD

BO_ 1105 FCM_OD_2: 64 FC
 SG_ FC_Obj2_Track_ID : 0|8@1+ (1,0) [0|255] "" HAD
 SG_ FC_Obj2_Valid : 8|2@1+ (1,0) [0|2] "" HAD
 SG_ FC_Obj2_Track_Age : 16|16@1+ (1,0) [0|65535] "" HAD
 SG_ FC_Obj2_Confidence : 257|7@1+ (1,0) [0|100] "%" HAD
 SG_ FC_Obj2_MotionCategory : 10|4@1+ (1,0) [0|13] "" HAD
 SG_ FC_Obj2_MotionType : 32|3@1+ (1,0) [0|7] "" HAD
 SG_ FC_Obj2_MeasureStatus : 35|3@1+ (1,0) [0|7] "" HAD
 SG_ FC_Obj2_Class : 38|3@1+ (1,0) [0|7] "" HAD
 SG_ FC_Obj2_VehSubType : 41|3@1+ (1,0) [0|7] "" HAD
 SG_ FC_Obj2_PedSubType : 44|2@1+ (1,0) [0|3] "" HAD
 SG_ FC_Obj2_LaneAssignment : 46|3@1+ (1,0) [0|5] "" HAD
 SG_ FC_Obj2_Height : 49|9@1+ (0.02,0) [0|10.24] "m" HAD
 SG_ FC_Obj2_Height_Vnce : 58|9@1+ (0.02,0) [0|10.24] "m" HAD
 SG_ FC_Obj2_Length : 67|9@1+ (0.05,0) [0|25.6] "m" HAD
 SG_ FC_Obj2_Length_Vnce : 76|9@1+ (0.05,0) [0|25.6] "m" HAD
 SG_ FC_Obj2_Width : 85|9@1+ (0.02,0) [0|10.24] "m" HAD
 SG_ FC_Obj2_Width_Vnce : 94|9@1+ (0.02,0) [0|10.24] "m" HAD
 SG_ FC_Obj2_TurnLight : 103|3@1+ (1,0) [0|4] "" HAD
 SG_ FC_Obj2_Brakelight_Info : 106|1@1+ (1,0) [0|1] "" HAD
 SG_ FC_Obj2_TTC : 107|10@1+ (0.01,0) [0|10] "sec" HAD
 SG_ FC_Obj2_Dx : 117|13@1+ (0.0625,-250) [-250|250] "m" HAD
 SG_ FC_Obj2_Dx_STD : 130|13@1+ (0.0625,0) [0|250] "m" HAD
 SG_ FC_Obj2_Dy : 143|13@1+ (0.0625,-250) [-250|250] "m" HAD
 SG_ FC_Obj2_Dy_STD : 156|13@1+ (0.0625,0) [0|250] "m" HAD
 SG_ FC_Obj2_RelVx : 169|12@1+ (0.05,-102.4) [-102.4|102.35] "m/s" HAD
 SG_ FC_Obj2_RelVx_STD : 181|12@1+ (0.05,0) [0|102.35] "m/s" HAD
 SG_ FC_Obj2_RelVy : 193|12@1+ (0.05,-50) [-50|50] "m/s" HAD
 SG_ FC_Obj2_RelVy_STD : 205|12@1+ (0.05,0) [0|50] "m/s" HAD
 SG_ FC_Obj2_RelAx : 217|10@1+ (0.03,-14.97) [-14.97|14.97] "m/s2" HAD
 SG_ FC_Obj2_RelAx_STD : 227|10@1+ (0.03,0) [0|14.97] "m/s2" HAD
 SG_ FC_Obj2_RelAy : 237|10@1+ (0.03,-14.97) [-14.97|14.97] "m/s2" HAD
 SG_ FC_Obj2_RelAy_STD : 247|10@1+ (0.03,0) [0|14.97] "m/s2" HAD
 SG_ FC_Obj2_HeadingAngle : 264|16@1+ (0.01,-327.68) [-327.68|327.67] "degree" HAD
 SG_ FC_Obj2_HeadingAngle_Vnce : 280|16@1+ (0.01,0) [0|327.67] "degree" HAD
 SG_ FC_Obj2_WorldinfoYaw : 296|16@1+ (0.01,-327.68) [-327.68|327.67] "degree" HAD
 SG_ FC_Obj2_WorldinfoYaw_Vnce : 312|16@1+ (0.01,0) [0|327.67] "degree" HAD
 SG_ FC_Obj2_AbsVx : 328|12@1+ (0.05,-102.4) [-102.4|102.35] "m/s" HAD
 SG_ FC_Obj2_AbsVy : 340|12@1+ (0.05,-50) [-50|50] "m/s" HAD
 SG_ FC_Obj2_CutInFlag : 352|2@1+ (1,0) [0|2] "" HAD
 SG_ FC_Obj2_CornerPoint_x : 354|13@1+ (0.0625,-250) [-250|250] "m" HAD
 SG_ FC_Obj2_CornerPoint_y : 368|13@1+ (0.0625,-250) [-250|250] "m" HAD
 SG_ FC_Obj2_CutInLane : 384|13@1+ (0.01,-40.96) [-40.96|40.95] "m" HAD
 SG_ FC_Obj2_DistInLane : 400|11@1+ (0.01,-10) [-10|10] "" HAD
 SG_ FC_RollingCounter_451 : 411|4@1+ (1,0) [0|15] "" HAD
 SG_ FC_CRCChecksum_451 : 416|16@1+ (1,0) [0|65535] "" HAD

BO_ 1106 FCM_OD_3: 64 FC
 SG_ FC_Obj3_Track_ID : 0|8@1+ (1,0) [0|255] "" HAD
 SG_ FC_Obj3_Valid : 8|2@1+ (1,0) [0|2] "" HAD
 SG_ FC_Obj3_Track_Age : 16|16@1+ (1,0) [0|65535] "" HAD
 SG_ FC_Obj3_Confidence : 257|7@1+ (1,0) [0|100] "%" HAD
 SG_ FC_Obj3_MotionCategory : 10|4@1+ (1,0) [0|13] "" HAD
 SG_ FC_Obj3_MotionType : 32|3@1+ (1,0) [0|7] "" HAD
 SG_ FC_Obj3_MeasureStatus : 35|3@1+ (1,0) [0|7] "" HAD
 SG_ FC_Obj3_Class : 38|3@1+ (1,0) [0|7] "" HAD
 SG_ FC_Obj3_VehSubType : 41|3@1+ (1,0) [0|7] "" HAD
 SG_ FC_Obj3_PedSubType : 44|2@1+ (1,0) [0|3] "" HAD
 SG_ FC_Obj3_LaneAssignment : 46|3@1+ (1,0) [0|5] "" HAD
 SG_ FC_Obj3_Height : 49|9@1+ (0.02,0) [0|10.24] "m" HAD
 SG_ FC_Obj3_Height_Vnce : 58|9@1+ (0.02,0) [0|10.24] "m" HAD
 SG_ FC_Obj3_Length : 67|9@1+ (0.05,0) [0|25.6] "m" HAD
 SG_ FC_Obj3_Length_Vnce : 76|9@1+ (0.05,0) [0|25.6] "m" HAD
 SG_ FC_Obj3_Width : 85|9@1+ (0.02,0) [0|10.24] "m" HAD
 SG_ FC_Obj3_Width_Vnce : 94|9@1+ (0.02,0) [0|10.24] "m" HAD
 SG_ FC_Obj3_TurnLight : 103|3@1+ (1,0) [0|4] "" HAD
 SG_ FC_Obj3_Brakelight_Info : 106|1@1+ (1,0) [0|1] "" HAD
 SG_ FC_Obj3_TTC : 107|10@1+ (0.01,0) [0|10] "sec" HAD
 SG_ FC_Obj3_Dx : 117|13@1+ (0.0625,-250) [-250|250] "m" HAD
 SG_ FC_Obj3_Dx_STD : 130|13@1+ (0.0625,0) [0|250] "m" HAD
 SG_ FC_Obj3_Dy : 143|13@1+ (0.0625,-250) [-250|250] "m" HAD
 SG_ FC_Obj3_Dy_STD : 156|13@1+ (0.0625,0) [0|250] "m" HAD
 SG_ FC_Obj3_RelVx : 169|12@1+ (0.05,-102.4) [-102.4|102.35] "m/s" HAD
 SG_ FC_Obj3_RelVx_STD : 181|12@1+ (0.05,0) [0|102.35] "m/s" HAD
 SG_ FC_Obj3_RelVy : 193|12@1+ (0.05,-50) [-50|50] "m/s" HAD
 SG_ FC_Obj3_RelVy_STD : 205|12@1+ (0.05,0) [0|50] "m/s" HAD
 SG_ FC_Obj3_RelAx : 217|10@1+ (0.03,-14.97) [-14.97|14.97] "m/s2" HAD
 SG_ FC_Obj3_RelAx_STD : 227|10@1+ (0.03,0) [0|14.97] "m/s2" HAD
 SG_ FC_Obj3_RelAy : 237|10@1+ (0.03,-14.97) [-14.97|14.97] "m/s2" HAD
 SG_ FC_Obj3_RelAy_STD : 247|10@1+ (0.03,0) [0|14.97] "m/s2" HAD
 SG_ FC_Obj3_HeadingAngle : 264|16@1+ (0.01,-327.68) [-327.68|327.67] "degree" HAD
 SG_ FC_Obj3_HeadingAngle_Vnce : 280|16@1+ (0.01,0) [0|327.67] "degree" HAD
 SG_ FC_Obj3_WorldinfoYaw : 296|16@1+ (0.01,-327.68) [-327.68|327.67] "degree" HAD
 SG_ FC_Obj3_WorldinfoYaw_Vnce : 312|16@1+ (0.01,0) [0|327.67] "degree" HAD
 SG_ FC_Obj3_AbsVx : 328|12@1+ (0.05,-102.4) [-102.4|102.35] "m/s" HAD
 SG_ FC_Obj3_AbsVy : 340|12@1+ (0.05,-50) [-50|50] "m/s" HAD
 SG_ FC_Obj3_CutInFlag : 352|2@1+ (1,0) [0|2] "" HAD
 SG_ FC_Obj3_CornerPoint_x : 354|13@1+ (0.0625,-250) [-250|250] "m" HAD
 SG_ FC_Obj3_CornerPoint_y : 368|13@1+ (0.0625,-250) [-250|250] "m" HAD
 SG_ FC_Obj3_CutInLane : 384|13@1+ (0.01,-40.96) [-40.96|40.95] "m" HAD
 SG_ FC_Obj3_DistInLane : 400|11@1+ (0.01,-10) [-10|10] "" HAD
 SG_ FC_RollingCounter_452 : 411|4@1+ (1,0) [0|15] "" HAD
 SG_ FC_CRCChecksum_452 : 416|16@1+ (1,0) [0|65535] "" HAD

BO_ 1107 FCM_OD_4: 64 FC
 SG_ FC_Obj4_Track_ID : 0|8@1+ (1,0) [0|255] "" HAD
 SG_ FC_Obj4_Valid : 8|2@1+ (1,0) [0|2] "" HAD
 SG_ FC_Obj4_Track_Age : 16|16@1+ (1,0) [0|65535] "" HAD
 SG_ FC_Obj4_Confidence : 257|7@1+ (1,0) [0|100] "%" HAD
 SG_ FC_Obj4_MotionCategory : 10|4@1+ (1,0) [0|13] "" HAD
 SG_ FC_Obj4_MotionType : 32|3@1+ (1,0) [0|7] "" HAD
 SG_ FC_Obj4_MeasureStatus : 35|3@1+ (1,0) [0|7] "" HAD
 SG_ FC_Obj4_Class : 38|3@1+ (1,0) [0|7] "" HAD
 SG_ FC_Obj4_VehSubType : 41|3@1+ (1,0) [0|7] "" HAD
 SG_ FC_Obj4_PedSubType : 44|2@1+ (1,0) [0|3] "" HAD
 SG_ FC_Obj4_LaneAssignment : 46|3@1+ (1,0) [0|5] "" HAD
 SG_ FC_Obj4_Height : 49|9@1+ (0.02,0) [0|10.24] "m" HAD
 SG_ FC_Obj4_Height_Vnce : 58|9@1+ (0.02,0) [0|10.24] "m" HAD
 SG_ FC_Obj4_Length : 67|9@1+ (0.05,0) [0|25.6] "m" HAD
 SG_ FC_Obj4_Length_Vnce : 76|9@1+ (0.05,0) [0|25.6] "m" HAD
 SG_ FC_Obj4_Width : 85|9@1+ (0.02,0) [0|10.24] "m" HAD
 SG_ FC_Obj4_Width_Vnce : 94|9@1+ (0.02,0) [0|10.24] "m" HAD
 SG_ FC_Obj4_TurnLight : 103|3@1+ (1,0) [0|4] "" HAD
 SG_ FC_Obj4_Brakelight_Info : 106|1@1+ (1,0) [0|1] "" HAD
 SG_ FC_Obj4_TTC : 107|10@1+ (0.01,0) [0|10] "sec" HAD
 SG_ FC_Obj4_Dx : 117|13@1+ (0.0625,-250) [-250|250] "m" HAD
 SG_ FC_Obj4_Dx_STD : 130|13@1+ (0.0625,0) [0|250] "m" HAD
 SG_ FC_Obj4_Dy : 143|13@1+ (0.0625,-250) [-250|250] "m" HAD
 SG_ FC_Obj4_Dy_STD : 156|13@1+ (0.0625,0) [0|250] "m" HAD
 SG_ FC_Obj4_RelVx : 169|12@1+ (0.05,-102.4) [-102.4|102.35] "m/s" HAD
 SG_ FC_Obj4_RelVx_STD : 181|12@1+ (0.05,0) [0|102.35] "m/s" HAD
 SG_ FC_Obj4_RelVy : 193|12@1+ (0.05,-50) [-50|50] "m/s" HAD
 SG_ FC_Obj4_RelVy_STD : 205|12@1+ (0.05,0) [0|50] "m/s" HAD
 SG_ FC_Obj4_RelAx : 217|10@1+ (0.03,-14.97) [-14.97|14.97] "m/s2" HAD
 SG_ FC_Obj4_RelAx_STD : 227|10@1+ (0.03,0) [0|14.97] "m/s2" HAD
 SG_ FC_Obj4_RelAy : 237|10@1+ (0.03,-14.97) [-14.97|14.97] "m/s2" HAD
 SG_ FC_Obj4_RelAy_STD : 247|10@1+ (0.03,0) [0|14.97] "m/s2" HAD
 SG_ FC_Obj4_HeadingAngle : 264|16@1+ (0.01,-327.68) [-327.68|327.67] "degree" HAD
 SG_ FC_Obj4_HeadingAngle_Vnce : 280|16@1+ (0.01,0) [0|327.67] "degree" HAD
 SG_ FC_Obj4_WorldinfoYaw : 296|16@1+ (0.01,-327.68) [-327.68|327.67] "degree" HAD
 SG_ FC_Obj4_WorldinfoYaw_Vnce : 312|16@1+ (0.01,0) [0|327.67] "degree" HAD
 SG_ FC_Obj4_AbsVx : 328|12@1+ (0.05,-102.4) [-102.4|102.35] "m/s" HAD
 SG_ FC_Obj4_AbsVy : 340|12@1+ (0.05,-50) [-50|50] "m/s" HAD
 SG_ FC_Obj4_CutInFlag : 352|2@1+ (1,0) [0|2] "" HAD
 SG_ FC_Obj4_CornerPoint_x : 354|13@1+ (0.0625,-250) [-250|250] "m" HAD
 SG_ FC_Obj4_CornerPoint_y : 368|13@1+ (0.0625,-250) [-250|250] "m" HAD
 SG_ FC_Obj4_CutInLane : 384|13@1+ (0.01,-40.96) [-40.96|40.95] "m" HAD
 SG_ FC_Obj4_DistInLane : 400|11@1+ (0.01,-10) [-10|10] "" HAD
 SG_ FC_RollingCounter_453 : 411|4@1+ (1,0) [0|15] "" HAD
 SG_ FC_CRCChecksum_453 : 416|16@1+ (1,0) [0|65535] "" HAD

BO_ 1108 FCM_OD_5: 64 FC
 SG_ FC_Obj5_Track_ID : 0|8@1+ (1,0) [0|255] "" HAD
 SG_ FC_Obj5_Valid : 8|2@1+ (1,0) [0|2] "" HAD
 SG_ FC_Obj5_Track_Age : 16|16@1+ (1,0) [0|65535] "" HAD
 SG_ FC_Obj5_Confidence : 257|7@1+ (1,0) [0|100] "%" HAD
 SG_ FC_Obj5_MotionCategory : 10|4@1+ (1,0) [0|13] "" HAD
 SG_ FC_Obj5_MotionType : 32|3@1+ (1,0) [0|7] "" HAD
 SG_ FC_Obj5_MeasureStatus : 35|3@1+ (1,0) [0|7] "" HAD
 SG_ FC_Obj5_Class : 38|3@1+ (1,0) [0|7] "" HAD
 SG_ FC_Obj5_VehSubType : 41|3@1+ (1,0) [0|7] "" HAD
 SG_ FC_Obj5_PedSubType : 44|2@1+ (1,0) [0|3] "" HAD
 SG_ FC_Obj5_LaneAssignment : 46|3@1+ (1,0) [0|5] "" HAD
 SG_ FC_Obj5_Height : 49|9@1+ (0.02,0) [0|10.24] "m" HAD
 SG_ FC_Obj5_Height_Vnce : 58|9@1+ (0.02,0) [0|10.24] "m" HAD
 SG_ FC_Obj5_Length : 67|9@1+ (0.05,0) [0|25.6] "m" HAD
 SG_ FC_Obj5_Length_Vnce : 76|9@1+ (0.05,0) [0|25.6] "m" HAD
 SG_ FC_Obj5_Width : 85|9@1+ (0.02,0) [0|10.24] "m" HAD
 SG_ FC_Obj5_Width_Vnce : 94|9@1+ (0.02,0) [0|10.24] "m" HAD
 SG_ FC_Obj5_TurnLight : 103|3@1+ (1,0) [0|4] "" HAD
 SG_ FC_Obj5_Brakelight_Info : 106|1@1+ (1,0) [0|1] "" HAD
 SG_ FC_Obj5_TTC : 107|10@1+ (0.01,0) [0|10] "sec" HAD
 SG_ FC_Obj5_Dx : 117|13@1+ (0.0625,-250) [-250|250] "m" HAD
 SG_ FC_Obj5_Dx_STD : 130|13@1+ (0.0625,0) [0|250] "m" HAD
 SG_ FC_Obj5_Dy : 143|13@1+ (0.0625,-250) [-250|250] "m" HAD
 SG_ FC_Obj5_Dy_STD : 156|13@1+ (0.0625,0) [0|250] "m" HAD
 SG_ FC_Obj5_RelVx : 169|12@1+ (0.05,-102.4) [-102.4|102.35] "m/s" HAD
 SG_ FC_Obj5_RelVx_STD : 181|12@1+ (0.05,0) [0|102.35] "m/s" HAD
 SG_ FC_Obj5_RelVy : 193|12@1+ (0.05,-50) [-50|50] "m/s" HAD
 SG_ FC_Obj5_RelVy_STD : 205|12@1+ (0.05,0) [0|50] "m/s" HAD
 SG_ FC_Obj5_RelAx : 217|10@1+ (0.03,-14.97) [-14.97|14.97] "m/s2" HAD
 SG_ FC_Obj5_RelAx_STD : 227|10@1+ (0.03,0) [0|14.97] "m/s2" HAD
 SG_ FC_Obj5_RelAy : 237|10@1+ (0.03,-14.97) [-14.97|14.97] "m/s2" HAD
 SG_ FC_Obj5_RelAy_STD : 247|10@1+ (0.03,0) [0|14.97] "m/s2" HAD
 SG_ FC_Obj5_HeadingAngle : 264|16@1+ (0.01,-327.68) [-327.68|327.67] "degree" HAD
 SG_ FC_Obj5_HeadingAngle_Vnce : 280|16@1+ (0.01,0) [0|327.67] "degree" HAD
 SG_ FC_Obj5_WorldinfoYaw : 296|16@1+ (0.01,-327.68) [-327.68|327.67] "degree" HAD
 SG_ FC_Obj5_WorldinfoYaw_Vnce : 312|16@1+ (0.01,0) [0|327.67] "degree" HAD
 SG_ FC_Obj5_AbsVx : 328|12@1+ (0.05,-102.4) [-102.4|102.35] "m/s" HAD
 SG_ FC_Obj5_AbsVy : 340|12@1+ (0.05,-50) [-50|50] "m/s" HAD
 SG_ FC_Obj5_CutInFlag : 352|2@1+ (1,0) [0|2] "" HAD
 SG_ FC_Obj5_CornerPoint_x : 354|13@1+ (0.0625,-250) [-250|250] "m" HAD
 SG_ FC_Obj5_CornerPoint_y : 368|13@1+ (0.0625,-250) [-250|250] "m" HAD
 SG_ FC_Obj5_CutInLane : 384|13@1+ (0.01,-40.96) [-40.96|40.95] "m" HAD
 SG_ FC_Obj5_DistInLane : 400|11@1+ (0.01,-10) [-10|10] "" HAD
 SG_ FC_RollingCounter_454 : 411|4@1+ (1,0) [0|15] "" HAD
 SG_ FC_CRCChecksum_454 : 416|16@1+ (1,0) [0|65535] "" HAD

BO_ 1109 FCM_OD_6: 64 FC
 SG_ FC_Obj6_Track_ID : 0|8@1+ (1,0) [0|255] "" HAD
 SG_ FC_Obj6_Valid : 8|2@1+ (1,0) [0|2] "" HAD
 SG_ FC_Obj6_Track_Age : 16|16@1+ (1,0) [0|65535] "" HAD
 SG_ FC_Obj6_Confidence : 257|7@1+ (1,0) [0|100] "%" HAD
 SG_ FC_Obj6_MotionCategory : 10|4@1+ (1,0) [0|13] "" HAD
 SG_ FC_Obj6_MotionType : 32|3@1+ (1,0) [0|7] "" HAD
 SG_ FC_Obj6_MeasureStatus : 35|3@1+ (1,0) [0|7] "" HAD
 SG_ FC_Obj6_Class : 38|3@1+ (1,0) [0|7] "" HAD
 SG_ FC_Obj6_VehSubType : 41|3@1+ (1,0) [0|7] "" HAD
 SG_ FC_Obj6_PedSubType : 44|2@1+ (1,0) [0|3] "" HAD
 SG_ FC_Obj6_LaneAssignment : 46|3@1+ (1,0) [0|5] "" HAD
 SG_ FC_Obj6_Height : 49|9@1+ (0.02,0) [0|10.24] "m" HAD
 SG_ FC_Obj6_Height_Vnce : 58|9@1+ (0.02,0) [0|10.24] "m" HAD
 SG_ FC_Obj6_Length : 67|9@1+ (0.05,0) [0|25.6] "m" HAD
 SG_ FC_Obj6_Length_Vnce : 76|9@1+ (0.05,0) [0|25.6] "m" HAD
 SG_ FC_Obj6_Width : 85|9@1+ (0.02,0) [0|10.24] "m" HAD
 SG_ FC_Obj6_Width_Vnce : 94|9@1+ (0.02,0) [0|10.24] "m" HAD
 SG_ FC_Obj6_TurnLight : 103|3@1+ (1,0) [0|4] "" HAD
 SG_ FC_Obj6_Brakelight_Info : 106|1@1+ (1,0) [0|1] "" HAD
 SG_ FC_Obj6_TTC : 107|10@1+ (0.01,0) [0|10] "sec" HAD
 SG_ FC_Obj6_Dx : 117|13@1+ (0.0625,-250) [-250|250] "m" HAD
 SG_ FC_Obj6_Dx_STD : 130|13@1+ (0.0625,0) [0|250] "m" HAD
 SG_ FC_Obj6_Dy : 143|13@1+ (0.0625,-250) [-250|250] "m" HAD
 SG_ FC_Obj6_Dy_STD : 156|13@1+ (0.0625,0) [0|250] "m" HAD
 SG_ FC_Obj6_RelVx : 169|12@1+ (0.05,-102.4) [-102.4|102.35] "m/s" HAD
 SG_ FC_Obj6_RelVx_STD : 181|12@1+ (0.05,0) [0|102.35] "m/s" HAD
 SG_ FC_Obj6_RelVy : 193|12@1+ (0.05,-50) [-50|50] "m/s" HAD
 SG_ FC_Obj6_RelVy_STD : 205|12@1+ (0.05,0) [0|50] "m/s" HAD
 SG_ FC_Obj6_RelAx : 217|10@1+ (0.03,-14.97) [-14.97|14.97] "m/s2" HAD
 SG_ FC_Obj6_RelAx_STD : 227|10@1+ (0.03,0) [0|14.97] "m/s2" HAD
 SG_ FC_Obj6_RelAy : 237|10@1+ (0.03,-14.97) [-14.97|14.97] "m/s2" HAD
 SG_ FC_Obj6_RelAy_STD : 247|10@1+ (0.03,0) [0|14.97] "m/s2" HAD
 SG_ FC_Obj6_HeadingAngle : 264|16@1+ (0.01,-327.68) [-327.68|327.67] "degree" HAD
 SG_ FC_Obj6_HeadingAngle_Vnce : 280|16@1+ (0.01,0) [0|327.67] "degree" HAD
 SG_ FC_Obj6_WorldinfoYaw : 296|16@1+ (0.01,-327.68) [-327.68|327.67] "degree" HAD
 SG_ FC_Obj6_WorldinfoYaw_Vnce : 312|16@1+ (0.01,0) [0|327.67] "degree" HAD
 SG_ FC_Obj6_AbsVx : 328|12@1+ (0.05,-102.4) [-102.4|102.35] "m/s" HAD
 SG_ FC_Obj6_AbsVy : 340|12@1+ (0.05,-50) [-50|50] "m/s" HAD
 SG_ FC_Obj6_CutInFlag : 352|2@1+ (1,0) [0|2] "" HAD
 SG_ FC_Obj6_CornerPoint_x : 354|13@1+ (0.0625,-250) [-250|250] "m" HAD
 SG_ FC_Obj6_CornerPoint_y : 368|13@1+ (0.0625,-250) [-250|250] "m" HAD
 SG_ FC_Obj6_CutInLane : 384|13@1+ (0.01,-40.96) [-40.96|40.95] "m" HAD
 SG_ FC_Obj6_DistInLane : 400|11@1+ (0.01,-10) [-10|10] "" HAD
 SG_ FC_RollingCounter_455 : 411|4@1+ (1,0) [0|15] "" HAD
 SG_ FC_CRCChecksum_455 : 416|16@1+ (1,0) [0|65535] "" HAD

BO_ 1110 FCM_OD_7: 64 FC
 SG_ FC_Obj7_Track_ID : 0|8@1+ (1,0) [0|255] "" HAD
 SG_ FC_Obj7_Valid : 8|2@1+ (1,0) [0|2] "" HAD
 SG_ FC_Obj7_Track_Age : 16|16@1+ (1,0) [0|65535] "" HAD
 SG_ FC_Obj7_Confidence : 257|7@1+ (1,0) [0|100] "%" HAD
 SG_ FC_Obj7_MotionCategory : 10|4@1+ (1,0) [0|13] "" HAD
 SG_ FC_Obj7_MotionType : 32|3@1+ (1,0) [0|7] "" HAD
 SG_ FC_Obj7_MeasureStatus : 35|3@1+ (1,0) [0|7] "" HAD
 SG_ FC_Obj7_Class : 38|3@1+ (1,0) [0|7] "" HAD
 SG_ FC_Obj7_VehSubType : 41|3@1+ (1,0) [0|7] "" HAD
 SG_ FC_Obj7_PedSubType : 44|2@1+ (1,0) [0|3] "" HAD
 SG_ FC_Obj7_LaneAssignment : 46|3@1+ (1,0) [0|5] "" HAD
 SG_ FC_Obj7_Height : 49|9@1+ (0.02,0) [0|10.24] "m" HAD
 SG_ FC_Obj7_Height_Vnce : 58|9@1+ (0.02,0) [0|10.24] "m" HAD
 SG_ FC_Obj7_Length : 67|9@1+ (0.05,0) [0|25.6] "m" HAD
 SG_ FC_Obj7_Length_Vnce : 76|9@1+ (0.05,0) [0|25.6] "m" HAD
 SG_ FC_Obj7_Width : 85|9@1+ (0.02,0) [0|10.24] "m" HAD
 SG_ FC_Obj7_Width_Vnce : 94|9@1+ (0.02,0) [0|10.24] "m" HAD
 SG_ FC_Obj7_TurnLight : 103|3@1+ (1,0) [0|4] "" HAD
 SG_ FC_Obj7_Brakelight_Info : 106|1@1+ (1,0) [0|1] "" HAD
 SG_ FC_Obj7_TTC : 107|10@1+ (0.01,0) [0|10] "sec" HAD
 SG_ FC_Obj7_Dx : 117|13@1+ (0.0625,-250) [-250|250] "m" HAD
 SG_ FC_Obj7_Dx_STD : 130|13@1+ (0.0625,0) [0|250] "m" HAD
 SG_ FC_Obj7_Dy : 143|13@1+ (0.0625,-250) [-250|250] "m" HAD
 SG_ FC_Obj7_Dy_STD : 156|13@1+ (0.0625,0) [0|250] "m" HAD
 SG_ FC_Obj7_RelVx : 169|12@1+ (0.05,-102.4) [-102.4|102.35] "m/s" HAD
 SG_ FC_Obj7_RelVx_STD : 181|12@1+ (0.05,0) [0|102.35] "m/s" HAD
 SG_ FC_Obj7_RelVy : 193|12@1+ (0.05,-50) [-50|50] "m/s" HAD
 SG_ FC_Obj7_RelVy_STD : 205|12@1+ (0.05,0) [0|50] "m/s" HAD
 SG_ FC_Obj7_RelAx : 217|10@1+ (0.03,-14.97) [-14.97|14.97] "m/s2" HAD
 SG_ FC_Obj7_RelAx_STD : 227|10@1+ (0.03,0) [0|14.97] "m/s2" HAD
 SG_ FC_Obj7_RelAy : 237|10@1+ (0.03,-14.97) [-14.97|14.97] "m/s2" HAD
 SG_ FC_Obj7_RelAy_STD : 247|10@1+ (0.03,0) [0|14.97] "m/s2" HAD
 SG_ FC_Obj7_HeadingAngle : 264|16@1+ (0.01,-327.68) [-327.68|327.67] "degree" HAD
 SG_ FC_Obj7_HeadingAngle_Vnce : 280|16@1+ (0.01,0) [0|327.67] "degree" HAD
 SG_ FC_Obj7_WorldinfoYaw : 296|16@1+ (0.01,-327.68) [-327.68|327.67] "degree" HAD
 SG_ FC_Obj7_WorldinfoYaw_Vnce : 312|16@1+ (0.01,0) [0|327.67] "degree" HAD
 SG_ FC_Obj7_AbsVx : 328|12@1+ (0.05,-102.4) [-102.4|102.35] "m/s" HAD
 SG_ FC_Obj7_AbsVy : 340|12@1+ (0.05,-50) [-50|50] "m/s" HAD
 SG_ FC_Obj7_CutInFlag : 352|2@1+ (1,0) [0|2] "" HAD
 SG_ FC_Obj7_CornerPoint_x : 354|13@1+ (0.0625,-250) [-250|250] "m" HAD
 SG_ FC_Obj7_CornerPoint_y : 368|13@1+ (0.0625,-250) [-250|250] "m" HAD
 SG_ FC_Obj7_CutInLane : 384|13@1+ (0.01,-40.96) [-40.96|40.95] "m" HAD
 SG_ FC_Obj7_DistInLane : 400|11@1+ (0.01,-10) [-10|10] "" HAD
 SG_ FC_RollingCounter_456 : 411|4@1+ (1,0) [0|15] "" HAD
 SG_ FC_CRCChecksum_456 : 416|16@1+ (1,0) [0|65535] "" HAD

BO_ 1111 FCM_OD_8: 64 FC
 SG_ FC_Obj8_Track_ID : 0|8@1+ (1,0) [0|255] "" HAD
 SG_ FC_Obj8_Valid : 8|2@1+ (1,0) [0|2] "" HAD
 SG_ FC_Obj8_Track_Age : 16|16@1+ (1,0) [0|65535] "" HAD
 SG_ FC_Obj8_Confidence : 257|7@1+ (1,0) [0|100] "%" HAD
 SG_ FC_Obj8_MotionCategory : 10|4@1+ (1,0) [0|13] "" HAD
 SG_ FC_Obj8_MotionType : 32|3@1+ (1,0) [0|7] "" HAD
 SG_ FC_Obj8_MeasureStatus : 35|3@1+ (1,0) [0|7] "" HAD
 SG_ FC_Obj8_Class : 38|3@1+ (1,0) [0|7] "" HAD
 SG_ FC_Obj8_VehSubType : 41|3@1+ (1,0) [0|7] "" HAD
 SG_ FC_Obj8_PedSubType : 44|2@1+ (1,0) [0|3] "" HAD
 SG_ FC_Obj8_LaneAssignment : 46|3@1+ (1,0) [0|5] "" HAD
 SG_ FC_Obj8_Height : 49|9@1+ (0.02,0) [0|10.24] "m" HAD
 SG_ FC_Obj8_Height_Vnce : 58|9@1+ (0.02,0) [0|10.24] "m" HAD
 SG_ FC_Obj8_Length : 67|9@1+ (0.05,0) [0|25.6] "m" HAD
 SG_ FC_Obj8_Length_Vnce : 76|9@1+ (0.05,0) [0|25.6] "m" HAD
 SG_ FC_Obj8_Width : 85|9@1+ (0.02,0) [0|10.24] "m" HAD
 SG_ FC_Obj8_Width_Vnce : 94|9@1+ (0.02,0) [0|10.24] "m" HAD
 SG_ FC_Obj8_TurnLight : 103|3@1+ (1,0) [0|4] "" HAD
 SG_ FC_Obj8_Brakelight_Info : 106|1@1+ (1,0) [0|1] "" HAD
 SG_ FC_Obj8_TTC : 107|10@1+ (0.01,0) [0|10] "sec" HAD
 SG_ FC_Obj8_Dx : 117|13@1+ (0.0625,-250) [-250|250] "m" HAD
 SG_ FC_Obj8_Dx_STD : 130|13@1+ (0.0625,0) [0|250] "m" HAD
 SG_ FC_Obj8_Dy : 143|13@1+ (0.0625,-250) [-250|250] "m" HAD
 SG_ FC_Obj8_Dy_STD : 156|13@1+ (0.0625,0) [0|250] "m" HAD
 SG_ FC_Obj8_RelVx : 169|12@1+ (0.05,-102.4) [-102.4|102.35] "m/s" HAD
 SG_ FC_Obj8_RelVx_STD : 181|12@1+ (0.05,0) [0|102.35] "m/s" HAD
 SG_ FC_Obj8_RelVy : 193|12@1+ (0.05,-50) [-50|50] "m/s" HAD
 SG_ FC_Obj8_RelVy_STD : 205|12@1+ (0.05,0) [0|50] "m/s" HAD
 SG_ FC_Obj8_RelAx : 217|10@1+ (0.03,-14.97) [-14.97|14.97] "m/s2" HAD
 SG_ FC_Obj8_RelAx_STD : 227|10@1+ (0.03,0) [0|14.97] "m/s2" HAD
 SG_ FC_Obj8_RelAy : 237|10@1+ (0.03,-14.97) [-14.97|14.97] "m/s2" HAD
 SG_ FC_Obj8_RelAy_STD : 247|10@1+ (0.03,0) [0|14.97] "m/s2" HAD
 SG_ FC_Obj8_HeadingAngle : 264|16@1+ (0.01,-327.68) [-327.68|327.67] "degree" HAD
 SG_ FC_Obj8_HeadingAngle_Vnce : 280|16@1+ (0.01,0) [0|327.67] "degree" HAD
 SG_ FC_Obj8_WorldinfoYaw : 296|16@1+ (0.01,-327.68) [-327.68|327.67] "degree" HAD
 SG_ FC_Obj8_WorldinfoYaw_Vnce : 312|16@1+ (0.01,0) [0|327.67] "degree" HAD
 SG_ FC_Obj8_AbsVx : 328|12@1+ (0.05,-102.4) [-102.4|102.35] "m/s" HAD
 SG_ FC_Obj8_AbsVy : 340|12@1+ (0.05,-50) [-50|50] "m/s" HAD
 SG_ FC_Obj8_CutInFlag : 352|2@1+ (1,0) [0|2] "" HAD
 SG_ FC_Obj8_CornerPoint_x : 354|13@1+ (0.0625,-250) [-250|250] "m" HAD
 SG_ FC_Obj8_CornerPoint_y : 368|13@1+ (0.0625,-250) [-250|250] "m" HAD
 SG_ FC_Obj8_CutInLane : 384|13@1+ (0.01,-40.96) [-40.96|40.95] "m" HAD
 SG_ FC_Obj8_DistInLane : 400|11@1+ (0.01,-10) [-10|10] "" HAD
 SG_ FC_RollingCounter_457 : 411|4@1+ (1,0) [0|15] "" HAD
 SG_ FC_CRCChecksum_457 : 416|16@1+ (1,0) [0|65535] "" HAD

BO_ 1112 FCM_OD_9: 64 FC
 SG_ FC_Obj9_Track_ID : 0|8@1+ (1,0) [0|255] "" HAD
 SG_ FC_Obj9_Valid : 8|2@1+ (1,0) [0|2] "" HAD
 SG_ FC_Obj9_Track_Age : 16|16@1+ (1,0) [0|65535] "" HAD
 SG_ FC_Obj9_Confidence : 257|7@1+ (1,0) [0|100] "%" HAD
 SG_ FC_Obj9_MotionCategory : 10|4@1+ (1,0) [0|13] "" HAD
 SG_ FC_Obj9_MotionType : 32|3@1+ (1,0) [0|7] "" HAD
 SG_ FC_Obj9_MeasureStatus : 35|3@1+ (1,0) [0|7] "" HAD
 SG_ FC_Obj9_Class : 38|3@1+ (1,0) [0|7] "" HAD
 SG_ FC_Obj9_VehSubType : 41|3@1+ (1,0) [0|7] "" HAD
 SG_ FC_Obj9_PedSubType : 44|2@1+ (1,0) [0|3] "" HAD
 SG_ FC_Obj9_LaneAssignment : 46|3@1+ (1,0) [0|5] "" HAD
 SG_ FC_Obj9_Height : 49|9@1+ (0.02,0) [0|10.24] "m" HAD
 SG_ FC_Obj9_Height_Vnce : 58|9@1+ (0.02,0) [0|10.24] "m" HAD
 SG_ FC_Obj9_Length : 67|9@1+ (0.05,0) [0|25.6] "m" HAD
 SG_ FC_Obj9_Length_Vnce : 76|9@1+ (0.05,0) [0|25.6] "m" HAD
 SG_ FC_Obj9_Width : 85|9@1+ (0.02,0) [0|10.24] "m" HAD
 SG_ FC_Obj9_Width_Vnce : 94|9@1+ (0.02,0) [0|10.24] "m" HAD
 SG_ FC_Obj9_TurnLight : 103|3@1+ (1,0) [0|4] "" HAD
 SG_ FC_Obj9_Brakelight_Info : 106|1@1+ (1,0) [0|1] "" HAD
 SG_ FC_Obj9_TTC : 107|10@1+ (0.01,0) [0|10] "sec" HAD
 SG_ FC_Obj9_Dx : 117|13@1+ (0.0625,-250) [-250|250] "m" HAD
 SG_ FC_Obj9_Dx_STD : 130|13@1+ (0.0625,0) [0|250] "m" HAD
 SG_ FC_Obj9_Dy : 143|13@1+ (0.0625,-250) [-250|250] "m" HAD
 SG_ FC_Obj9_Dy_STD : 156|13@1+ (0.0625,0) [0|250] "m" HAD
 SG_ FC_Obj9_RelVx : 169|12@1+ (0.05,-102.4) [-102.4|102.35] "m/s" HAD
 SG_ FC_Obj9_RelVx_STD : 181|12@1+ (0.05,0) [0|102.35] "m/s" HAD
 SG_ FC_Obj9_RelVy : 193|12@1+ (0.05,-50) [-50|50] "m/s" HAD
 SG_ FC_Obj9_RelVy_STD : 205|12@1+ (0.05,0) [0|50] "m/s" HAD
 SG_ FC_Obj9_RelAx : 217|10@1+ (0.03,-14.97) [-14.97|14.97] "m/s2" HAD
 SG_ FC_Obj9_RelAx_STD : 227|10@1+ (0.03,0) [0|14.97] "m/s2" HAD
 SG_ FC_Obj9_RelAy : 237|10@1+ (0.03,-14.97) [-14.97|14.97] "m/s2" HAD
 SG_ FC_Obj9_RelAy_STD : 247|10@1+ (0.03,0) [0|14.97] "m/s2" HAD
 SG_ FC_Obj9_HeadingAngle : 264|16@1+ (0.01,-327.68) [-327.68|327.67] "degree" HAD
 SG_ FC_Obj9_HeadingAngle_Vnce : 280|16@1+ (0.01,0) [0|327.67] "degree" HAD
 SG_ FC_Obj9_WorldinfoYaw : 296|16@1+ (0.01,-327.68) [-327.68|327.67] "degree" HAD
 SG_ FC_Obj9_WorldinfoYaw_Vnce : 312|16@1+ (0.01,0) [0|327.67] "degree" HAD
 SG_ FC_Obj9_AbsVx : 328|12@1+ (0.05,-102.4) [-102.4|102.35] "m/s" HAD
 SG_ FC_Obj9_AbsVy : 340|12@1+ (0.05,-50) [-50|50] "m/s" HAD
 SG_ FC_Obj9_CutInFlag : 352|2@1+ (1,0) [0|2] "" HAD
 SG_ FC_Obj9_CornerPoint_x : 354|13@1+ (0.0625,-250) [-250|250] "m" HAD
 SG_ FC_Obj9_CornerPoint_y : 368|13@1+ (0.0625,-250) [-250|250] "m" HAD
 SG_ FC_Obj9_CutInLane : 384|13@1+ (0.01,-40.96) [-40.96|40.95] "m" HAD
 SG_ FC_Obj9_DistInLane : 400|11@1+ (0.01,-10) [-10|10] "" HAD
 SG_ FC_RollingCounter_458 : 411|4@1+ (1,0) [0|15] "" HAD
 SG_ FC_CRCChecksum_458 : 416|16@1+ (1,0) [0|65535] "" HAD

BO_ 1113 FCM_OD_10: 64 FC
 SG_ FC_Obj10_Track_ID : 0|8@1+ (1,0) [0|255] "" HAD
 SG_ FC_Obj10_Valid : 8|2@1+ (1,0) [0|2] "" HAD
 SG_ FC_Obj10_Track_Age : 16|16@1+ (1,0) [0|65535] "" HAD
 SG_ FC_Obj10_Confidence : 257|7@1+ (1,0) [0|100] "%" HAD
 SG_ FC_Obj10_MotionCategory : 10|4@1+ (1,0) [0|13] "" HAD
 SG_ FC_Obj10_MotionType : 32|3@1+ (1,0) [0|7] "" HAD
 SG_ FC_Obj10_MeasureStatus : 35|3@1+ (1,0) [0|7] "" HAD
 SG_ FC_Obj10_Class : 38|3@1+ (1,0) [0|7] "" HAD
 SG_ FC_Obj10_VehSubType : 41|3@1+ (1,0) [0|7] "" HAD
 SG_ FC_Obj10_PedSubType : 44|2@1+ (1,0) [0|3] "" HAD
 SG_ FC_Obj10_LaneAssignment : 46|3@1+ (1,0) [0|5] "" HAD
 SG_ FC_Obj10_Height : 49|9@1+ (0.02,0) [0|10.24] "m" HAD
 SG_ FC_Obj10_Height_Vnce : 58|9@1+ (0.02,0) [0|10.24] "m" HAD
 SG_ FC_Obj10_Length : 67|9@1+ (0.05,0) [0|25.6] "m" HAD
 SG_ FC_Obj10_Length_Vnce : 76|9@1+ (0.05,0) [0|25.6] "m" HAD
 SG_ FC_Obj10_Width : 85|9@1+ (0.02,0) [0|10.24] "m" HAD
 SG_ FC_Obj10_Width_Vnce : 94|9@1+ (0.02,0) [0|10.24] "m" HAD
 SG_ FC_Obj10_TurnLight : 103|3@1+ (1,0) [0|4] "" HAD
 SG_ FC_Obj10_Brakelight_Info : 106|1@1+ (1,0) [0|1] "" HAD
 SG_ FC_Obj10_TTC : 107|10@1+ (0.01,0) [0|10] "sec" HAD
 SG_ FC_Obj10_Dx : 117|13@1+ (0.0625,-250) [-250|250] "m" HAD
 SG_ FC_Obj10_Dx_STD : 130|13@1+ (0.0625,0) [0|250] "m" HAD
 SG_ FC_Obj10_Dy : 143|13@1+ (0.0625,-250) [-250|250] "m" HAD
 SG_ FC_Obj10_Dy_STD : 156|13@1+ (0.0625,0) [0|250] "m" HAD
 SG_ FC_Obj10_RelVx : 169|12@1+ (0.05,-102.4) [-102.4|102.35] "m/s" HAD
 SG_ FC_Obj10_RelVx_STD : 181|12@1+ (0.05,0) [0|102.35] "m/s" HAD
 SG_ FC_Obj10_RelVy : 193|12@1+ (0.05,-50) [-50|50] "m/s" HAD
 SG_ FC_Obj10_RelVy_STD : 205|12@1+ (0.05,0) [0|50] "m/s" HAD
 SG_ FC_Obj10_RelAx : 217|10@1+ (0.03,-14.97) [-14.97|14.97] "m/s2" HAD
 SG_ FC_Obj10_RelAx_STD : 227|10@1+ (0.03,0) [0|14.97] "m/s2" HAD
 SG_ FC_Obj10_RelAy : 237|10@1+ (0.03,-14.97) [-14.97|14.97] "m/s2" HAD
 SG_ FC_Obj10_RelAy_STD : 247|10@1+ (0.03,0) [0|14.97] "m/s2" HAD
 SG_ FC_Obj10_HeadingAngle : 264|16@1+ (0.01,-327.68) [-327.68|327.67] "degree" HAD
 SG_ FC_Obj10_HeadingAngle_Vnce : 280|16@1+ (0.01,0) [0|327.67] "degree" HAD
 SG_ FC_Obj10_WorldinfoYaw : 296|16@1+ (0.01,-327.68) [-327.68|327.67] "degree" HAD
 SG_ FC_Obj10_WorldinfoYaw_Vnce : 312|16@1+ (0.01,0) [0|327.67] "degree" HAD
 SG_ FC_Obj10_AbsVx : 328|12@1+ (0.05,-102.4) [-102.4|102.35] "m/s" HAD
 SG_ FC_Obj10_AbsVy : 340|12@1+ (0.05,-50) [-50|50] "m/s" HAD
 SG_ FC_Obj10_CutInFlag : 352|2@1+ (1,0) [0|2] "" HAD
 SG_ FC_Obj10_CornerPoint_x : 354|13@1+ (0.0625,-250) [-250|250] "m" HAD
 SG_ FC_Obj10_CornerPoint_y : 368|13@1+ (0.0625,-250) [-250|250] "m" HAD
 SG_ FC_Obj10_CutInLane : 384|13@1+ (0.01,-40.96) [-40.96|40.95] "m" HAD
 SG_ FC_Obj10_DistInLane : 400|11@1+ (0.01,-10) [-10|10] "" HAD
 SG_ FC_RollingCounter_459 : 411|4@1+ (1,0) [0|15] "" HAD
 SG_ FC_CRCChecksum_459 : 416|16@1+ (1,0) [0|65535] "" HAD

BO_ 1114 FCM_OD_11: 64 FC
 SG_ FC_Obj11_Track_ID : 0|8@1+ (1,0) [0|255] "" HAD
 SG_ FC_Obj11_Valid : 8|2@1+ (1,0) [0|2] "" HAD
 SG_ FC_Obj11_Track_Age : 16|16@1+ (1,0) [0|65535] "" HAD
 SG_ FC_Obj11_Confidence : 257|7@1+ (1,0) [0|100] "%" HAD
 SG_ FC_Obj11_MotionCategory : 10|4@1+ (1,0) [0|13] "" HAD
 SG_ FC_Obj11_MotionType : 32|3@1+ (1,0) [0|7] "" HAD
 SG_ FC_Obj11_MeasureStatus : 35|3@1+ (1,0) [0|7] "" HAD
 SG_ FC_Obj11_Class : 38|3@1+ (1,0) [0|7] "" HAD
 SG_ FC_Obj11_VehSubType : 41|3@1+ (1,0) [0|7] "" HAD
 SG_ FC_Obj11_PedSubType : 44|2@1+ (1,0) [0|3] "" HAD
 SG_ FC_Obj11_LaneAssignment : 46|3@1+ (1,0) [0|5] "" HAD
 SG_ FC_Obj11_Height : 49|9@1+ (0.02,0) [0|10.24] "m" HAD
 SG_ FC_Obj11_Height_Vnce : 58|9@1+ (0.02,0) [0|10.24] "m" HAD
 SG_ FC_Obj11_Length : 67|9@1+ (0.05,0) [0|25.6] "m" HAD
 SG_ FC_Obj11_Length_Vnce : 76|9@1+ (0.05,0) [0|25.6] "m" HAD
 SG_ FC_Obj11_Width : 85|9@1+ (0.02,0) [0|10.24] "m" HAD
 SG_ FC_Obj11_Width_Vnce : 94|9@1+ (0.02,0) [0|10.24] "m" HAD
 SG_ FC_Obj11_TurnLight : 103|3@1+ (1,0) [0|4] "" HAD
 SG_ FC_Obj11_Brakelight_Info : 106|1@1+ (1,0) [0|1] "" HAD
 SG_ FC_Obj11_TTC : 107|10@1+ (0.01,0) [0|10] "sec" HAD
 SG_ FC_Obj11_Dx : 117|13@1+ (0.0625,-250) [-250|250] "m" HAD
 SG_ FC_Obj11_Dx_STD : 130|13@1+ (0.0625,0) [0|250] "m" HAD
 SG_ FC_Obj11_Dy : 143|13@1+ (0.0625,-250) [-250|250] "m" HAD
 SG_ FC_Obj11_Dy_STD : 156|13@1+ (0.0625,0) [0|250] "m" HAD
 SG_ FC_Obj11_RelVx : 169|12@1+ (0.05,-102.4) [-102.4|102.35] "m/s" HAD
 SG_ FC_Obj11_RelVx_STD : 181|12@1+ (0.05,0) [0|102.35] "m/s" HAD
 SG_ FC_Obj11_RelVy : 193|12@1+ (0.05,-50) [-50|50] "m/s" HAD
 SG_ FC_Obj11_RelVy_STD : 205|12@1+ (0.05,0) [0|50] "m/s" HAD
 SG_ FC_Obj11_RelAx : 217|10@1+ (0.03,-14.97) [-14.97|14.97] "m/s2" HAD
 SG_ FC_Obj11_RelAx_STD : 227|10@1+ (0.03,0) [0|14.97] "m/s2" HAD
 SG_ FC_Obj11_RelAy : 237|10@1+ (0.03,-14.97) [-14.97|14.97] "m/s2" HAD
 SG_ FC_Obj11_RelAy_STD : 247|10@1+ (0.03,0) [0|14.97] "m/s2" HAD
 SG_ FC_Obj11_HeadingAngle : 264|16@1+ (0.01,-327.68) [-327.68|327.67] "degree" HAD
 SG_ FC_Obj11_HeadingAngle_Vnce : 280|16@1+ (0.01,0) [0|327.67] "degree" HAD
 SG_ FC_Obj11_WorldinfoYaw : 296|16@1+ (0.01,-327.68) [-327.68|327.67] "degree" HAD
 SG_ FC_Obj11_WorldinfoYaw_Vnce : 312|16@1+ (0.01,0) [0|327.67] "degree" HAD
 SG_ FC_Obj11_AbsVx : 328|12@1+ (0.05,-102.4) [-102.4|102.35] "m/s" HAD
 SG_ FC_Obj11_AbsVy : 340|12@1+ (0.05,-50) [-50|50] "m/s" HAD
 SG_ FC_Obj11_CutInFlag : 352|2@1+ (1,0) [0|2] "" HAD
 SG_ FC_Obj11_CornerPoint_x : 354|13@1+ (0.0625,-250) [-250|250] "m" HAD
 SG_ FC_Obj11_CornerPoint_y : 368|13@1+ (0.0625,-250) [-250|250] "m" HAD
 SG_ FC_Obj11_CutInLane : 384|13@1+ (0.01,-40.96) [-40.96|40.95] "m" HAD
 SG_ FC_Obj11_DistInLane : 400|11@1+ (0.01,-10) [-10|10] "" HAD
 SG_ FC_RollingCounter_45A : 411|4@1+ (1,0) [0|15] "" HAD
 SG_ FC_CRCChecksum_45A : 416|16@1+ (1,0) [0|65535] "" HAD

BO_ 1115 FCM_OD_12: 64 FC
 SG_ FC_Obj12_Track_ID : 0|8@1+ (1,0) [0|255] "" HAD
 SG_ FC_Obj12_Valid : 8|2@1+ (1,0) [0|2] "" HAD
 SG_ FC_Obj12_Track_Age : 16|16@1+ (1,0) [0|65535] "" HAD
 SG_ FC_Obj12_Confidence : 257|7@1+ (1,0) [0|100] "%" HAD
 SG_ FC_Obj12_MotionCategory : 10|4@1+ (1,0) [0|13] "" HAD
 SG_ FC_Obj12_MotionType : 32|3@1+ (1,0) [0|7] "" HAD
 SG_ FC_Obj12_MeasureStatus : 35|3@1+ (1,0) [0|7] "" HAD
 SG_ FC_Obj12_Class : 38|3@1+ (1,0) [0|7] "" HAD
 SG_ FC_Obj12_VehSubType : 41|3@1+ (1,0) [0|7] "" HAD
 SG_ FC_Obj12_PedSubType : 44|2@1+ (1,0) [0|3] "" HAD
 SG_ FC_Obj12_LaneAssignment : 46|3@1+ (1,0) [0|5] "" HAD
 SG_ FC_Obj12_Height : 49|9@1+ (0.02,0) [0|10.24] "m" HAD
 SG_ FC_Obj12_Height_Vnce : 58|9@1+ (0.02,0) [0|10.24] "m" HAD
 SG_ FC_Obj12_Length : 67|9@1+ (0.05,0) [0|25.6] "m" HAD
 SG_ FC_Obj12_Length_Vnce : 76|9@1+ (0.05,0) [0|25.6] "m" HAD
 SG_ FC_Obj12_Width : 85|9@1+ (0.02,0) [0|10.24] "m" HAD
 SG_ FC_Obj12_Width_Vnce : 94|9@1+ (0.02,0) [0|10.24] "m" HAD
 SG_ FC_Obj12_TurnLight : 103|3@1+ (1,0) [0|4] "" HAD
 SG_ FC_Obj12_Brakelight_Info : 106|1@1+ (1,0) [0|1] "" HAD
 SG_ FC_Obj12_TTC : 107|10@1+ (0.01,0) [0|10] "sec" HAD
 SG_ FC_Obj12_Dx : 117|13@1+ (0.0625,-250) [-250|250] "m" HAD
 SG_ FC_Obj12_Dx_STD : 130|13@1+ (0.0625,0) [0|250] "m" HAD
 SG_ FC_Obj12_Dy : 143|13@1+ (0.0625,-250) [-250|250] "m" HAD
 SG_ FC_Obj12_Dy_STD : 156|13@1+ (0.0625,0) [0|250] "m" HAD
 SG_ FC_Obj12_RelVx : 169|12@1+ (0.05,-102.4) [-102.4|102.35] "m/s" HAD
 SG_ FC_Obj12_RelVx_STD : 181|12@1+ (0.05,0) [0|102.35] "m/s" HAD
 SG_ FC_Obj12_RelVy : 193|12@1+ (0.05,-50) [-50|50] "m/s" HAD
 SG_ FC_Obj12_RelVy_STD : 205|12@1+ (0.05,0) [0|50] "m/s" HAD
 SG_ FC_Obj12_RelAx : 217|10@1+ (0.03,-14.97) [-14.97|14.97] "m/s2" HAD
 SG_ FC_Obj12_RelAx_STD : 227|10@1+ (0.03,0) [0|14.97] "m/s2" HAD
 SG_ FC_Obj12_RelAy : 237|10@1+ (0.03,-14.97) [-14.97|14.97] "m/s2" HAD
 SG_ FC_Obj12_RelAy_STD : 247|10@1+ (0.03,0) [0|14.97] "m/s2" HAD
 SG_ FC_Obj12_HeadingAngle : 264|16@1+ (0.01,-327.68) [-327.68|327.67] "degree" HAD
 SG_ FC_Obj12_HeadingAngle_Vnce : 280|16@1+ (0.01,0) [0|327.67] "degree" HAD
 SG_ FC_Obj12_WorldinfoYaw : 296|16@1+ (0.01,-327.68) [-327.68|327.67] "degree" HAD
 SG_ FC_Obj12_WorldinfoYaw_Vnce : 312|16@1+ (0.01,0) [0|327.67] "degree" HAD
 SG_ FC_Obj12_AbsVx : 328|12@1+ (0.05,-102.4) [-102.4|102.35] "m/s" HAD
 SG_ FC_Obj12_AbsVy : 340|12@1+ (0.05,-50) [-50|50] "m/s" HAD
 SG_ FC_Obj12_CutInFlag : 352|2@1+ (1,0) [0|2] "" HAD
 SG_ FC_Obj12_CornerPoint_x : 354|13@1+ (0.0625,-250) [-250|250] "m" HAD
 SG_ FC_Obj12_CornerPoint_y : 368|13@1+ (0.0625,-250) [-250|250] "m" HAD
 SG_ FC_Obj12_CutInLane : 384|13@1+ (0.01,-40.96) [-40.96|40.95] "m" HAD
 SG_ FC_Obj12_DistInLane : 400|11@1+ (0.01,-10) [-10|10] "" HAD
 SG_ FC_RollingCounter_45B : 411|4@1+ (1,0) [0|15] "" HAD
 SG_ FC_CRCChecksum_45B : 416|16@1+ (1,0) [0|65535] "" HAD

BO_ 1116 FCM_OD_13: 64 FC
 SG_ FC_Obj13_Track_ID : 0|8@1+ (1,0) [0|255] "" HAD
 SG_ FC_Obj13_Valid : 8|2@1+ (1,0) [0|2] "" HAD
 SG_ FC_Obj13_Track_Age : 16|16@1+ (1,0) [0|65535] "" HAD
 SG_ FC_Obj13_Confidence : 257|7@1+ (1,0) [0|100] "%" HAD
 SG_ FC_Obj13_MotionCategory : 10|4@1+ (1,0) [0|13] "" HAD
 SG_ FC_Obj13_MotionType : 32|3@1+ (1,0) [0|7] "" HAD
 SG_ FC_Obj13_MeasureStatus : 35|3@1+ (1,0) [0|7] "" HAD
 SG_ FC_Obj13_Class : 38|3@1+ (1,0) [0|7] "" HAD
 SG_ FC_Obj13_VehSubType : 41|3@1+ (1,0) [0|7] "" HAD
 SG_ FC_Obj13_PedSubType : 44|2@1+ (1,0) [0|3] "" HAD
 SG_ FC_Obj13_LaneAssignment : 46|3@1+ (1,0) [0|5] "" HAD
 SG_ FC_Obj13_Height : 49|9@1+ (0.02,0) [0|10.24] "m" HAD
 SG_ FC_Obj13_Height_Vnce : 58|9@1+ (0.02,0) [0|10.24] "m" HAD
 SG_ FC_Obj13_Length : 67|9@1+ (0.05,0) [0|25.6] "m" HAD
 SG_ FC_Obj13_Length_Vnce : 76|9@1+ (0.05,0) [0|25.6] "m" HAD
 SG_ FC_Obj13_Width : 85|9@1+ (0.02,0) [0|10.24] "m" HAD
 SG_ FC_Obj13_Width_Vnce : 94|9@1+ (0.02,0) [0|10.24] "m" HAD
 SG_ FC_Obj13_TurnLight : 103|3@1+ (1,0) [0|4] "" HAD
 SG_ FC_Obj13_Brakelight_Info : 106|1@1+ (1,0) [0|1] "" HAD
 SG_ FC_Obj13_TTC : 107|10@1+ (0.01,0) [0|10] "sec" HAD
 SG_ FC_Obj13_Dx : 117|13@1+ (0.0625,-250) [-250|250] "m" HAD
 SG_ FC_Obj13_Dx_STD : 130|13@1+ (0.0625,0) [0|250] "m" HAD
 SG_ FC_Obj13_Dy : 143|13@1+ (0.0625,-250) [-250|250] "m" HAD
 SG_ FC_Obj13_Dy_STD : 156|13@1+ (0.0625,0) [0|250] "m" HAD
 SG_ FC_Obj13_RelVx : 169|12@1+ (0.05,-102.4) [-102.4|102.35] "m/s" HAD
 SG_ FC_Obj13_RelVx_STD : 181|12@1+ (0.05,0) [0|102.35] "m/s" HAD
 SG_ FC_Obj13_RelVy : 193|12@1+ (0.05,-50) [-50|50] "m/s" HAD
 SG_ FC_Obj13_RelVy_STD : 205|12@1+ (0.05,0) [0|50] "m/s" HAD
 SG_ FC_Obj13_RelAx : 217|10@1+ (0.03,-14.97) [-14.97|14.97] "m/s2" HAD
 SG_ FC_Obj13_RelAx_STD : 227|10@1+ (0.03,0) [0|14.97] "m/s2" HAD
 SG_ FC_Obj13_RelAy : 237|10@1+ (0.03,-14.97) [-14.97|14.97] "m/s2" HAD
 SG_ FC_Obj13_RelAy_STD : 247|10@1+ (0.03,0) [0|14.97] "m/s2" HAD
 SG_ FC_Obj13_HeadingAngle : 264|16@1+ (0.01,-327.68) [-327.68|327.67] "degree" HAD
 SG_ FC_Obj13_HeadingAngle_Vnce : 280|16@1+ (0.01,0) [0|327.67] "degree" HAD
 SG_ FC_Obj13_WorldinfoYaw : 296|16@1+ (0.01,-327.68) [-327.68|327.67] "degree" HAD
 SG_ FC_Obj13_WorldinfoYaw_Vnce : 312|16@1+ (0.01,0) [0|327.67] "degree" HAD
 SG_ FC_Obj13_AbsVx : 328|12@1+ (0.05,-102.4) [-102.4|102.35] "m/s" HAD
 SG_ FC_Obj13_AbsVy : 340|12@1+ (0.05,-50) [-50|50] "m/s" HAD
 SG_ FC_Obj13_CutInFlag : 352|2@1+ (1,0) [0|2] "" HAD
 SG_ FC_Obj13_CornerPoint_x : 354|13@1+ (0.0625,-250) [-250|250] "m" HAD
 SG_ FC_Obj13_CornerPoint_y : 368|13@1+ (0.0625,-250) [-250|250] "m" HAD
 SG_ FC_Obj13_CutInLane : 384|13@1+ (0.01,-40.96) [-40.96|40.95] "m" HAD
 SG_ FC_Obj13_DistInLane : 400|11@1+ (0.01,-10) [-10|10] "" HAD
 SG_ FC_RollingCounter_45C : 411|4@1+ (1,0) [0|15] "" HAD
 SG_ FC_CRCChecksum_45C : 416|16@1+ (1,0) [0|65535] "" HAD

BO_ 1117 FCM_OD_14: 64 FC
 SG_ FC_Obj14_Track_ID : 0|8@1+ (1,0) [0|255] "" HAD
 SG_ FC_Obj14_Valid : 8|2@1+ (1,0) [0|2] "" HAD
 SG_ FC_Obj14_Track_Age : 16|16@1+ (1,0) [0|65535] "" HAD
 SG_ FC_Obj14_Confidence : 257|7@1+ (1,0) [0|100] "%" HAD
 SG_ FC_Obj14_MotionCategory : 10|4@1+ (1,0) [0|13] "" HAD
 SG_ FC_Obj14_MotionType : 32|3@1+ (1,0) [0|7] "" HAD
 SG_ FC_Obj14_MeasureStatus : 35|3@1+ (1,0) [0|7] "" HAD
 SG_ FC_Obj14_Class : 38|3@1+ (1,0) [0|7] "" HAD
 SG_ FC_Obj14_VehSubType : 41|3@1+ (1,0) [0|7] "" HAD
 SG_ FC_Obj14_PedSubType : 44|2@1+ (1,0) [0|3] "" HAD
 SG_ FC_Obj14_LaneAssignment : 46|3@1+ (1,0) [0|5] "" HAD
 SG_ FC_Obj14_Height : 49|9@1+ (0.02,0) [0|10.24] "m" HAD
 SG_ FC_Obj14_Height_Vnce : 58|9@1+ (0.02,0) [0|10.24] "m" HAD
 SG_ FC_Obj14_Length : 67|9@1+ (0.05,0) [0|25.6] "m" HAD
 SG_ FC_Obj14_Length_Vnce : 76|9@1+ (0.05,0) [0|25.6] "m" HAD
 SG_ FC_Obj14_Width : 85|9@1+ (0.02,0) [0|10.24] "m" HAD
 SG_ FC_Obj14_Width_Vnce : 94|9@1+ (0.02,0) [0|10.24] "m" HAD
 SG_ FC_Obj14_TurnLight : 103|3@1+ (1,0) [0|4] "" HAD
 SG_ FC_Obj14_Brakelight_Info : 106|1@1+ (1,0) [0|1] "" HAD
 SG_ FC_Obj14_TTC : 107|10@1+ (0.01,0) [0|10] "sec" HAD
 SG_ FC_Obj14_Dx : 117|13@1+ (0.0625,-250) [-250|250] "m" HAD
 SG_ FC_Obj14_Dx_STD : 130|13@1+ (0.0625,0) [0|250] "m" HAD
 SG_ FC_Obj14_Dy : 143|13@1+ (0.0625,-250) [-250|250] "m" HAD
 SG_ FC_Obj14_Dy_STD : 156|13@1+ (0.0625,0) [0|250] "m" HAD
 SG_ FC_Obj14_RelVx : 169|12@1+ (0.05,-102.4) [-102.4|102.35] "m/s" HAD
 SG_ FC_Obj14_RelVx_STD : 181|12@1+ (0.05,0) [0|102.35] "m/s" HAD
 SG_ FC_Obj14_RelVy : 193|12@1+ (0.05,-50) [-50|50] "m/s" HAD
 SG_ FC_Obj14_RelVy_STD : 205|12@1+ (0.05,0) [0|50] "m/s" HAD
 SG_ FC_Obj14_RelAx : 217|10@1+ (0.03,-14.97) [-14.97|14.97] "m/s2" HAD
 SG_ FC_Obj14_RelAx_STD : 227|10@1+ (0.03,0) [0|14.97] "m/s2" HAD
 SG_ FC_Obj14_RelAy : 237|10@1+ (0.03,-14.97) [-14.97|14.97] "m/s2" HAD
 SG_ FC_Obj14_RelAy_STD : 247|10@1+ (0.03,0) [0|14.97] "m/s2" HAD
 SG_ FC_Obj14_HeadingAngle : 264|16@1+ (0.01,-327.68) [-327.68|327.67] "degree" HAD
 SG_ FC_Obj14_HeadingAngle_Vnce : 280|16@1+ (0.01,0) [0|327.67] "degree" HAD
 SG_ FC_Obj14_WorldinfoYaw : 296|16@1+ (0.01,-327.68) [-327.68|327.67] "degree" HAD
 SG_ FC_Obj14_WorldinfoYaw_Vnce : 312|16@1+ (0.01,0) [0|327.67] "degree" HAD
 SG_ FC_Obj14_AbsVx : 328|12@1+ (0.05,-102.4) [-102.4|102.35] "m/s" HAD
 SG_ FC_Obj14_AbsVy : 340|12@1+ (0.05,-50) [-50|50] "m/s" HAD
 SG_ FC_Obj14_CutInFlag : 352|2@1+ (1,0) [0|2] "" HAD
 SG_ FC_Obj14_CornerPoint_x : 354|13@1+ (0.0625,-250) [-250|250] "m" HAD
 SG_ FC_Obj14_CornerPoint_y : 368|13@1+ (0.0625,-250) [-250|250] "m" HAD
 SG_ FC_Obj14_CutInLane : 384|13@1+ (0.01,-40.96) [-40.96|40.95] "m" HAD
 SG_ FC_Obj14_DistInLane : 400|11@1+ (0.01,-10) [-10|10] "" HAD
 SG_ FC_RollingCounter_45D : 411|4@1+ (1,0) [0|15] "" HAD
 SG_ FC_CRCChecksum_45D : 416|16@1+ (1,0) [0|65535] "" HAD

BO_ 1118 FCM_OD_15: 64 FC
 SG_ FC_Obj15_Track_ID : 0|8@1+ (1,0) [0|255] "" HAD
 SG_ FC_Obj15_Valid : 8|2@1+ (1,0) [0|2] "" HAD
 SG_ FC_Obj15_Track_Age : 16|16@1+ (1,0) [0|65535] "" HAD
 SG_ FC_Obj15_Confidence : 257|7@1+ (1,0) [0|100] "%" HAD
 SG_ FC_Obj15_MotionCategory : 10|4@1+ (1,0) [0|13] "" HAD
 SG_ FC_Obj15_MotionType : 32|3@1+ (1,0) [0|7] "" HAD
 SG_ FC_Obj15_MeasureStatus : 35|3@1+ (1,0) [0|7] "" HAD
 SG_ FC_Obj15_Class : 38|3@1+ (1,0) [0|7] "" HAD
 SG_ FC_Obj15_VehSubType : 41|3@1+ (1,0) [0|7] "" HAD
 SG_ FC_Obj15_PedSubType : 44|2@1+ (1,0) [0|3] "" HAD
 SG_ FC_Obj15_LaneAssignment : 46|3@1+ (1,0) [0|5] "" HAD
 SG_ FC_Obj15_Height : 49|9@1+ (0.02,0) [0|10.24] "m" HAD
 SG_ FC_Obj15_Height_Vnce : 58|9@1+ (0.02,0) [0|10.24] "m" HAD
 SG_ FC_Obj15_Length : 67|9@1+ (0.05,0) [0|25.6] "m" HAD
 SG_ FC_Obj15_Length_Vnce : 76|9@1+ (0.05,0) [0|25.6] "m" HAD
 SG_ FC_Obj15_Width : 85|9@1+ (0.02,0) [0|10.24] "m" HAD
 SG_ FC_Obj15_Width_Vnce : 94|9@1+ (0.02,0) [0|10.24] "m" HAD
 SG_ FC_Obj15_TurnLight : 103|3@1+ (1,0) [0|4] "" HAD
 SG_ FC_Obj15_Brakelight_Info : 106|1@1+ (1,0) [0|1] "" HAD
 SG_ FC_Obj15_TTC : 107|10@1+ (0.01,0) [0|10] "sec" HAD
 SG_ FC_Obj15_Dx : 117|13@1+ (0.0625,-250) [-250|250] "m" HAD
 SG_ FC_Obj15_Dx_STD : 130|13@1+ (0.0625,0) [0|250] "m" HAD
 SG_ FC_Obj15_Dy : 143|13@1+ (0.0625,-250) [-250|250] "m" HAD
 SG_ FC_Obj15_Dy_STD : 156|13@1+ (0.0625,0) [0|250] "m" HAD
 SG_ FC_Obj15_RelVx : 169|12@1+ (0.05,-102.4) [-102.4|102.35] "m/s" HAD
 SG_ FC_Obj15_RelVx_STD : 181|12@1+ (0.05,0) [0|102.35] "m/s" HAD
 SG_ FC_Obj15_RelVy : 193|12@1+ (0.05,-50) [-50|50] "m/s" HAD
 SG_ FC_Obj15_RelVy_STD : 205|12@1+ (0.05,0) [0|50] "m/s" HAD
 SG_ FC_Obj15_RelAx : 217|10@1+ (0.03,-14.97) [-14.97|14.97] "m/s2" HAD
 SG_ FC_Obj15_RelAx_STD : 227|10@1+ (0.03,0) [0|14.97] "m/s2" HAD
 SG_ FC_Obj15_RelAy : 237|10@1+ (0.03,-14.97) [-14.97|14.97] "m/s2" HAD
 SG_ FC_Obj15_RelAy_STD : 247|10@1+ (0.03,0) [0|14.97] "m/s2" HAD
 SG_ FC_Obj15_HeadingAngle : 264|16@1+ (0.01,-327.68) [-327.68|327.67] "degree" HAD
 SG_ FC_Obj15_HeadingAngle_Vnce : 280|16@1+ (0.01,0) [0|327.67] "degree" HAD
 SG_ FC_Obj15_WorldinfoYaw : 296|16@1+ (0.01,-327.68) [-327.68|327.67] "degree" HAD
 SG_ FC_Obj15_WorldinfoYaw_Vnce : 312|16@1+ (0.01,0) [0|327.67] "degree" HAD
 SG_ FC_Obj15_AbsVx : 328|12@1+ (0.05,-102.4) [-102.4|102.35] "m/s" HAD
 SG_ FC_Obj15_AbsVy : 340|12@1+ (0.05,-50) [-50|50] "m/s" HAD
 SG_ FC_Obj15_CutInFlag : 352|2@1+ (1,0) [0|2] "" HAD
 SG_ FC_Obj15_CornerPoint_x : 354|13@1+ (0.0625,-250) [-250|250] "m" HAD
 SG_ FC_Obj15_CornerPoint_y : 368|13@1+ (0.0625,-250) [-250|250] "m" HAD
 SG_ FC_Obj15_CutInLane : 384|13@1+ (0.01,-40.96) [-40.96|40.95] "m" HAD
 SG_ FC_Obj15_DistInLane : 400|11@1+ (0.01,-10) [-10|10] "" HAD
 SG_ FC_RollingCounter_45E : 411|4@1+ (1,0) [0|15] "" HAD
 SG_ FC_CRCChecksum_45E : 416|16@1+ (1,0) [0|65535] "" HAD

BO_ 1119 FCM_OD_16: 64 FC
 SG_ FC_Obj16_Track_ID : 0|8@1+ (1,0) [0|255] "" HAD
 SG_ FC_Obj16_Valid : 8|2@1+ (1,0) [0|2] "" HAD
 SG_ FC_Obj16_Track_Age : 16|16@1+ (1,0) [0|65535] "" HAD
 SG_ FC_Obj16_Confidence : 257|7@1+ (1,0) [0|100] "%" HAD
 SG_ FC_Obj16_MotionCategory : 10|4@1+ (1,0) [0|13] "" HAD
 SG_ FC_Obj16_MotionType : 32|3@1+ (1,0) [0|7] "" HAD
 SG_ FC_Obj16_MeasureStatus : 35|3@1+ (1,0) [0|7] "" HAD
 SG_ FC_Obj16_Class : 38|3@1+ (1,0) [0|7] "" HAD
 SG_ FC_Obj16_VehSubType : 41|3@1+ (1,0) [0|7] "" HAD
 SG_ FC_Obj16_PedSubType : 44|2@1+ (1,0) [0|3] "" HAD
 SG_ FC_Obj16_LaneAssignment : 46|3@1+ (1,0) [0|5] "" HAD
 SG_ FC_Obj16_Height : 49|9@1+ (0.02,0) [0|10.24] "m" HAD
 SG_ FC_Obj16_Height_Vnce : 58|9@1+ (0.02,0) [0|10.24] "m" HAD
 SG_ FC_Obj16_Length : 67|9@1+ (0.05,0) [0|25.6] "m" HAD
 SG_ FC_Obj16_Length_Vnce : 76|9@1+ (0.05,0) [0|25.6] "m" HAD
 SG_ FC_Obj16_Width : 85|9@1+ (0.02,0) [0|10.24] "m" HAD
 SG_ FC_Obj16_Width_Vnce : 94|9@1+ (0.02,0) [0|10.24] "m" HAD
 SG_ FC_Obj16_TurnLight : 103|3@1+ (1,0) [0|4] "" HAD
 SG_ FC_Obj16_Brakelight_Info : 106|1@1+ (1,0) [0|1] "" HAD
 SG_ FC_Obj16_TTC : 107|10@1+ (0.01,0) [0|10] "sec" HAD
 SG_ FC_Obj16_Dx : 117|13@1+ (0.0625,-250) [-250|250] "m" HAD
 SG_ FC_Obj16_Dx_STD : 130|13@1+ (0.0625,0) [0|250] "m" HAD
 SG_ FC_Obj16_Dy : 143|13@1+ (0.0625,-250) [-250|250] "m" HAD
 SG_ FC_Obj16_Dy_STD : 156|13@1+ (0.0625,0) [0|250] "m" HAD
 SG_ FC_Obj16_RelVx : 169|12@1+ (0.05,-102.4) [-102.4|102.35] "m/s" HAD
 SG_ FC_Obj16_RelVx_STD : 181|12@1+ (0.05,0) [0|102.35] "m/s" HAD
 SG_ FC_Obj16_RelVy : 193|12@1+ (0.05,-50) [-50|50] "m/s" HAD
 SG_ FC_Obj16_RelVy_STD : 205|12@1+ (0.05,0) [0|50] "m/s" HAD
 SG_ FC_Obj16_RelAx : 217|10@1+ (0.03,-14.97) [-14.97|14.97] "m/s2" HAD
 SG_ FC_Obj16_RelAx_STD : 227|10@1+ (0.03,0) [0|14.97] "m/s2" HAD
 SG_ FC_Obj16_RelAy : 237|10@1+ (0.03,-14.97) [-14.97|14.97] "m/s2" HAD
 SG_ FC_Obj16_RelAy_STD : 247|10@1+ (0.03,0) [0|14.97] "m/s2" HAD
 SG_ FC_Obj16_HeadingAngle : 264|16@1+ (0.01,-327.68) [-327.68|327.67] "degree" HAD
 SG_ FC_Obj16_HeadingAngle_Vnce : 280|16@1+ (0.01,0) [0|327.67] "degree" HAD
 SG_ FC_Obj16_WorldinfoYaw : 296|16@1+ (0.01,-327.68) [-327.68|327.67] "degree" HAD
 SG_ FC_Obj16_WorldinfoYaw_Vnce : 312|16@1+ (0.01,0) [0|327.67] "degree" HAD
 SG_ FC_Obj16_AbsVx : 328|12@1+ (0.05,-102.4) [-102.4|102.35] "m/s" HAD
 SG_ FC_Obj16_AbsVy : 340|12@1+ (0.05,-50) [-50|50] "m/s" HAD
 SG_ FC_Obj16_CutInFlag : 352|2@1+ (1,0) [0|2] "" HAD
 SG_ FC_Obj16_CornerPoint_x : 354|13@1+ (0.0625,-250) [-250|250] "m" HAD
 SG_ FC_Obj16_CornerPoint_y : 368|13@1+ (0.0625,-250) [-250|250] "m" HAD
 SG_ FC_Obj16_CutInLane : 384|13@1+ (0.01,-40.96) [-40.96|40.95] "m" HAD
 SG_ FC_Obj16_DistInLane : 400|11@1+ (0.01,-10) [-10|10] "" HAD
 SG_ FC_RollingCounter_45F : 411|4@1+ (1,0) [0|15] "" HAD
 SG_ FC_CRCChecksum_45F : 416|16@1+ (1,0) [0|65535] "" HAD

BO_ 1120 FCM_OD_17: 64 FC
 SG_ FC_Obj17_Track_ID : 0|8@1+ (1,0) [0|255] "" HAD
 SG_ FC_Obj17_Valid : 8|2@1+ (1,0) [0|2] "" HAD
 SG_ FC_Obj17_Track_Age : 16|16@1+ (1,0) [0|65535] "" HAD
 SG_ FC_Obj17_Confidence : 257|7@1+ (1,0) [0|100] "%" HAD
 SG_ FC_Obj17_MotionCategory : 10|4@1+ (1,0) [0|13] "" HAD
 SG_ FC_Obj17_MotionType : 32|3@1+ (1,0) [0|7] "" HAD
 SG_ FC_Obj17_MeasureStatus : 35|3@1+ (1,0) [0|7] "" HAD
 SG_ FC_Obj17_Class : 38|3@1+ (1,0) [0|7] "" HAD
 SG_ FC_Obj17_VehSubType : 41|3@1+ (1,0) [0|7] "" HAD
 SG_ FC_Obj17_PedSubType : 44|2@1+ (1,0) [0|3] "" HAD
 SG_ FC_Obj17_LaneAssignment : 46|3@1+ (1,0) [0|5] "" HAD
 SG_ FC_Obj17_Height : 49|9@1+ (0.02,0) [0|10.24] "m" HAD
 SG_ FC_Obj17_Height_Vnce : 58|9@1+ (0.02,0) [0|10.24] "m" HAD
 SG_ FC_Obj17_Length : 67|9@1+ (0.05,0) [0|25.6] "m" HAD
 SG_ FC_Obj17_Length_Vnce : 76|9@1+ (0.05,0) [0|25.6] "m" HAD
 SG_ FC_Obj17_Width : 85|9@1+ (0.02,0) [0|10.24] "m" HAD
 SG_ FC_Obj17_Width_Vnce : 94|9@1+ (0.02,0) [0|10.24] "m" HAD
 SG_ FC_Obj17_TurnLight : 103|3@1+ (1,0) [0|4] "" HAD
 SG_ FC_Obj17_Brakelight_Info : 106|1@1+ (1,0) [0|1] "" HAD
 SG_ FC_Obj17_TTC : 107|10@1+ (0.01,0) [0|10] "sec" HAD
 SG_ FC_Obj17_Dx : 117|13@1+ (0.0625,-250) [-250|250] "m" HAD
 SG_ FC_Obj17_Dx_STD : 130|13@1+ (0.0625,0) [0|250] "m" HAD
 SG_ FC_Obj17_Dy : 143|13@1+ (0.0625,-250) [-250|250] "m" HAD
 SG_ FC_Obj17_Dy_STD : 156|13@1+ (0.0625,0) [0|250] "m" HAD
 SG_ FC_Obj17_RelVx : 169|12@1+ (0.05,-102.4) [-102.4|102.35] "m/s" HAD
 SG_ FC_Obj17_RelVx_STD : 181|12@1+ (0.05,0) [0|102.35] "m/s" HAD
 SG_ FC_Obj17_RelVy : 193|12@1+ (0.05,-50) [-50|50] "m/s" HAD
 SG_ FC_Obj17_RelVy_STD : 205|12@1+ (0.05,0) [0|50] "m/s" HAD
 SG_ FC_Obj17_RelAx : 217|10@1+ (0.03,-14.97) [-14.97|14.97] "m/s2" HAD
 SG_ FC_Obj17_RelAx_STD : 227|10@1+ (0.03,0) [0|14.97] "m/s2" HAD
 SG_ FC_Obj17_RelAy : 237|10@1+ (0.03,-14.97) [-14.97|14.97] "m/s2" HAD
 SG_ FC_Obj17_RelAy_STD : 247|10@1+ (0.03,0) [0|14.97] "m/s2" HAD
 SG_ FC_Obj17_HeadingAngle : 264|16@1+ (0.01,-327.68) [-327.68|327.67] "degree" HAD
 SG_ FC_Obj17_HeadingAngle_Vnce : 280|16@1+ (0.01,0) [0|327.67] "degree" HAD
 SG_ FC_Obj17_WorldinfoYaw : 296|16@1+ (0.01,-327.68) [-327.68|327.67] "degree" HAD
 SG_ FC_Obj17_WorldinfoYaw_Vnce : 312|16@1+ (0.01,0) [0|327.67] "degree" HAD
 SG_ FC_Obj17_AbsVx : 328|12@1+ (0.05,-102.4) [-102.4|102.35] "m/s" HAD
 SG_ FC_Obj17_AbsVy : 340|12@1+ (0.05,-50) [-50|50] "m/s" HAD
 SG_ FC_Obj17_CutInFlag : 352|2@1+ (1,0) [0|2] "" HAD
 SG_ FC_Obj17_CornerPoint_x : 354|13@1+ (0.0625,-250) [-250|250] "m" HAD
 SG_ FC_Obj17_CornerPoint_y : 368|13@1+ (0.0625,-250) [-250|250] "m" HAD
 SG_ FC_Obj17_CutInLane : 384|13@1+ (0.01,-40.96) [-40.96|40.95] "m" HAD
 SG_ FC_Obj17_DistInLane : 400|11@1+ (0.01,-10) [-10|10] "" HAD
 SG_ FC_RollingCounter_460 : 411|4@1+ (1,0) [0|15] "" HAD
 SG_ FC_CRCChecksum_460 : 416|16@1+ (1,0) [0|65535] "" HAD

BO_ 1121 FCM_OD_18: 64 FC
 SG_ FC_Obj18_Track_ID : 0|8@1+ (1,0) [0|255] "" HAD
 SG_ FC_Obj18_Valid : 8|2@1+ (1,0) [0|2] "" HAD
 SG_ FC_Obj18_Track_Age : 16|16@1+ (1,0) [0|65535] "" HAD
 SG_ FC_Obj18_Confidence : 257|7@1+ (1,0) [0|100] "%" HAD
 SG_ FC_Obj18_MotionCategory : 10|4@1+ (1,0) [0|13] "" HAD
 SG_ FC_Obj18_MotionType : 32|3@1+ (1,0) [0|7] "" HAD
 SG_ FC_Obj18_MeasureStatus : 35|3@1+ (1,0) [0|7] "" HAD
 SG_ FC_Obj18_Class : 38|3@1+ (1,0) [0|7] "" HAD
 SG_ FC_Obj18_VehSubType : 41|3@1+ (1,0) [0|7] "" HAD
 SG_ FC_Obj18_PedSubType : 44|2@1+ (1,0) [0|3] "" HAD
 SG_ FC_Obj18_LaneAssignment : 46|3@1+ (1,0) [0|5] "" HAD
 SG_ FC_Obj18_Height : 49|9@1+ (0.02,0) [0|10.24] "m" HAD
 SG_ FC_Obj18_Height_Vnce : 58|9@1+ (0.02,0) [0|10.24] "m" HAD
 SG_ FC_Obj18_Length : 67|9@1+ (0.05,0) [0|25.6] "m" HAD
 SG_ FC_Obj18_Length_Vnce : 76|9@1+ (0.05,0) [0|25.6] "m" HAD
 SG_ FC_Obj18_Width : 85|9@1+ (0.02,0) [0|10.24] "m" HAD
 SG_ FC_Obj18_Width_Vnce : 94|9@1+ (0.02,0) [0|10.24] "m" HAD
 SG_ FC_Obj18_TurnLight : 103|3@1+ (1,0) [0|4] "" HAD
 SG_ FC_Obj18_Brakelight_Info : 106|1@1+ (1,0) [0|1] "" HAD
 SG_ FC_Obj18_TTC : 107|10@1+ (0.01,0) [0|10] "sec" HAD
 SG_ FC_Obj18_Dx : 117|13@1+ (0.0625,-250) [-250|250] "m" HAD
 SG_ FC_Obj18_Dx_STD : 130|13@1+ (0.0625,0) [0|250] "m" HAD
 SG_ FC_Obj18_Dy : 143|13@1+ (0.0625,-250) [-250|250] "m" HAD
 SG_ FC_Obj18_Dy_STD : 156|13@1+ (0.0625,0) [0|250] "m" HAD
 SG_ FC_Obj18_RelVx : 169|12@1+ (0.05,-102.4) [-102.4|102.35] "m/s" HAD
 SG_ FC_Obj18_RelVx_STD : 181|12@1+ (0.05,0) [0|102.35] "m/s" HAD
 SG_ FC_Obj18_RelVy : 193|12@1+ (0.05,-50) [-50|50] "m/s" HAD
 SG_ FC_Obj18_RelVy_STD : 205|12@1+ (0.05,0) [0|50] "m/s" HAD
 SG_ FC_Obj18_RelAx : 217|10@1+ (0.03,-14.97) [-14.97|14.97] "m/s2" HAD
 SG_ FC_Obj18_RelAx_STD : 227|10@1+ (0.03,0) [0|14.97] "m/s2" HAD
 SG_ FC_Obj18_RelAy : 237|10@1+ (0.03,-14.97) [-14.97|14.97] "m/s2" HAD
 SG_ FC_Obj18_RelAy_STD : 247|10@1+ (0.03,0) [0|14.97] "m/s2" HAD
 SG_ FC_Obj18_HeadingAngle : 264|16@1+ (0.01,-327.68) [-327.68|327.67] "degree" HAD
 SG_ FC_Obj18_HeadingAngle_Vnce : 280|16@1+ (0.01,0) [0|327.67] "degree" HAD
 SG_ FC_Obj18_WorldinfoYaw : 296|16@1+ (0.01,-327.68) [-327.68|327.67] "degree" HAD
 SG_ FC_Obj18_WorldinfoYaw_Vnce : 312|16@1+ (0.01,0) [0|327.67] "degree" HAD
 SG_ FC_Obj18_AbsVx : 328|12@1+ (0.05,-102.4) [-102.4|102.35] "m/s" HAD
 SG_ FC_Obj18_AbsVy : 340|12@1+ (0.05,-50) [-50|50] "m/s" HAD
 SG_ FC_Obj18_CutInFlag : 352|2@1+ (1,0) [0|2] "" HAD
 SG_ FC_Obj18_CornerPoint_x : 354|13@1+ (0.0625,-250) [-250|250] "m" HAD
 SG_ FC_Obj18_CornerPoint_y : 368|13@1+ (0.0625,-250) [-250|250] "m" HAD
 SG_ FC_Obj18_CutInLane : 384|13@1+ (0.01,-40.96) [-40.96|40.95] "m" HAD
 SG_ FC_Obj18_DistInLane : 400|11@1+ (0.01,-10) [-10|10] "" HAD
 SG_ FC_RollingCounter_461 : 411|4@1+ (1,0) [0|15] "" HAD
 SG_ FC_CRCChecksum_461 : 416|16@1+ (1,0) [0|65535] "" HAD

BO_ 1122 FCM_OD_19: 64 FC
 SG_ FC_Obj19_Track_ID : 0|8@1+ (1,0) [0|255] "" HAD
 SG_ FC_Obj19_Valid : 8|2@1+ (1,0) [0|2] "" HAD
 SG_ FC_Obj19_Track_Age : 16|16@1+ (1,0) [0|65535] "" HAD
 SG_ FC_Obj19_Confidence : 257|7@1+ (1,0) [0|100] "%" HAD
 SG_ FC_Obj19_MotionCategory : 10|4@1+ (1,0) [0|13] "" HAD
 SG_ FC_Obj19_MotionType : 32|3@1+ (1,0) [0|7] "" HAD
 SG_ FC_Obj19_MeasureStatus : 35|3@1+ (1,0) [0|7] "" HAD
 SG_ FC_Obj19_Class : 38|3@1+ (1,0) [0|7] "" HAD
 SG_ FC_Obj19_VehSubType : 41|3@1+ (1,0) [0|7] "" HAD
 SG_ FC_Obj19_PedSubType : 44|2@1+ (1,0) [0|3] "" HAD
 SG_ FC_Obj19_LaneAssignment : 46|3@1+ (1,0) [0|5] "" HAD
 SG_ FC_Obj19_Height : 49|9@1+ (0.02,0) [0|10.24] "m" HAD
 SG_ FC_Obj19_Height_Vnce : 58|9@1+ (0.02,0) [0|10.24] "m" HAD
 SG_ FC_Obj19_Length : 67|9@1+ (0.05,0) [0|25.6] "m" HAD
 SG_ FC_Obj19_Length_Vnce : 76|9@1+ (0.05,0) [0|25.6] "m" HAD
 SG_ FC_Obj19_Width : 85|9@1+ (0.02,0) [0|10.24] "m" HAD
 SG_ FC_Obj19_Width_Vnce : 94|9@1+ (0.02,0) [0|10.24] "m" HAD
 SG_ FC_Obj19_TurnLight : 103|3@1+ (1,0) [0|4] "" HAD
 SG_ FC_Obj19_Brakelight_Info : 106|1@1+ (1,0) [0|1] "" HAD
 SG_ FC_Obj19_TTC : 107|10@1+ (0.01,0) [0|10] "sec" HAD
 SG_ FC_Obj19_Dx : 117|13@1+ (0.0625,-250) [-250|250] "m" HAD
 SG_ FC_Obj19_Dx_STD : 130|13@1+ (0.0625,0) [0|250] "m" HAD
 SG_ FC_Obj19_Dy : 143|13@1+ (0.0625,-250) [-250|250] "m" HAD
 SG_ FC_Obj19_Dy_STD : 156|13@1+ (0.0625,0) [0|250] "m" HAD
 SG_ FC_Obj19_RelVx : 169|12@1+ (0.05,-102.4) [-102.4|102.35] "m/s" HAD
 SG_ FC_Obj19_RelVx_STD : 181|12@1+ (0.05,0) [0|102.35] "m/s" HAD
 SG_ FC_Obj19_RelVy : 193|12@1+ (0.05,-50) [-50|50] "m/s" HAD
 SG_ FC_Obj19_RelVy_STD : 205|12@1+ (0.05,0) [0|50] "m/s" HAD
 SG_ FC_Obj19_RelAx : 217|10@1+ (0.03,-14.97) [-14.97|14.97] "m/s2" HAD
 SG_ FC_Obj19_RelAx_STD : 227|10@1+ (0.03,0) [0|14.97] "m/s2" HAD
 SG_ FC_Obj19_RelAy : 237|10@1+ (0.03,-14.97) [-14.97|14.97] "m/s2" HAD
 SG_ FC_Obj19_RelAy_STD : 247|10@1+ (0.03,0) [0|14.97] "m/s2" HAD
 SG_ FC_Obj19_HeadingAngle : 264|16@1+ (0.01,-327.68) [-327.68|327.67] "degree" HAD
 SG_ FC_Obj19_HeadingAngle_Vnce : 280|16@1+ (0.01,0) [0|327.67] "degree" HAD
 SG_ FC_Obj19_WorldinfoYaw : 296|16@1+ (0.01,-327.68) [-327.68|327.67] "degree" HAD
 SG_ FC_Obj19_WorldinfoYaw_Vnce : 312|16@1+ (0.01,0) [0|327.67] "degree" HAD
 SG_ FC_Obj19_AbsVx : 328|12@1+ (0.05,-102.4) [-102.4|102.35] "m/s" HAD
 SG_ FC_Obj19_AbsVy : 340|12@1+ (0.05,-50) [-50|50] "m/s" HAD
 SG_ FC_Obj19_CutInFlag : 352|2@1+ (1,0) [0|2] "" HAD
 SG_ FC_Obj19_CornerPoint_x : 354|13@1+ (0.0625,-250) [-250|250] "m" HAD
 SG_ FC_Obj19_CornerPoint_y : 368|13@1+ (0.0625,-250) [-250|250] "m" HAD
 SG_ FC_Obj19_CutInLane : 384|13@1+ (0.01,-40.96) [-40.96|40.95] "m" HAD
 SG_ FC_Obj19_DistInLane : 400|11@1+ (0.01,-10) [-10|10] "" HAD
 SG_ FC_RollingCounter_462 : 411|4@1+ (1,0) [0|15] "" HAD
 SG_ FC_CRCChecksum_462 : 416|16@1+ (1,0) [0|65535] "" HAD

BO_ 1123 FCM_OD_20: 64 FC
 SG_ FC_Obj20_Track_ID : 0|8@1+ (1,0) [0|255] "" HAD
 SG_ FC_Obj20_Valid : 8|2@1+ (1,0) [0|2] "" HAD
 SG_ FC_Obj20_Track_Age : 16|16@1+ (1,0) [0|65535] "" HAD
 SG_ FC_Obj20_Confidence : 257|7@1+ (1,0) [0|100] "%" HAD
 SG_ FC_Obj20_MotionCategory : 10|4@1+ (1,0) [0|13] "" HAD
 SG_ FC_Obj20_MotionType : 32|3@1+ (1,0) [0|7] "" HAD
 SG_ FC_Obj20_MeasureStatus : 35|3@1+ (1,0) [0|7] "" HAD
 SG_ FC_Obj20_Class : 38|3@1+ (1,0) [0|7] "" HAD
 SG_ FC_Obj20_VehSubType : 41|3@1+ (1,0) [0|7] "" HAD
 SG_ FC_Obj20_PedSubType : 44|2@1+ (1,0) [0|3] "" HAD
 SG_ FC_Obj20_LaneAssignment : 46|3@1+ (1,0) [0|5] "" HAD
 SG_ FC_Obj20_Height : 49|9@1+ (0.02,0) [0|10.24] "m" HAD
 SG_ FC_Obj20_Height_Vnce : 58|9@1+ (0.02,0) [0|10.24] "m" HAD
 SG_ FC_Obj20_Length : 67|9@1+ (0.05,0) [0|25.6] "m" HAD
 SG_ FC_Obj20_Length_Vnce : 76|9@1+ (0.05,0) [0|25.6] "m" HAD
 SG_ FC_Obj20_Width : 85|9@1+ (0.02,0) [0|10.24] "m" HAD
 SG_ FC_Obj20_Width_Vnce : 94|9@1+ (0.02,0) [0|10.24] "m" HAD
 SG_ FC_Obj20_TurnLight : 103|3@1+ (1,0) [0|4] "" HAD
 SG_ FC_Obj20_Brakelight_Info : 106|1@1+ (1,0) [0|1] "" HAD
 SG_ FC_Obj20_TTC : 107|10@1+ (0.01,0) [0|10] "sec" HAD
 SG_ FC_Obj20_Dx : 117|13@1+ (0.0625,-250) [-250|250] "m" HAD
 SG_ FC_Obj20_Dx_STD : 130|13@1+ (0.0625,0) [0|250] "m" HAD
 SG_ FC_Obj20_Dy : 143|13@1+ (0.0625,-250) [-250|250] "m" HAD
 SG_ FC_Obj20_Dy_STD : 156|13@1+ (0.0625,0) [0|250] "m" HAD
 SG_ FC_Obj20_RelVx : 169|12@1+ (0.05,-102.4) [-102.4|102.35] "m/s" HAD
 SG_ FC_Obj20_RelVx_STD : 181|12@1+ (0.05,0) [0|102.35] "m/s" HAD
 SG_ FC_Obj20_RelVy : 193|12@1+ (0.05,-50) [-50|50] "m/s" HAD
 SG_ FC_Obj20_RelVy_STD : 205|12@1+ (0.05,0) [0|50] "m/s" HAD
 SG_ FC_Obj20_RelAx : 217|10@1+ (0.03,-14.97) [-14.97|14.97] "m/s2" HAD
 SG_ FC_Obj20_RelAx_STD : 227|10@1+ (0.03,0) [0|14.97] "m/s2" HAD
 SG_ FC_Obj20_RelAy : 237|10@1+ (0.03,-14.97) [-14.97|14.97] "m/s2" HAD
 SG_ FC_Obj20_RelAy_STD : 247|10@1+ (0.03,0) [0|14.97] "m/s2" HAD
 SG_ FC_Obj20_HeadingAngle : 264|16@1+ (0.01,-327.68) [-327.68|327.67] "degree" HAD
 SG_ FC_Obj20_HeadingAngle_Vnce : 280|16@1+ (0.01,0) [0|327.67] "degree" HAD
 SG_ FC_Obj20_WorldinfoYaw : 296|16@1+ (0.01,-327.68) [-327.68|327.67] "degree" HAD
 SG_ FC_Obj20_WorldinfoYaw_Vnce : 312|16@1+ (0.01,0) [0|327.67] "degree" HAD
 SG_ FC_Obj20_AbsVx : 328|12@1+ (0.05,-102.4) [-102.4|102.35] "m/s" HAD
 SG_ FC_Obj20_AbsVy : 340|12@1+ (0.05,-50) [-50|50] "m/s" HAD
 SG_ FC_Obj20_CutInFlag : 352|2@1+ (1,0) [0|2] "" HAD
 SG_ FC_Obj20_CornerPoint_x : 354|13@1+ (0.0625,-250) [-250|250] "m" HAD
 SG_ FC_Obj20_CornerPoint_y : 368|13@1+ (0.0625,-250) [-250|250] "m" HAD
 SG_ FC_Obj20_CutInLane : 384|13@1+ (0.01,-40.96) [-40.96|40.95] "m" HAD
 SG_ FC_Obj20_DistInLane : 400|11@1+ (0.01,-10) [-10|10] "" HAD
 SG_ FC_RollingCounter_463 : 411|4@1+ (1,0) [0|15] "" HAD
 SG_ FC_CRCChecksum_463 : 416|16@1+ (1,0) [0|65535] "" HAD

BO_ 1136 FCM_LD_1: 64 FC
 SG_ FC_Line1_ID : 0|16@1+ (1,0) [0|65535] "" HAD
 SG_ FC_Line1_Confidence : 16|7@1+ (1,0) [0|100] "%" HAD
 SG_ FC_Line1_MeasureStauts : 24|3@1+ (1,0) [0|7] "" HAD
 SG_ FC_Line1_Type : 27|4@1+ (1,0) [0|15] "" HAD
 SG_ FC_Line1_color : 32|2@1+ (1,0) [0|3] "" HAD
 SG_ FC_Line1_Width : 34|7@1+ (0.01,0) [0|1] "m" HAD
 SG_ FC_Line1_dx_Start : 41|11@1+ (0.1,0) [0|200] "m" HAD
 SG_ FC_Line1_dx_End : 52|11@1+ (0.1,0) [0|200] "m" HAD
 SG_ FC_Line1_ModelC0 : 64|11@1+ (0.01,0) [-10|10] "m" HAD
 SG_ FC_Line1_ModelC1 : 75|11@1+ (0.0009765625,0) [-1|0.9990234375] "rad" HAD
 SG_ FC_Line1_ModelC2 : 88|16@1+ (9.77E-007,0) [-0.032|0.032] "1/m" HAD
 SG_ FC_Line1_ModelC3 : 104|17@1+ (3.7252902985E-009,0) [-0.000244140625002496|0.000244136899712198] "1/m2" HAD
 SG_ FC_Line1_ParseConf : 121|7@1+ (1,0) [0|100] "%" HAD
 SG_ FC_Line2_ID : 128|16@1+ (1,0) [0|65535] "" HAD
 SG_ FC_Line2_Confidence : 144|7@1+ (1,0) [0|100] "%" HAD
 SG_ FC_Line2_MeasureStauts : 152|3@1+ (1,0) [0|7] "" HAD
 SG_ FC_Line2_Type : 155|4@1+ (1,0) [0|15] "" HAD
 SG_ FC_Line2_color : 160|2@1+ (1,0) [0|3] "" HAD
 SG_ FC_Line2_Width : 162|7@1+ (0.01,0) [0|1] "m" HAD
 SG_ FC_Line2_dx_Start : 169|11@1+ (0.1,0) [0|200] "m" HAD
 SG_ FC_Line2_dx_End : 180|11@1+ (0.1,0) [0|200] "m" HAD
 SG_ FC_Line2_ModelC0 : 191|11@1+ (0.01,0) [-10|10] "m" HAD
 SG_ FC_Line2_ModelC1 : 202|11@1+ (0.0009765625,0) [-1|0.9990234375] "rad" HAD
 SG_ FC_Line2_ModelC2 : 216|16@1+ (9.77E-007,0) [-0.032|0.032] "1/m" HAD
 SG_ FC_Line2_ModelC3 : 232|17@1+ (3.7252902985E-009,0) [-0.000244140625002496|0.000244136899712198] "1/m2" HAD
 SG_ FC_Line2_ParseConf : 249|7@1+ (1,0) [0|100] "%" HAD
 SG_ FC_RollingCounter_470 : 256|4@1+ (1,0) [0|15] "" HAD
 SG_ FC_CRCChecksum_470 : 264|16@1+ (1,0) [0|65535] "" HAD

BO_ 1137 FCM_LD_2: 64 FC
 SG_ FC_Line3_ID : 0|16@1+ (1,0) [0|65535] "" HAD
 SG_ FC_Line3_Confidence : 16|7@1+ (1,0) [0|100] "%" HAD
 SG_ FC_Line3_MeasureStauts : 24|3@1+ (1,0) [0|7] "" HAD
 SG_ FC_Line3_Type : 27|4@1+ (1,0) [0|15] "" HAD
 SG_ FC_Line3_color : 32|2@1+ (1,0) [0|3] "" HAD
 SG_ FC_Line3_Width : 34|7@1+ (0.01,0) [0|1] "m" HAD
 SG_ FC_Line3_dx_Start : 41|11@1+ (0.1,0) [0|200] "m" HAD
 SG_ FC_Line3_dx_End : 52|11@1+ (0.1,0) [0|200] "m" HAD
 SG_ FC_Line3_ModelC0 : 64|11@1+ (0.01,0) [-10|10] "m" HAD
 SG_ FC_Line3_ModelC1 : 75|11@1+ (0.0009765625,0) [-1|0.9990234375] "rad" HAD
 SG_ FC_Line3_ModelC2 : 88|16@1+ (9.77E-007,0) [-0.032|0.032] "1/m" HAD
 SG_ FC_Line3_ModelC3 : 104|17@1+ (3.7252902985E-009,0) [-0.000244140625002496|0.000244136899712198] "1/m2" HAD
 SG_ FC_Line3_ParseConf : 121|7@1+ (1,0) [0|100] "%" HAD
 SG_ FC_Line4_ID : 128|16@1+ (1,0) [0|65535] "" HAD
 SG_ FC_Line4_Confidence : 144|7@1+ (1,0) [0|100] "%" HAD
 SG_ FC_Line4_MeasureStauts : 152|3@1+ (1,0) [0|7] "" HAD
 SG_ FC_Line4_Type : 155|4@1+ (1,0) [0|15] "" HAD
 SG_ FC_Line4_color : 160|2@1+ (1,0) [0|3] "" HAD
 SG_ FC_Line4_Width : 162|7@1+ (0.01,0) [0|1] "m" HAD
 SG_ FC_Line4_dx_Start : 169|11@1+ (0.1,0) [0|200] "m" HAD
 SG_ FC_Line4_dx_End : 180|11@1+ (0.1,0) [0|200] "m" HAD
 SG_ FC_Line4_ModelC0 : 191|11@1+ (0.01,0) [-10|10] "m" HAD
 SG_ FC_Line4_ModelC1 : 202|11@1+ (0.0009765625,0) [-1|0.9990234375] "rad" HAD
 SG_ FC_Line4_ModelC2 : 216|16@1+ (9.77E-007,0) [-0.032|0.032] "1/m" HAD
 SG_ FC_Line4_ModelC3 : 232|17@1+ (3.7252902985E-009,0) [-0.000244140625002496|0.000244136899712198] "1/m2" HAD
 SG_ FC_Line4_ParseConf : 249|7@1+ (1,0) [0|100] "%" HAD
 SG_ FC_RollingCounter_471 : 256|4@1+ (1,0) [0|15] "" HAD
 SG_ FC_CRCChecksum_471 : 264|16@1+ (1,0) [0|65535] "" HAD

BO_ 1138 FCM_LD_3: 64 FC
 SG_ FC_Line5_ID : 0|16@1+ (1,0) [0|65535] "" HAD
 SG_ FC_Line5_Confidence : 16|7@1+ (1,0) [0|100] "%" HAD
 SG_ FC_Line5_MeasureStauts : 24|3@1+ (1,0) [0|7] "" HAD
 SG_ FC_Line5_Type : 27|4@1+ (1,0) [0|15] "" HAD
 SG_ FC_Line5_color : 32|2@1+ (1,0) [0|3] "" HAD
 SG_ FC_Line5_dx_Start : 41|11@1+ (0.1,0) [0|200] "m" HAD
 SG_ FC_Line5_dx_End : 52|11@1+ (0.1,0) [0|200] "m" HAD
 SG_ FC_Line5_ModelC0 : 64|11@1+ (0.01,0) [-10|10] "m" HAD
 SG_ FC_Line5_ModelC1 : 75|11@1+ (0.0009765625,0) [-1|0.9990234375] "rad" HAD
 SG_ FC_Line5_ModelC2 : 88|16@1+ (9.77E-007,0) [-0.032|0.032] "1/m" HAD
 SG_ FC_Line5_ModelC3 : 104|17@1+ (3.7252902985E-009,0) [-0.000244140625002496|0.000244136899712198] "1/m2" HAD
 SG_ FC_Line5_ParseConf : 121|7@1+ (1,0) [0|100] "%" HAD
 SG_ FC_Line6_ID : 128|16@1+ (1,0) [0|65535] "" HAD
 SG_ FC_Line6_Confidence : 144|7@1+ (1,0) [0|100] "%" HAD
 SG_ FC_Line6_MeasureStauts : 152|3@1+ (1,0) [0|7] "" HAD
 SG_ FC_Line6_Type : 155|4@1+ (1,0) [0|15] "" HAD
 SG_ FC_Line6_color : 160|2@1+ (1,0) [0|3] "" HAD
 SG_ FC_Line6_dx_Start : 169|11@1+ (0.1,0) [0|200] "m" HAD
 SG_ FC_Line6_dx_End : 180|11@1+ (0.1,0) [0|200] "m" HAD
 SG_ FC_Line6_ModelC0 : 191|11@1+ (0.01,0) [-10|10] "m" HAD
 SG_ FC_Line6_ModelC1 : 202|11@1+ (0.0009765625,0) [-1|0.9990234375] "rad" HAD
 SG_ FC_Line6_ModelC2 : 216|16@1+ (9.77E-007,0) [-0.032|0.032] "1/m" HAD
 SG_ FC_Line6_ModelC3 : 232|17@1+ (3.7252902985E-009,0) [-0.000244140625002496|0.000244136899712198] "1/m2" HAD
 SG_ FC_Line6_ParseConf : 249|7@1+ (1,0) [0|100] "%" HAD
 SG_ FC_RollingCounter_472 : 256|4@1+ (1,0) [0|15] "" HAD
 SG_ FC_CRCChecksum_472 : 264|16@1+ (1,0) [0|65535] "" HAD

BO_ 1168 FCM_TFLTSR_1: 64 FC
 SG_ FC_RoadType : 0|3@1+ (1,0) [0|7] "" HAD
 SG_ FC_WeatherType : 3|3@1+ (1,0) [0|7] "" HAD
 SG_ FC_RollingCounter_490 : 304|4@1+ (1,0) [0|15] "" HAD
 SG_ FC_CRCChecksum_490 : 312|16@1+ (1,0) [0|65535] "" HAD

BO_ 1172 FCM_IHBC_ISA_TSR: 64 FC
 SG_ FC_IHBC_Decision : 0|1@1+ (1,0) [0|1] "" HAD
 SG_ FC_VisionOnlySign_Type : 1|5@1+ (1,0) [0|19] "" HAD
 SG_ FC_ISA_Value : 6|5@1+ (1,0) [0|19] "" HAD
 SG_ FC_ISA_Sign_Type : 11|2@1+ (1,0) [0|3] "" HAD
 SG_ FC_ISA_Popup_text : 13|2@1+ (1,0) [0|3] "" HAD
 SG_ FC_SpeedLimitType : 16|3@1+ (1,0) [0|7] "" HAD
 SG_ FC_TSRHostSpdLimitUnits : 19|2@1+ (1,0) [0|3] "" HAD
 SG_ FC_TSRMandatorySign : 21|4@1+ (1,0) [0|15] "" HAD
 SG_ FC_TSRProhibitionSign : 25|4@1+ (1,0) [0|15] "" HAD
 SG_ FC_TSRWarningSign : 32|4@1+ (1,0) [0|15] "" HAD
 SG_ FC_StopLine_Detected : 36|1@1+ (1,0) [0|1] "" HAD
 SG_ FC_StopLine_Dist : 37|10@1+ (0.1,0) [0|102.3] "m" HAD
 SG_ FC_Crosswalk_Detect : 47|1@1+ (1,0) [0|1] "" HAD
 SG_ FC_Crosswalk_Dist : 48|10@1+ (0.1,0) [0|102.3] "m" HAD
 SG_ FC_SpeedBump_Detect : 58|1@1+ (1,0) [0|1] "" HAD
 SG_ FC_SpeedBump_Dist : 59|10@1+ (0.1,0) [0|102.3] "m" HAD
 SG_ FC_RollingCounter_494 : 72|4@1+ (1,0) [0|15] "" HAD
 SG_ FC_CRCChecksum_494 : 80|16@1+ (1,0) [0|65535] "" HAD

BO_ 1173 FCM_FailSafe: 64 FC
 SG_ FC_CameraCalibrationStatus : 0|2@1+ (1,0) [0|3] "" HAD
 SG_ FC_CameraFailureStatus : 2|3@1+ (1,0) [0|7] "" HAD
 SG_ FC_FrameID : 16|32@1+ (1,0) [0|4294967295] "" HAD
 SG_ FC_TiStamp : 48|32@1+ (0.0001,0) [0|429496.7295] "s" HAD
 SG_ FC_TiBas : 80|1@1+ (1,0) [0|1] "" HAD
 SG_ FC_TiLeap : 81|1@1+ (1,0) [0|1] "" HAD
 SG_ FC_TiOut : 82|1@1+ (1,0) [0|1] "" HAD
 SG_ FC_MCUTiStamp : 88|8@1+ (1,0) [0|255] "um" HAD
 SG_ FC_RollingCounter_495 : 96|4@1+ (1,0) [0|15] "" HAD
 SG_ FC_CRCChecksum_495 : 104|16@1+ (1,0) [0|65535] "" HAD

BO_ 1139 FCM_CB_1: 64 FC
 SG_ FC_StaticObj1_Type : 0|3@1+ (1,0) [0|7] "" HAD
 SG_ FC_StaticObj2_Type : 3|3@1+ (1,0) [0|7] "" HAD
 SG_ FC_StaticObj3_Type : 6|3@1+ (1,0) [0|7] "" HAD
 SG_ FC_StaticObj4_Type : 9|3@1+ (1,0) [0|7] "" HAD
 SG_ FC_StaticObj5_Type : 12|3@1+ (1,0) [0|7] "" HAD
 SG_ FC_StaticObj6_Type : 15|3@1+ (1,0) [0|7] "" HAD
 SG_ FC_StaticObj7_Type : 18|3@1+ (1,0) [0|7] "" HAD
 SG_ FC_StaticObj8_Type : 21|3@1+ (1,0) [0|7] "" HAD
 SG_ FC_StaticObj9_Type : 24|3@1+ (1,0) [0|7] "" HAD
 SG_ FC_StaticObj10_Type : 27|3@1+ (1,0) [0|7] "" HAD
 SG_ FC_StaticObj11_Type : 30|3@1+ (1,0) [0|7] "" HAD
 SG_ FC_StaticObj12_Type : 33|3@1+ (1,0) [0|7] "" HAD
 SG_ FC_StaticObj13_Type : 36|3@1+ (1,0) [0|7] "" HAD
 SG_ FC_StaticObj14_Type : 39|3@1+ (1,0) [0|7] "" HAD
 SG_ FC_StaticObj15_Type : 42|3@1+ (1,0) [0|7] "" HAD
 SG_ FC_StaticObj16_Type : 45|3@1+ (1,0) [0|7] "" HAD
 SG_ FC_StaticObj17_Type : 48|3@1+ (1,0) [0|7] "" HAD
 SG_ FC_StaticObj18_Type : 51|3@1+ (1,0) [0|7] "" HAD
 SG_ FC_StaticObj19_Type : 54|3@1+ (1,0) [0|7] "" HAD
 SG_ FC_StaticObj20_Type : 57|3@1+ (1,0) [0|7] "" HAD
 SG_ FC_StaticObj1_Dx : 60|10@1+ (0.2,0) [0|204.6] "m" HAD
 SG_ FC_StaticObj2_Dx : 70|10@1+ (0.2,0) [0|204.6] "m" HAD
 SG_ FC_StaticObj3_Dx : 80|10@1+ (0.2,0) [0|204.6] "m" HAD
 SG_ FC_StaticObj4_Dx : 90|10@1+ (0.2,0) [0|204.6] "m" HAD
 SG_ FC_StaticObj5_Dx : 100|10@1+ (0.2,0) [0|204.6] "m" HAD
 SG_ FC_StaticObj6_Dx : 110|10@1+ (0.2,0) [0|204.6] "m" HAD
 SG_ FC_StaticObj7_Dx : 120|10@1+ (0.2,0) [0|204.6] "m" HAD
 SG_ FC_StaticObj8_Dx : 130|10@1+ (0.2,0) [0|204.6] "m" HAD
 SG_ FC_StaticObj9_Dx : 140|10@1+ (0.2,0) [0|204.6] "m" HAD
 SG_ FC_StaticObj10_Dx : 150|10@1+ (0.2,0) [0|204.6] "m" HAD
 SG_ FC_StaticObj11_Dx : 160|10@1+ (0.2,0) [0|204.6] "m" HAD
 SG_ FC_StaticObj12_Dx : 170|10@1+ (0.2,0) [0|204.6] "m" HAD
 SG_ FC_StaticObj13_Dx : 180|10@1+ (0.2,0) [0|204.6] "m" HAD
 SG_ FC_StaticObj14_Dx : 190|10@1+ (0.2,0) [0|204.6] "m" HAD
 SG_ FC_StaticObj15_Dx : 200|10@1+ (0.2,0) [0|204.6] "m" HAD
 SG_ FC_StaticObj16_Dx : 210|10@1+ (0.2,0) [0|204.6] "m" HAD
 SG_ FC_StaticObj17_Dx : 220|10@1+ (0.2,0) [0|204.6] "m" HAD
 SG_ FC_StaticObj18_Dx : 230|10@1+ (0.2,0) [0|204.6] "m" HAD
 SG_ FC_StaticObj19_Dx : 240|10@1+ (0.2,0) [0|204.6] "m" HAD
 SG_ FC_StaticObj20_Dx : 250|10@1+ (0.2,0) [0|204.6] "m" HAD
 SG_ FC_StaticObj1_Dy : 260|11@1+ (0.05,-51) [-51|51.35] "m" HAD
 SG_ FC_StaticObj2_Dy : 271|11@1+ (0.05,-51) [-51|51.35] "m" HAD
 SG_ FC_StaticObj3_Dy : 282|11@1+ (0.05,-51) [-51|51.35] "m" HAD
 SG_ FC_StaticObj4_Dy : 293|11@1+ (0.05,-51) [-51|51.35] "m" HAD
 SG_ FC_StaticObj5_Dy : 304|11@1+ (0.05,-51) [-51|51.35] "m" HAD
 SG_ FC_StaticObj6_Dy : 315|11@1+ (0.05,-51) [-51|51.35] "m" HAD
 SG_ FC_StaticObj7_Dy : 326|11@1+ (0.05,-51) [-51|51.35] "m" HAD
 SG_ FC_StaticObj8_Dy : 337|11@1+ (0.05,-51) [-51|51.35] "m" HAD
 SG_ FC_StaticObj9_Dy : 348|11@1+ (0.05,-51) [-51|51.35] "m" HAD
 SG_ FC_StaticObj10_Dy : 359|11@1+ (0.05,-51) [-51|51.35] "m" HAD
 SG_ FC_StaticObj11_Dy : 370|11@1+ (0.05,-51) [-51|51.35] "m" HAD
 SG_ FC_StaticObj12_Dy : 381|11@1+ (0.05,-51) [-51|51.35] "m" HAD
 SG_ FC_StaticObj13_Dy : 392|11@1+ (0.05,-51) [-51|51.35] "m" HAD
 SG_ FC_StaticObj14_Dy : 403|11@1+ (0.05,-51) [-51|51.35] "m" HAD
 SG_ FC_StaticObj15_Dy : 414|11@1+ (0.05,-51) [-51|51.35] "m" HAD
 SG_ FC_StaticObj16_Dy : 425|11@1+ (0.05,-51) [-51|51.35] "m" HAD
 SG_ FC_StaticObj17_Dy : 436|11@1+ (0.05,-51) [-51|51.35] "m" HAD
 SG_ FC_StaticObj18_Dy : 447|11@1+ (0.05,-51) [-51|51.35] "m" HAD
 SG_ FC_StaticObj19_Dy : 458|11@1+ (0.05,-51) [-51|51.35] "m" HAD
 SG_ FC_StaticObj20_Dy : 469|11@1+ (0.05,-51) [-51|51.35] "m" HAD
 SG_ FC_RollingCounter_473 : 480|4@1+ (1,0) [0|15] "" HAD
 SG_ FC_CRCChecksum_473 : 488|16@1+ (1,0) [0|65535] "" HAD

CM_ BO_ 1152  "freespace1";
CM_ BO_ 1153  "freespace22";
CM_ BO_ 1154  "freespace43";
CM_ BO_ 1155  "freespace1";
CM_ BO_ 1124  "CPIVID";
CM_ BO_ 1104  "1 ID";
CM_ BO_ 1105  "2 ID";
CM_ BO_ 1106  "3 ID";
CM_ BO_ 1107  "4 ID";
CM_ BO_ 1108  "5 ID";
CM_ BO_ 1109  "6 ID";
CM_ BO_ 1110  "7 ID";
CM_ BO_ 1111  "8 ID";
CM_ BO_ 1112  "9 ID";
CM_ BO_ 1113  "10 ID";
CM_ BO_ 1114  "11 ID";
CM_ BO_ 1115  "12 ID";
CM_ BO_ 1116  "13 ID";
CM_ BO_ 1117  "14 ID";
CM_ BO_ 1118  "15 ID";
CM_ BO_ 1119  "16 ID";
CM_ BO_ 1120  "17 ID";
CM_ BO_ 1121  "18 ID";
CM_ BO_ 1122  "19 ID";
CM_ BO_ 1123  "20 ID";
CM_ BO_ 1136  "1 ID";
CM_ BO_ 1137  "3 ID";
CM_ BO_ 1138  "5 ID";
CM_ BO_ 1172  "IHBC";
CM_ BO_ 1139  "1";

CM_ SG_ 1152 FC_lateral1 "freespace1";
CM_ SG_ 1152 FC_longitudinal1 "freespace1";
CM_ SG_ 1152 FC_lateral2 "freespace2";
CM_ SG_ 1152 FC_longitudinal2 "freespace2";
CM_ SG_ 1152 FC_lateral3 "freespace3";
CM_ SG_ 1152 FC_longitudinal3 "freespace3";
CM_ SG_ 1152 FC_lateral4 "freespace4";
CM_ SG_ 1152 FC_longitudinal4 "freespace4";
CM_ SG_ 1152 FC_lateral5 "freespace5";
CM_ SG_ 1152 FC_longitudinal5 "freespace5";
CM_ SG_ 1152 FC_lateral6 "freespace6";
CM_ SG_ 1152 FC_longitudinal6 "freespace6";
CM_ SG_ 1152 FC_lateral7 "freespace7";
CM_ SG_ 1152 FC_longitudinal7 "freespace7";
CM_ SG_ 1152 FC_lateral8 "freespace8";
CM_ SG_ 1152 FC_longitudinal8 "freespace8";
CM_ SG_ 1152 FC_lateral9 "freespace9";
CM_ SG_ 1152 FC_longitudinal9 "freespace9";
CM_ SG_ 1152 FC_lateral10 "freespace10";
CM_ SG_ 1152 FC_longitudinal10 "freespace10";
CM_ SG_ 1152 FC_lateral11 "freespace11";
CM_ SG_ 1152 FC_longitudinal11 "freespace11";
CM_ SG_ 1152 FC_lateral12 "freespace12";
CM_ SG_ 1152 FC_longitudinal12 "freespace12";
CM_ SG_ 1152 FC_lateral13 "freespace13";
CM_ SG_ 1152 FC_longitudinal13 "freespace13";
CM_ SG_ 1152 FC_lateral14 "freespace14";
CM_ SG_ 1152 FC_longitudinal14 "freespace14";
CM_ SG_ 1152 FC_lateral15 "freespace15";
CM_ SG_ 1152 FC_longitudinal15 "freespace15";
CM_ SG_ 1152 FC_lateral16 "freespace16";
CM_ SG_ 1152 FC_longitudinal16 "freespace16";
CM_ SG_ 1152 FC_lateral17 "freespace17";
CM_ SG_ 1152 FC_longitudinal17 "freespace17";
CM_ SG_ 1152 FC_lateral18 "freespace18";
CM_ SG_ 1152 FC_longitudinal18 "freespace18";
CM_ SG_ 1152 FC_lateral19 "freespace19";
CM_ SG_ 1152 FC_longitudinal19 "freespace19";
CM_ SG_ 1152 FC_lateral20 "freespace20";
CM_ SG_ 1152 FC_longitudinal20 "freespace20";
CM_ SG_ 1152 FC_lateral21 "freespace21";
CM_ SG_ 1152 FC_longitudinal21 "freespace21";
CM_ SG_ 1152 FC_RollingCounter_480 "481";
CM_ SG_ 1152 FC_CRCChecksum_480 "481";
CM_ SG_ 1153 FC_lateral22 "freespace22";
CM_ SG_ 1153 FC_longitudinal22 "freespace22";
CM_ SG_ 1153 FC_lateral23 "freespace23";
CM_ SG_ 1153 FC_longitudinal23 "freespace23";
CM_ SG_ 1153 FC_lateral24 "freespace24";
CM_ SG_ 1153 FC_longitudinal24 "freespace24";
CM_ SG_ 1153 FC_lateral25 "freespace25";
CM_ SG_ 1153 FC_longitudinal25 "freespace25";
CM_ SG_ 1153 FC_lateral26 "freespace26";
CM_ SG_ 1153 FC_longitudinal26 "freespace26";
CM_ SG_ 1153 FC_lateral27 "freespace27";
CM_ SG_ 1153 FC_longitudinal27 "freespace27";
CM_ SG_ 1153 FC_lateral28 "freespace28";
CM_ SG_ 1153 FC_longitudinal28 "freespace28";
CM_ SG_ 1153 FC_lateral29 "freespace29";
CM_ SG_ 1153 FC_longitudinal29 "freespace29";
CM_ SG_ 1153 FC_lateral30 "freespace30";
CM_ SG_ 1153 FC_longitudinal30 "freespace30";
CM_ SG_ 1153 FC_lateral31 "freespace31";
CM_ SG_ 1153 FC_longitudinal31 "freespace31";
CM_ SG_ 1153 FC_lateral32 "freespace32";
CM_ SG_ 1153 FC_longitudinal32 "freespace32";
CM_ SG_ 1153 FC_lateral33 "freespace33";
CM_ SG_ 1153 FC_longitudinal33 "freespace33";
CM_ SG_ 1153 FC_lateral34 "freespace34";
CM_ SG_ 1153 FC_longitudinal34 "freespace34";
CM_ SG_ 1153 FC_lateral35 "freespace35";
CM_ SG_ 1153 FC_longitudinal35 "freespace35";
CM_ SG_ 1153 FC_lateral36 "freespace36";
CM_ SG_ 1153 FC_longitudinal36 "freespace36";
CM_ SG_ 1153 FC_lateral37 "freespace37";
CM_ SG_ 1153 FC_longitudinal37 "freespace37";
CM_ SG_ 1153 FC_lateral38 "freespace38";
CM_ SG_ 1153 FC_longitudinal38 "freespace38";
CM_ SG_ 1153 FC_lateral39 "freespace39";
CM_ SG_ 1153 FC_longitudinal39 "freespace39";
CM_ SG_ 1153 FC_lateral40 "freespace40";
CM_ SG_ 1153 FC_longitudinal40 "freespace40";
CM_ SG_ 1153 FC_lateral41 "freespace41";
CM_ SG_ 1153 FC_longitudinal41 "freespace41";
CM_ SG_ 1153 FC_lateral42 "freespace42";
CM_ SG_ 1153 FC_longitudinal42 "freespace42";
CM_ SG_ 1153 FC_RollingCounter_481 "481";
CM_ SG_ 1153 FC_CRCChecksum_481 "481";
CM_ SG_ 1154 FC_lateral43 "freespace43";
CM_ SG_ 1154 FC_longitudinal43 "freespace43";
CM_ SG_ 1154 FC_lateral44 "freespace44";
CM_ SG_ 1154 FC_longitudinal44 "freespace44";
CM_ SG_ 1154 FC_lateral45 "freespace45";
CM_ SG_ 1154 FC_longitudinal45 "freespace45";
CM_ SG_ 1154 FC_lateral46 "freespace46";
CM_ SG_ 1154 FC_longitudinal46 "freespace46";
CM_ SG_ 1154 FC_lateral47 "freespace47";
CM_ SG_ 1154 FC_longitudinal47 "freespace47";
CM_ SG_ 1154 FC_lateral48 "freespace48";
CM_ SG_ 1154 FC_longitudinal48 "freespace48";
CM_ SG_ 1154 FC_lateral49 "freespace49";
CM_ SG_ 1154 FC_longitudinal49 "freespace49";
CM_ SG_ 1154 FC_lateral50 "freespace50";
CM_ SG_ 1154 FC_longitudinal50 "freespace50";
CM_ SG_ 1154 FC_lateral51 "freespace51";
CM_ SG_ 1154 FC_longitudinal51 "freespace51";
CM_ SG_ 1154 FC_lateral52 "freespace52";
CM_ SG_ 1154 FC_longitudinal52 "freespace52";
CM_ SG_ 1154 FC_lateral53 "freespace53";
CM_ SG_ 1154 FC_longitudinal53 "freespace53";
CM_ SG_ 1154 FC_lateral54 "freespace54";
CM_ SG_ 1154 FC_longitudinal54 "freespace54";
CM_ SG_ 1154 FC_lateral55 "freespace55";
CM_ SG_ 1154 FC_longitudinal55 "freespace55";
CM_ SG_ 1154 FC_lateral56 "freespace56";
CM_ SG_ 1154 FC_longitudinal56 "freespace56";
CM_ SG_ 1154 FC_lateral57 "freespace57";
CM_ SG_ 1154 FC_longitudinal57 "freespace57";
CM_ SG_ 1154 FC_lateral58 "freespace58";
CM_ SG_ 1154 FC_longitudinal58 "freespace58";
CM_ SG_ 1154 FC_lateral59 "freespace59";
CM_ SG_ 1154 FC_longitudinal59 "freespace59";
CM_ SG_ 1154 FC_lateral60 "freespace60";
CM_ SG_ 1154 FC_longitudinal60 "freespace60";
CM_ SG_ 1154 FC_lateral61 "freespace61";
CM_ SG_ 1154 FC_longitudinal61 "freespace61";
CM_ SG_ 1154 FC_lateral62 "freespace62";
CM_ SG_ 1154 FC_longitudinal62 "freespace62";
CM_ SG_ 1154 FC_lateral63 "freespace63";
CM_ SG_ 1154 FC_longitudinal63 "freespace63";
CM_ SG_ 1154 FC_lateral64 "freespace64";
CM_ SG_ 1154 FC_longitudinal64 "freespace64";
CM_ SG_ 1154 FC_RollingCounter_482 "482";
CM_ SG_ 1154 FC_CRCChecksum_482 "482";
CM_ SG_ 1155 FC_Type_Point1 "freespace1";
CM_ SG_ 1155 FC_Type_Point2 "freespace2";
CM_ SG_ 1155 FC_Type_Point3 "freespace3";
CM_ SG_ 1155 FC_Type_Point4 "freespace4";
CM_ SG_ 1155 FC_Type_Point5 "freespace5";
CM_ SG_ 1155 FC_Type_Point6 "freespace6";
CM_ SG_ 1155 FC_Type_Point7 "freespace7";
CM_ SG_ 1155 FC_Type_Point8 "freespace8";
CM_ SG_ 1155 FC_Type_Point9 "freespace9";
CM_ SG_ 1155 FC_Type_Point10 "freespace10";
CM_ SG_ 1155 FC_Type_Point11 "freespace11";
CM_ SG_ 1155 FC_Type_Point12 "freespace12";
CM_ SG_ 1155 FC_Type_Point13 "freespace13";
CM_ SG_ 1155 FC_Type_Point14 "freespace14";
CM_ SG_ 1155 FC_Type_Point15 "freespace15";
CM_ SG_ 1155 FC_Type_Point16 "freespace16";
CM_ SG_ 1155 FC_Type_Point17 "freespace17";
CM_ SG_ 1155 FC_Type_Point18 "freespace18";
CM_ SG_ 1155 FC_Type_Point19 "freespace19";
CM_ SG_ 1155 FC_Type_Point20 "freespace20";
CM_ SG_ 1155 FC_Type_Point21 "freespace21";
CM_ SG_ 1155 FC_Type_Point22 "freespace22";
CM_ SG_ 1155 FC_Type_Point23 "freespace23";
CM_ SG_ 1155 FC_Type_Point24 "freespace24";
CM_ SG_ 1155 FC_Type_Point25 "freespace25";
CM_ SG_ 1155 FC_Type_Point26 "freespace26";
CM_ SG_ 1155 FC_Type_Point27 "freespace27";
CM_ SG_ 1155 FC_Type_Point28 "freespace28";
CM_ SG_ 1155 FC_Type_Point29 "freespace29";
CM_ SG_ 1155 FC_Type_Point30 "freespace30";
CM_ SG_ 1155 FC_Type_Point31 "freespace31";
CM_ SG_ 1155 FC_Type_Point32 "freespace32";
CM_ SG_ 1155 FC_Type_Point33 "freespace33";
CM_ SG_ 1155 FC_Type_Point34 "freespace34";
CM_ SG_ 1155 FC_Type_Point35 "freespace35";
CM_ SG_ 1155 FC_Type_Point36 "freespace36";
CM_ SG_ 1155 FC_Type_Point37 "freespace37";
CM_ SG_ 1155 FC_Type_Point38 "freespace38";
CM_ SG_ 1155 FC_Type_Point39 "freespace39";
CM_ SG_ 1155 FC_Type_Point40 "freespace40";
CM_ SG_ 1155 FC_Type_Point41 "freespace41";
CM_ SG_ 1155 FC_Type_Point42 "freespace42";
CM_ SG_ 1155 FC_Type_Point43 "freespace43";
CM_ SG_ 1155 FC_Type_Point44 "freespace44";
CM_ SG_ 1155 FC_Type_Point45 "freespace45";
CM_ SG_ 1155 FC_Type_Point46 "freespace46";
CM_ SG_ 1155 FC_Type_Point47 "freespace47";
CM_ SG_ 1155 FC_Type_Point48 "freespace48";
CM_ SG_ 1155 FC_Type_Point49 "freespace49";
CM_ SG_ 1155 FC_Type_Point50 "freespace50";
CM_ SG_ 1155 FC_Type_Point51 "freespace51";
CM_ SG_ 1155 FC_Type_Point52 "freespace52";
CM_ SG_ 1155 FC_Type_Point53 "freespace53";
CM_ SG_ 1155 FC_Type_Point54 "freespace54";
CM_ SG_ 1155 FC_Type_Point55 "freespace55";
CM_ SG_ 1155 FC_Type_Point56 "freespace56";
CM_ SG_ 1155 FC_Type_Point57 "freespace57";
CM_ SG_ 1155 FC_Type_Point58 "freespace58";
CM_ SG_ 1155 FC_Type_Point59 "freespace59";
CM_ SG_ 1155 FC_Type_Point60 "freespace60";
CM_ SG_ 1155 FC_Type_Point61 "freespace61";
CM_ SG_ 1155 FC_Type_Point62 "freespace62";
CM_ SG_ 1155 FC_Type_Point63 "freespace63";
CM_ SG_ 1155 FC_Type_Point64 "freespace64";
CM_ SG_ 1155 FC_RollingCounter_483 "483";
CM_ SG_ 1155 FC_CRCChecksum_483 "483";
CM_ SG_ 1124 FC_CIPV_ID "CPIVID";
CM_ SG_ 1124 FC_CIPVFlag "CPIV";
CM_ SG_ 1124 FC_MCP_ID "MCPID";
CM_ SG_ 1124 FC_MCPFlag "MCP";
CM_ SG_ 1124 FC_CIPV_TTC "CIPVTTC";
CM_ SG_ 1124 FC_CIPV_TTC_Valid "CIPVTTC";
CM_ SG_ 1124 FC_RollingCounter_464 "464";
CM_ SG_ 1124 FC_CRCChecksum_464 "464";
CM_ SG_ 1104 FC_Obj1_Track_ID "1 ID";
CM_ SG_ 1104 FC_Obj1_Valid "1";
CM_ SG_ 1104 FC_Obj1_Track_Age "1";
CM_ SG_ 1104 FC_Obj1_Confidence "1";
CM_ SG_ 1104 FC_Obj1_MotionCategory "1";
CM_ SG_ 1104 FC_Obj1_MotionType "1";
CM_ SG_ 1104 FC_Obj1_MeasureStatus "1";
CM_ SG_ 1104 FC_Obj1_Class "1";
CM_ SG_ 1104 FC_Obj1_VehSubType "1";
CM_ SG_ 1104 FC_Obj1_PedSubType "1";
CM_ SG_ 1104 FC_Obj1_LaneAssignment "1";
CM_ SG_ 1104 FC_Obj1_Height "1";
CM_ SG_ 1104 FC_Obj1_Height_Vnce "1";
CM_ SG_ 1104 FC_Obj1_Length "1";
CM_ SG_ 1104 FC_Obj1_Length_Vnce "1";
CM_ SG_ 1104 FC_Obj1_Width "1";
CM_ SG_ 1104 FC_Obj1_Width_Vnce "1";
CM_ SG_ 1104 FC_Obj1_TurnLight "1";
CM_ SG_ 1104 FC_Obj1_Brakelight_Info "1";
CM_ SG_ 1104 FC_Obj1_TTC "1TTC";
CM_ SG_ 1104 FC_Obj1_Dx "1";
CM_ SG_ 1104 FC_Obj1_Dx_STD "1";
CM_ SG_ 1104 FC_Obj1_Dy "1";
CM_ SG_ 1104 FC_Obj1_Dy_STD "1";
CM_ SG_ 1104 FC_Obj1_RelVx "1";
CM_ SG_ 1104 FC_Obj1_RelVx_STD "1";
CM_ SG_ 1104 FC_Obj1_RelVy "1";
CM_ SG_ 1104 FC_Obj1_RelVy_STD "1";
CM_ SG_ 1104 FC_Obj1_RelAx "1";
CM_ SG_ 1104 FC_Obj1_RelAx_STD "1";
CM_ SG_ 1104 FC_Obj1_RelAy "1";
CM_ SG_ 1104 FC_Obj1_RelAy_STD "1";
CM_ SG_ 1104 FC_Obj1_HeadingAngle "1";
CM_ SG_ 1104 FC_Obj1_HeadingAngle_Vnce "1";
CM_ SG_ 1104 FC_Obj1_WorldinfoYaw "1";
CM_ SG_ 1104 FC_Obj1_WorldinfoYaw_Vnce "1";
CM_ SG_ 1104 FC_Obj1_AbsVx "1";
CM_ SG_ 1104 FC_Obj1_AbsVy "1";
CM_ SG_ 1104 FC_Obj1_CutInFlag "1 cutin";
CM_ SG_ 1104 FC_Obj1_CornerPoint_x "1 cutin";
CM_ SG_ 1104 FC_Obj1_CornerPoint_y "1 cutin";
CM_ SG_ 1104 FC_Obj1_CutInLane "1 cutIn";
CM_ SG_ 1104 FC_Obj1_DistInLane "1 cutin";
CM_ SG_ 1104 FC_RollingCounter_450 "450";
CM_ SG_ 1104 FC_CRCChecksum_450 "450";
CM_ SG_ 1105 FC_Obj2_Track_ID "2 ID";
CM_ SG_ 1105 FC_Obj2_Valid "2";
CM_ SG_ 1105 FC_Obj2_Track_Age "2";
CM_ SG_ 1105 FC_Obj2_Confidence "2";
CM_ SG_ 1105 FC_Obj2_MotionCategory "2";
CM_ SG_ 1105 FC_Obj2_MotionType "2";
CM_ SG_ 1105 FC_Obj2_MeasureStatus "2";
CM_ SG_ 1105 FC_Obj2_Class "2";
CM_ SG_ 1105 FC_Obj2_VehSubType "2";
CM_ SG_ 1105 FC_Obj2_PedSubType "2";
CM_ SG_ 1105 FC_Obj2_LaneAssignment "2";
CM_ SG_ 1105 FC_Obj2_Height "2";
CM_ SG_ 1105 FC_Obj2_Height_Vnce "2";
CM_ SG_ 1105 FC_Obj2_Length "2";
CM_ SG_ 1105 FC_Obj2_Length_Vnce "2";
CM_ SG_ 1105 FC_Obj2_Width "2";
CM_ SG_ 1105 FC_Obj2_Width_Vnce "2";
CM_ SG_ 1105 FC_Obj2_TurnLight "2";
CM_ SG_ 1105 FC_Obj2_Brakelight_Info "2";
CM_ SG_ 1105 FC_Obj2_TTC "2TTC";
CM_ SG_ 1105 FC_Obj2_Dx "2";
CM_ SG_ 1105 FC_Obj2_Dx_STD "2";
CM_ SG_ 1105 FC_Obj2_Dy "2";
CM_ SG_ 1105 FC_Obj2_Dy_STD "2";
CM_ SG_ 1105 FC_Obj2_RelVx "2";
CM_ SG_ 1105 FC_Obj2_RelVx_STD "2";
CM_ SG_ 1105 FC_Obj2_RelVy "2";
CM_ SG_ 1105 FC_Obj2_RelVy_STD "2";
CM_ SG_ 1105 FC_Obj2_RelAx "2";
CM_ SG_ 1105 FC_Obj2_RelAx_STD "2";
CM_ SG_ 1105 FC_Obj2_RelAy "2";
CM_ SG_ 1105 FC_Obj2_RelAy_STD "2";
CM_ SG_ 1105 FC_Obj2_HeadingAngle "2";
CM_ SG_ 1105 FC_Obj2_HeadingAngle_Vnce "2";
CM_ SG_ 1105 FC_Obj2_WorldinfoYaw "2";
CM_ SG_ 1105 FC_Obj2_WorldinfoYaw_Vnce "2";
CM_ SG_ 1105 FC_Obj2_AbsVx "2";
CM_ SG_ 1105 FC_Obj2_AbsVy "2";
CM_ SG_ 1105 FC_Obj2_CutInFlag "2 cutin";
CM_ SG_ 1105 FC_Obj2_CornerPoint_x "2 cutin";
CM_ SG_ 1105 FC_Obj2_CornerPoint_y "2 cutin";
CM_ SG_ 1105 FC_Obj2_CutInLane "2 cutIn";
CM_ SG_ 1105 FC_Obj2_DistInLane "2 cutin";
CM_ SG_ 1105 FC_RollingCounter_451 "451";
CM_ SG_ 1105 FC_CRCChecksum_451 "451";
CM_ SG_ 1106 FC_Obj3_Track_ID "3 ID";
CM_ SG_ 1106 FC_Obj3_Valid "3";
CM_ SG_ 1106 FC_Obj3_Track_Age "3";
CM_ SG_ 1106 FC_Obj3_Confidence "3";
CM_ SG_ 1106 FC_Obj3_MotionCategory "3";
CM_ SG_ 1106 FC_Obj3_MotionType "3";
CM_ SG_ 1106 FC_Obj3_MeasureStatus "3";
CM_ SG_ 1106 FC_Obj3_Class "3";
CM_ SG_ 1106 FC_Obj3_VehSubType "3";
CM_ SG_ 1106 FC_Obj3_PedSubType "3";
CM_ SG_ 1106 FC_Obj3_LaneAssignment "3";
CM_ SG_ 1106 FC_Obj3_Height "3";
CM_ SG_ 1106 FC_Obj3_Height_Vnce "3";
CM_ SG_ 1106 FC_Obj3_Length "3";
CM_ SG_ 1106 FC_Obj3_Length_Vnce "3";
CM_ SG_ 1106 FC_Obj3_Width "3";
CM_ SG_ 1106 FC_Obj3_Width_Vnce "3";
CM_ SG_ 1106 FC_Obj3_TurnLight "3";
CM_ SG_ 1106 FC_Obj3_Brakelight_Info "3";
CM_ SG_ 1106 FC_Obj3_TTC "3TTC";
CM_ SG_ 1106 FC_Obj3_Dx "3";
CM_ SG_ 1106 FC_Obj3_Dx_STD "3";
CM_ SG_ 1106 FC_Obj3_Dy "3";
CM_ SG_ 1106 FC_Obj3_Dy_STD "3";
CM_ SG_ 1106 FC_Obj3_RelVx "3";
CM_ SG_ 1106 FC_Obj3_RelVx_STD "3";
CM_ SG_ 1106 FC_Obj3_RelVy "3";
CM_ SG_ 1106 FC_Obj3_RelVy_STD "3";
CM_ SG_ 1106 FC_Obj3_RelAx "3";
CM_ SG_ 1106 FC_Obj3_RelAx_STD "3";
CM_ SG_ 1106 FC_Obj3_RelAy "3";
CM_ SG_ 1106 FC_Obj3_RelAy_STD "3";
CM_ SG_ 1106 FC_Obj3_HeadingAngle "3";
CM_ SG_ 1106 FC_Obj3_HeadingAngle_Vnce "3";
CM_ SG_ 1106 FC_Obj3_WorldinfoYaw "3";
CM_ SG_ 1106 FC_Obj3_WorldinfoYaw_Vnce "3";
CM_ SG_ 1106 FC_Obj3_AbsVx "3";
CM_ SG_ 1106 FC_Obj3_AbsVy "3";
CM_ SG_ 1106 FC_Obj3_CutInFlag "3 cutin";
CM_ SG_ 1106 FC_Obj3_CornerPoint_x "3 cutin";
CM_ SG_ 1106 FC_Obj3_CornerPoint_y "3 cutin";
CM_ SG_ 1106 FC_Obj3_CutInLane "3 cutIn";
CM_ SG_ 1106 FC_Obj3_DistInLane "3 cutin";
CM_ SG_ 1106 FC_RollingCounter_452 "452";
CM_ SG_ 1106 FC_CRCChecksum_452 "452";
CM_ SG_ 1107 FC_Obj4_Track_ID "4 ID";
CM_ SG_ 1107 FC_Obj4_Valid "4";
CM_ SG_ 1107 FC_Obj4_Track_Age "4";
CM_ SG_ 1107 FC_Obj4_Confidence "4";
CM_ SG_ 1107 FC_Obj4_MotionCategory "4";
CM_ SG_ 1107 FC_Obj4_MotionType "4";
CM_ SG_ 1107 FC_Obj4_MeasureStatus "4";
CM_ SG_ 1107 FC_Obj4_Class "4";
CM_ SG_ 1107 FC_Obj4_VehSubType "4";
CM_ SG_ 1107 FC_Obj4_PedSubType "4";
CM_ SG_ 1107 FC_Obj4_LaneAssignment "4";
CM_ SG_ 1107 FC_Obj4_Height "4";
CM_ SG_ 1107 FC_Obj4_Height_Vnce "4";
CM_ SG_ 1107 FC_Obj4_Length "4";
CM_ SG_ 1107 FC_Obj4_Length_Vnce "4";
CM_ SG_ 1107 FC_Obj4_Width "4";
CM_ SG_ 1107 FC_Obj4_Width_Vnce "4";
CM_ SG_ 1107 FC_Obj4_TurnLight "4";
CM_ SG_ 1107 FC_Obj4_Brakelight_Info "4";
CM_ SG_ 1107 FC_Obj4_TTC "4TTC";
CM_ SG_ 1107 FC_Obj4_Dx "4";
CM_ SG_ 1107 FC_Obj4_Dx_STD "4";
CM_ SG_ 1107 FC_Obj4_Dy "4";
CM_ SG_ 1107 FC_Obj4_Dy_STD "4";
CM_ SG_ 1107 FC_Obj4_RelVx "4";
CM_ SG_ 1107 FC_Obj4_RelVx_STD "4";
CM_ SG_ 1107 FC_Obj4_RelVy "4";
CM_ SG_ 1107 FC_Obj4_RelVy_STD "4";
CM_ SG_ 1107 FC_Obj4_RelAx "4";
CM_ SG_ 1107 FC_Obj4_RelAx_STD "4";
CM_ SG_ 1107 FC_Obj4_RelAy "4";
CM_ SG_ 1107 FC_Obj4_RelAy_STD "4";
CM_ SG_ 1107 FC_Obj4_HeadingAngle "4";
CM_ SG_ 1107 FC_Obj4_HeadingAngle_Vnce "4";
CM_ SG_ 1107 FC_Obj4_WorldinfoYaw "4";
CM_ SG_ 1107 FC_Obj4_WorldinfoYaw_Vnce "4";
CM_ SG_ 1107 FC_Obj4_AbsVx "4";
CM_ SG_ 1107 FC_Obj4_AbsVy "4";
CM_ SG_ 1107 FC_Obj4_CutInFlag "4 cutin";
CM_ SG_ 1107 FC_Obj4_CornerPoint_x "4 cutin";
CM_ SG_ 1107 FC_Obj4_CornerPoint_y "4 cutin";
CM_ SG_ 1107 FC_Obj4_CutInLane "4 cutIn";
CM_ SG_ 1107 FC_Obj4_DistInLane "4 cutin";
CM_ SG_ 1107 FC_RollingCounter_453 "453";
CM_ SG_ 1107 FC_CRCChecksum_453 "453";
CM_ SG_ 1108 FC_Obj5_Track_ID "5 ID";
CM_ SG_ 1108 FC_Obj5_Valid "5";
CM_ SG_ 1108 FC_Obj5_Track_Age "5";
CM_ SG_ 1108 FC_Obj5_Confidence "5";
CM_ SG_ 1108 FC_Obj5_MotionCategory "5";
CM_ SG_ 1108 FC_Obj5_MotionType "5";
CM_ SG_ 1108 FC_Obj5_MeasureStatus "5";
CM_ SG_ 1108 FC_Obj5_Class "5";
CM_ SG_ 1108 FC_Obj5_VehSubType "5";
CM_ SG_ 1108 FC_Obj5_PedSubType "5";
CM_ SG_ 1108 FC_Obj5_LaneAssignment "5";
CM_ SG_ 1108 FC_Obj5_Height "5";
CM_ SG_ 1108 FC_Obj5_Height_Vnce "5";
CM_ SG_ 1108 FC_Obj5_Length "5";
CM_ SG_ 1108 FC_Obj5_Length_Vnce "5";
CM_ SG_ 1108 FC_Obj5_Width "5";
CM_ SG_ 1108 FC_Obj5_Width_Vnce "5";
CM_ SG_ 1108 FC_Obj5_TurnLight "5";
CM_ SG_ 1108 FC_Obj5_Brakelight_Info "5";
CM_ SG_ 1108 FC_Obj5_TTC "5TTC";
CM_ SG_ 1108 FC_Obj5_Dx "5";
CM_ SG_ 1108 FC_Obj5_Dx_STD "5";
CM_ SG_ 1108 FC_Obj5_Dy "5";
CM_ SG_ 1108 FC_Obj5_Dy_STD "5";
CM_ SG_ 1108 FC_Obj5_RelVx "5";
CM_ SG_ 1108 FC_Obj5_RelVx_STD "5";
CM_ SG_ 1108 FC_Obj5_RelVy "5";
CM_ SG_ 1108 FC_Obj5_RelVy_STD "5";
CM_ SG_ 1108 FC_Obj5_RelAx "5";
CM_ SG_ 1108 FC_Obj5_RelAx_STD "5";
CM_ SG_ 1108 FC_Obj5_RelAy "5";
CM_ SG_ 1108 FC_Obj5_RelAy_STD "5";
CM_ SG_ 1108 FC_Obj5_HeadingAngle "5";
CM_ SG_ 1108 FC_Obj5_HeadingAngle_Vnce "4";
CM_ SG_ 1108 FC_Obj5_WorldinfoYaw "5";
CM_ SG_ 1108 FC_Obj5_WorldinfoYaw_Vnce "5";
CM_ SG_ 1108 FC_Obj5_AbsVx "5";
CM_ SG_ 1108 FC_Obj5_AbsVy "5";
CM_ SG_ 1108 FC_Obj5_CutInFlag "5 cutin";
CM_ SG_ 1108 FC_Obj5_CornerPoint_x "5 cutin";
CM_ SG_ 1108 FC_Obj5_CornerPoint_y "5 cutin";
CM_ SG_ 1108 FC_Obj5_CutInLane "5 cutIn";
CM_ SG_ 1108 FC_Obj5_DistInLane "5 cutin";
CM_ SG_ 1108 FC_RollingCounter_454 "454";
CM_ SG_ 1108 FC_CRCChecksum_454 "454";
CM_ SG_ 1109 FC_Obj6_Track_ID "6 ID";
CM_ SG_ 1109 FC_Obj6_Valid "6";
CM_ SG_ 1109 FC_Obj6_Track_Age "6";
CM_ SG_ 1109 FC_Obj6_Confidence "6";
CM_ SG_ 1109 FC_Obj6_MotionCategory "6";
CM_ SG_ 1109 FC_Obj6_MotionType "6";
CM_ SG_ 1109 FC_Obj6_MeasureStatus "6";
CM_ SG_ 1109 FC_Obj6_Class "6";
CM_ SG_ 1109 FC_Obj6_VehSubType "6";
CM_ SG_ 1109 FC_Obj6_PedSubType "6";
CM_ SG_ 1109 FC_Obj6_LaneAssignment "6";
CM_ SG_ 1109 FC_Obj6_Height "6";
CM_ SG_ 1109 FC_Obj6_Height_Vnce "6";
CM_ SG_ 1109 FC_Obj6_Length "6";
CM_ SG_ 1109 FC_Obj6_Length_Vnce "6";
CM_ SG_ 1109 FC_Obj6_Width "6";
CM_ SG_ 1109 FC_Obj6_Width_Vnce "6";
CM_ SG_ 1109 FC_Obj6_TurnLight "6";
CM_ SG_ 1109 FC_Obj6_Brakelight_Info "6";
CM_ SG_ 1109 FC_Obj6_TTC "6TTC";
CM_ SG_ 1109 FC_Obj6_Dx "6";
CM_ SG_ 1109 FC_Obj6_Dx_STD "6";
CM_ SG_ 1109 FC_Obj6_Dy "6";
CM_ SG_ 1109 FC_Obj6_Dy_STD "6";
CM_ SG_ 1109 FC_Obj6_RelVx "6";
CM_ SG_ 1109 FC_Obj6_RelVx_STD "6";
CM_ SG_ 1109 FC_Obj6_RelVy "6";
CM_ SG_ 1109 FC_Obj6_RelVy_STD "6";
CM_ SG_ 1109 FC_Obj6_RelAx "6";
CM_ SG_ 1109 FC_Obj6_RelAx_STD "6";
CM_ SG_ 1109 FC_Obj6_RelAy "6";
CM_ SG_ 1109 FC_Obj6_RelAy_STD "6";
CM_ SG_ 1109 FC_Obj6_HeadingAngle "6";
CM_ SG_ 1109 FC_Obj6_HeadingAngle_Vnce "6";
CM_ SG_ 1109 FC_Obj6_WorldinfoYaw "6";
CM_ SG_ 1109 FC_Obj6_WorldinfoYaw_Vnce "6";
CM_ SG_ 1109 FC_Obj6_AbsVx "6";
CM_ SG_ 1109 FC_Obj6_AbsVy "6";
CM_ SG_ 1109 FC_Obj6_CutInFlag "6 cutin";
CM_ SG_ 1109 FC_Obj6_CornerPoint_x "6 cutin";
CM_ SG_ 1109 FC_Obj6_CornerPoint_y "6 cutin";
CM_ SG_ 1109 FC_Obj6_CutInLane "6 cutIn";
CM_ SG_ 1109 FC_Obj6_DistInLane "6 cutin";
CM_ SG_ 1109 FC_RollingCounter_455 "455";
CM_ SG_ 1109 FC_CRCChecksum_455 "455";
CM_ SG_ 1110 FC_Obj7_Track_ID "7 ID";
CM_ SG_ 1110 FC_Obj7_Valid "7";
CM_ SG_ 1110 FC_Obj7_Track_Age "7";
CM_ SG_ 1110 FC_Obj7_Confidence "7";
CM_ SG_ 1110 FC_Obj7_MotionCategory "7";
CM_ SG_ 1110 FC_Obj7_MotionType "7";
CM_ SG_ 1110 FC_Obj7_MeasureStatus "7";
CM_ SG_ 1110 FC_Obj7_Class "7";
CM_ SG_ 1110 FC_Obj7_VehSubType "7";
CM_ SG_ 1110 FC_Obj7_PedSubType "7";
CM_ SG_ 1110 FC_Obj7_LaneAssignment "7";
CM_ SG_ 1110 FC_Obj7_Height "7";
CM_ SG_ 1110 FC_Obj7_Height_Vnce "7";
CM_ SG_ 1110 FC_Obj7_Length "7";
CM_ SG_ 1110 FC_Obj7_Length_Vnce "7";
CM_ SG_ 1110 FC_Obj7_Width "7";
CM_ SG_ 1110 FC_Obj7_Width_Vnce "7";
CM_ SG_ 1110 FC_Obj7_TurnLight "7";
CM_ SG_ 1110 FC_Obj7_Brakelight_Info "7";
CM_ SG_ 1110 FC_Obj7_TTC "7TTC";
CM_ SG_ 1110 FC_Obj7_Dx "7";
CM_ SG_ 1110 FC_Obj7_Dx_STD "7";
CM_ SG_ 1110 FC_Obj7_Dy "7";
CM_ SG_ 1110 FC_Obj7_Dy_STD "7";
CM_ SG_ 1110 FC_Obj7_RelVx "7";
CM_ SG_ 1110 FC_Obj7_RelVx_STD "7";
CM_ SG_ 1110 FC_Obj7_RelVy "7";
CM_ SG_ 1110 FC_Obj7_RelVy_STD "7";
CM_ SG_ 1110 FC_Obj7_RelAx "7";
CM_ SG_ 1110 FC_Obj7_RelAx_STD "7";
CM_ SG_ 1110 FC_Obj7_RelAy "7";
CM_ SG_ 1110 FC_Obj7_RelAy_STD "7";
CM_ SG_ 1110 FC_Obj7_HeadingAngle "7";
CM_ SG_ 1110 FC_Obj7_HeadingAngle_Vnce "7";
CM_ SG_ 1110 FC_Obj7_WorldinfoYaw "7";
CM_ SG_ 1110 FC_Obj7_WorldinfoYaw_Vnce "7";
CM_ SG_ 1110 FC_Obj7_AbsVx "7";
CM_ SG_ 1110 FC_Obj7_AbsVy "7";
CM_ SG_ 1110 FC_Obj7_CutInFlag "7 cutin";
CM_ SG_ 1110 FC_Obj7_CornerPoint_x "7 cutin";
CM_ SG_ 1110 FC_Obj7_CornerPoint_y "7 cutin";
CM_ SG_ 1110 FC_Obj7_CutInLane "7 cutIn";
CM_ SG_ 1110 FC_Obj7_DistInLane "7 cutin";
CM_ SG_ 1110 FC_RollingCounter_456 "456";
CM_ SG_ 1110 FC_CRCChecksum_456 "456";
CM_ SG_ 1111 FC_Obj8_Track_ID "8 ID";
CM_ SG_ 1111 FC_Obj8_Valid "8";
CM_ SG_ 1111 FC_Obj8_Track_Age "8";
CM_ SG_ 1111 FC_Obj8_Confidence "8";
CM_ SG_ 1111 FC_Obj8_MotionCategory "8";
CM_ SG_ 1111 FC_Obj8_MotionType "8";
CM_ SG_ 1111 FC_Obj8_MeasureStatus "8";
CM_ SG_ 1111 FC_Obj8_Class "8";
CM_ SG_ 1111 FC_Obj8_VehSubType "8";
CM_ SG_ 1111 FC_Obj8_PedSubType "8";
CM_ SG_ 1111 FC_Obj8_LaneAssignment "8";
CM_ SG_ 1111 FC_Obj8_Height "8";
CM_ SG_ 1111 FC_Obj8_Height_Vnce "8";
CM_ SG_ 1111 FC_Obj8_Length "8";
CM_ SG_ 1111 FC_Obj8_Length_Vnce "8";
CM_ SG_ 1111 FC_Obj8_Width "8";
CM_ SG_ 1111 FC_Obj8_Width_Vnce "8";
CM_ SG_ 1111 FC_Obj8_TurnLight "8";
CM_ SG_ 1111 FC_Obj8_Brakelight_Info "8";
CM_ SG_ 1111 FC_Obj8_TTC "8TTC";
CM_ SG_ 1111 FC_Obj8_Dx "8";
CM_ SG_ 1111 FC_Obj8_Dx_STD "8";
CM_ SG_ 1111 FC_Obj8_Dy "8";
CM_ SG_ 1111 FC_Obj8_Dy_STD "8";
CM_ SG_ 1111 FC_Obj8_RelVx "8";
CM_ SG_ 1111 FC_Obj8_RelVx_STD "8";
CM_ SG_ 1111 FC_Obj8_RelVy "8";
CM_ SG_ 1111 FC_Obj8_RelVy_STD "8";
CM_ SG_ 1111 FC_Obj8_RelAx "8";
CM_ SG_ 1111 FC_Obj8_RelAx_STD "8";
CM_ SG_ 1111 FC_Obj8_RelAy "8";
CM_ SG_ 1111 FC_Obj8_RelAy_STD "8";
CM_ SG_ 1111 FC_Obj8_HeadingAngle "8";
CM_ SG_ 1111 FC_Obj8_HeadingAngle_Vnce "8";
CM_ SG_ 1111 FC_Obj8_WorldinfoYaw "8";
CM_ SG_ 1111 FC_Obj8_WorldinfoYaw_Vnce "8";
CM_ SG_ 1111 FC_Obj8_AbsVx "8";
CM_ SG_ 1111 FC_Obj8_AbsVy "8";
CM_ SG_ 1111 FC_Obj8_CutInFlag "8 cutin";
CM_ SG_ 1111 FC_Obj8_CornerPoint_x "8 cutin";
CM_ SG_ 1111 FC_Obj8_CornerPoint_y "8 cutin";
CM_ SG_ 1111 FC_Obj8_CutInLane "8 cutIn";
CM_ SG_ 1111 FC_Obj8_DistInLane "8 cutin";
CM_ SG_ 1111 FC_RollingCounter_457 "457";
CM_ SG_ 1111 FC_CRCChecksum_457 "457";
CM_ SG_ 1112 FC_Obj9_Track_ID "9 ID";
CM_ SG_ 1112 FC_Obj9_Valid "9";
CM_ SG_ 1112 FC_Obj9_Track_Age "9";
CM_ SG_ 1112 FC_Obj9_Confidence "9";
CM_ SG_ 1112 FC_Obj9_MotionCategory "9";
CM_ SG_ 1112 FC_Obj9_MotionType "9";
CM_ SG_ 1112 FC_Obj9_MeasureStatus "9";
CM_ SG_ 1112 FC_Obj9_Class "9";
CM_ SG_ 1112 FC_Obj9_VehSubType "9";
CM_ SG_ 1112 FC_Obj9_PedSubType "9";
CM_ SG_ 1112 FC_Obj9_LaneAssignment "9";
CM_ SG_ 1112 FC_Obj9_Height "9";
CM_ SG_ 1112 FC_Obj9_Height_Vnce "9";
CM_ SG_ 1112 FC_Obj9_Length "9";
CM_ SG_ 1112 FC_Obj9_Length_Vnce "9";
CM_ SG_ 1112 FC_Obj9_Width "9";
CM_ SG_ 1112 FC_Obj9_Width_Vnce "9";
CM_ SG_ 1112 FC_Obj9_TurnLight "9";
CM_ SG_ 1112 FC_Obj9_Brakelight_Info "9";
CM_ SG_ 1112 FC_Obj9_TTC "9TTC";
CM_ SG_ 1112 FC_Obj9_Dx "9";
CM_ SG_ 1112 FC_Obj9_Dx_STD "9";
CM_ SG_ 1112 FC_Obj9_Dy "9";
CM_ SG_ 1112 FC_Obj9_Dy_STD "9";
CM_ SG_ 1112 FC_Obj9_RelVx "9";
CM_ SG_ 1112 FC_Obj9_RelVx_STD "9";
CM_ SG_ 1112 FC_Obj9_RelVy "9";
CM_ SG_ 1112 FC_Obj9_RelVy_STD "9";
CM_ SG_ 1112 FC_Obj9_RelAx "9";
CM_ SG_ 1112 FC_Obj9_RelAx_STD "9";
CM_ SG_ 1112 FC_Obj9_RelAy "9";
CM_ SG_ 1112 FC_Obj9_RelAy_STD "9";
CM_ SG_ 1112 FC_Obj9_HeadingAngle "9";
CM_ SG_ 1112 FC_Obj9_HeadingAngle_Vnce "9";
CM_ SG_ 1112 FC_Obj9_WorldinfoYaw "9";
CM_ SG_ 1112 FC_Obj9_WorldinfoYaw_Vnce "9";
CM_ SG_ 1112 FC_Obj9_AbsVx "9";
CM_ SG_ 1112 FC_Obj9_AbsVy "9";
CM_ SG_ 1112 FC_Obj9_CutInFlag "9 cutin";
CM_ SG_ 1112 FC_Obj9_CornerPoint_x "9 cutin";
CM_ SG_ 1112 FC_Obj9_CornerPoint_y "9 cutin";
CM_ SG_ 1112 FC_Obj9_CutInLane "9 cutIn";
CM_ SG_ 1112 FC_Obj9_DistInLane "9 cutin";
CM_ SG_ 1112 FC_RollingCounter_458 "458";
CM_ SG_ 1112 FC_CRCChecksum_458 "458";
CM_ SG_ 1113 FC_Obj10_Track_ID "10 ID";
CM_ SG_ 1113 FC_Obj10_Valid "10";
CM_ SG_ 1113 FC_Obj10_Track_Age "10";
CM_ SG_ 1113 FC_Obj10_Confidence "10";
CM_ SG_ 1113 FC_Obj10_MotionCategory "10";
CM_ SG_ 1113 FC_Obj10_MotionType "10";
CM_ SG_ 1113 FC_Obj10_MeasureStatus "10";
CM_ SG_ 1113 FC_Obj10_Class "10";
CM_ SG_ 1113 FC_Obj10_VehSubType "10";
CM_ SG_ 1113 FC_Obj10_PedSubType "10";
CM_ SG_ 1113 FC_Obj10_LaneAssignment "10";
CM_ SG_ 1113 FC_Obj10_Height "10";
CM_ SG_ 1113 FC_Obj10_Height_Vnce "10";
CM_ SG_ 1113 FC_Obj10_Length "10";
CM_ SG_ 1113 FC_Obj10_Length_Vnce "10";
CM_ SG_ 1113 FC_Obj10_Width "10";
CM_ SG_ 1113 FC_Obj10_Width_Vnce "10";
CM_ SG_ 1113 FC_Obj10_TurnLight "10";
CM_ SG_ 1113 FC_Obj10_Brakelight_Info "10";
CM_ SG_ 1113 FC_Obj10_TTC "10TTC";
CM_ SG_ 1113 FC_Obj10_Dx "10";
CM_ SG_ 1113 FC_Obj10_Dx_STD "10";
CM_ SG_ 1113 FC_Obj10_Dy "10";
CM_ SG_ 1113 FC_Obj10_Dy_STD "10";
CM_ SG_ 1113 FC_Obj10_RelVx "10";
CM_ SG_ 1113 FC_Obj10_RelVx_STD "10";
CM_ SG_ 1113 FC_Obj10_RelVy "10";
CM_ SG_ 1113 FC_Obj10_RelVy_STD "10";
CM_ SG_ 1113 FC_Obj10_RelAx "10";
CM_ SG_ 1113 FC_Obj10_RelAx_STD "10";
CM_ SG_ 1113 FC_Obj10_RelAy "10";
CM_ SG_ 1113 FC_Obj10_RelAy_STD "10";
CM_ SG_ 1113 FC_Obj10_HeadingAngle "10";
CM_ SG_ 1113 FC_Obj10_HeadingAngle_Vnce "10";
CM_ SG_ 1113 FC_Obj10_WorldinfoYaw "10";
CM_ SG_ 1113 FC_Obj10_WorldinfoYaw_Vnce "10";
CM_ SG_ 1113 FC_Obj10_AbsVx "10";
CM_ SG_ 1113 FC_Obj10_AbsVy "10";
CM_ SG_ 1113 FC_Obj10_CutInFlag "10 cutin";
CM_ SG_ 1113 FC_Obj10_CornerPoint_x "10 cutin";
CM_ SG_ 1113 FC_Obj10_CornerPoint_y "10 cutin";
CM_ SG_ 1113 FC_Obj10_CutInLane "10 cutIn";
CM_ SG_ 1113 FC_Obj10_DistInLane "10 cutin";
CM_ SG_ 1113 FC_RollingCounter_459 "459";
CM_ SG_ 1113 FC_CRCChecksum_459 "459";
CM_ SG_ 1114 FC_Obj11_Track_ID "11 ID";
CM_ SG_ 1114 FC_Obj11_Valid "11";
CM_ SG_ 1114 FC_Obj11_Track_Age "11";
CM_ SG_ 1114 FC_Obj11_Confidence "11";
CM_ SG_ 1114 FC_Obj11_MotionCategory "11";
CM_ SG_ 1114 FC_Obj11_MotionType "11";
CM_ SG_ 1114 FC_Obj11_MeasureStatus "11";
CM_ SG_ 1114 FC_Obj11_Class "11";
CM_ SG_ 1114 FC_Obj11_VehSubType "11";
CM_ SG_ 1114 FC_Obj11_PedSubType "11";
CM_ SG_ 1114 FC_Obj11_LaneAssignment "11";
CM_ SG_ 1114 FC_Obj11_Height "11";
CM_ SG_ 1114 FC_Obj11_Height_Vnce "11";
CM_ SG_ 1114 FC_Obj11_Length "11";
CM_ SG_ 1114 FC_Obj11_Length_Vnce "11";
CM_ SG_ 1114 FC_Obj11_Width "11";
CM_ SG_ 1114 FC_Obj11_Width_Vnce "11";
CM_ SG_ 1114 FC_Obj11_TurnLight "11";
CM_ SG_ 1114 FC_Obj11_Brakelight_Info "11";
CM_ SG_ 1114 FC_Obj11_TTC "11TTC";
CM_ SG_ 1114 FC_Obj11_Dx "11";
CM_ SG_ 1114 FC_Obj11_Dx_STD "11";
CM_ SG_ 1114 FC_Obj11_Dy "11";
CM_ SG_ 1114 FC_Obj11_Dy_STD "11";
CM_ SG_ 1114 FC_Obj11_RelVx "11";
CM_ SG_ 1114 FC_Obj11_RelVx_STD "11";
CM_ SG_ 1114 FC_Obj11_RelVy "11";
CM_ SG_ 1114 FC_Obj11_RelVy_STD "11";
CM_ SG_ 1114 FC_Obj11_RelAx "11";
CM_ SG_ 1114 FC_Obj11_RelAx_STD "11";
CM_ SG_ 1114 FC_Obj11_RelAy "11";
CM_ SG_ 1114 FC_Obj11_RelAy_STD "11";
CM_ SG_ 1114 FC_Obj11_HeadingAngle "11";
CM_ SG_ 1114 FC_Obj11_HeadingAngle_Vnce "11";
CM_ SG_ 1114 FC_Obj11_WorldinfoYaw "11";
CM_ SG_ 1114 FC_Obj11_WorldinfoYaw_Vnce "11";
CM_ SG_ 1114 FC_Obj11_AbsVx "11";
CM_ SG_ 1114 FC_Obj11_AbsVy "11";
CM_ SG_ 1114 FC_Obj11_CutInFlag "11 cutin";
CM_ SG_ 1114 FC_Obj11_CornerPoint_x "11 cutin";
CM_ SG_ 1114 FC_Obj11_CornerPoint_y "11 cutin";
CM_ SG_ 1114 FC_Obj11_CutInLane "11 cutIn";
CM_ SG_ 1114 FC_Obj11_DistInLane "11 cutin";
CM_ SG_ 1114 FC_RollingCounter_45A "45A";
CM_ SG_ 1114 FC_CRCChecksum_45A "45A";
CM_ SG_ 1115 FC_Obj12_Track_ID "12 ID";
CM_ SG_ 1115 FC_Obj12_Valid "12";
CM_ SG_ 1115 FC_Obj12_Track_Age "12";
CM_ SG_ 1115 FC_Obj12_Confidence "12";
CM_ SG_ 1115 FC_Obj12_MotionCategory "12";
CM_ SG_ 1115 FC_Obj12_MotionType "12";
CM_ SG_ 1115 FC_Obj12_MeasureStatus "12";
CM_ SG_ 1115 FC_Obj12_Class "12";
CM_ SG_ 1115 FC_Obj12_VehSubType "12";
CM_ SG_ 1115 FC_Obj12_PedSubType "12";
CM_ SG_ 1115 FC_Obj12_LaneAssignment "12";
CM_ SG_ 1115 FC_Obj12_Height "12";
CM_ SG_ 1115 FC_Obj12_Height_Vnce "12";
CM_ SG_ 1115 FC_Obj12_Length "12";
CM_ SG_ 1115 FC_Obj12_Length_Vnce "12";
CM_ SG_ 1115 FC_Obj12_Width "12";
CM_ SG_ 1115 FC_Obj12_Width_Vnce "12";
CM_ SG_ 1115 FC_Obj12_TurnLight "12";
CM_ SG_ 1115 FC_Obj12_Brakelight_Info "12";
CM_ SG_ 1115 FC_Obj12_TTC "12TTC";
CM_ SG_ 1115 FC_Obj12_Dx "12";
CM_ SG_ 1115 FC_Obj12_Dx_STD "12";
CM_ SG_ 1115 FC_Obj12_Dy "12";
CM_ SG_ 1115 FC_Obj12_Dy_STD "12";
CM_ SG_ 1115 FC_Obj12_RelVx "12";
CM_ SG_ 1115 FC_Obj12_RelVx_STD "12";
CM_ SG_ 1115 FC_Obj12_RelVy "12";
CM_ SG_ 1115 FC_Obj12_RelVy_STD "12";
CM_ SG_ 1115 FC_Obj12_RelAx "12";
CM_ SG_ 1115 FC_Obj12_RelAx_STD "12";
CM_ SG_ 1115 FC_Obj12_RelAy "12";
CM_ SG_ 1115 FC_Obj12_RelAy_STD "12";
CM_ SG_ 1115 FC_Obj12_HeadingAngle "12";
CM_ SG_ 1115 FC_Obj12_HeadingAngle_Vnce "12";
CM_ SG_ 1115 FC_Obj12_WorldinfoYaw "12";
CM_ SG_ 1115 FC_Obj12_WorldinfoYaw_Vnce "12";
CM_ SG_ 1115 FC_Obj12_AbsVx "12";
CM_ SG_ 1115 FC_Obj12_AbsVy "12";
CM_ SG_ 1115 FC_Obj12_CutInFlag "12 cutin";
CM_ SG_ 1115 FC_Obj12_CornerPoint_x "12 cutin";
CM_ SG_ 1115 FC_Obj12_CornerPoint_y "12 cutin";
CM_ SG_ 1115 FC_Obj12_CutInLane "12 cutIn";
CM_ SG_ 1115 FC_Obj12_DistInLane "12 cutin";
CM_ SG_ 1115 FC_RollingCounter_45B "45B";
CM_ SG_ 1115 FC_CRCChecksum_45B "45B";
CM_ SG_ 1116 FC_Obj13_Track_ID "13 ID";
CM_ SG_ 1116 FC_Obj13_Valid "13";
CM_ SG_ 1116 FC_Obj13_Track_Age "13";
CM_ SG_ 1116 FC_Obj13_Confidence "13";
CM_ SG_ 1116 FC_Obj13_MotionCategory "13";
CM_ SG_ 1116 FC_Obj13_MotionType "13";
CM_ SG_ 1116 FC_Obj13_MeasureStatus "13";
CM_ SG_ 1116 FC_Obj13_Class "13";
CM_ SG_ 1116 FC_Obj13_VehSubType "13";
CM_ SG_ 1116 FC_Obj13_PedSubType "13";
CM_ SG_ 1116 FC_Obj13_LaneAssignment "13";
CM_ SG_ 1116 FC_Obj13_Height "13";
CM_ SG_ 1116 FC_Obj13_Height_Vnce "13";
CM_ SG_ 1116 FC_Obj13_Length "13";
CM_ SG_ 1116 FC_Obj13_Length_Vnce "13";
CM_ SG_ 1116 FC_Obj13_Width "13";
CM_ SG_ 1116 FC_Obj13_Width_Vnce "13";
CM_ SG_ 1116 FC_Obj13_TurnLight "13";
CM_ SG_ 1116 FC_Obj13_Brakelight_Info "13";
CM_ SG_ 1116 FC_Obj13_TTC "13TTC";
CM_ SG_ 1116 FC_Obj13_Dx "13";
CM_ SG_ 1116 FC_Obj13_Dx_STD "13";
CM_ SG_ 1116 FC_Obj13_Dy "13";
CM_ SG_ 1116 FC_Obj13_Dy_STD "13";
CM_ SG_ 1116 FC_Obj13_RelVx "13";
CM_ SG_ 1116 FC_Obj13_RelVx_STD "13";
CM_ SG_ 1116 FC_Obj13_RelVy "13";
CM_ SG_ 1116 FC_Obj13_RelVy_STD "13";
CM_ SG_ 1116 FC_Obj13_RelAx "13";
CM_ SG_ 1116 FC_Obj13_RelAx_STD "13";
CM_ SG_ 1116 FC_Obj13_RelAy "13";
CM_ SG_ 1116 FC_Obj13_RelAy_STD "13";
CM_ SG_ 1116 FC_Obj13_HeadingAngle "13";
CM_ SG_ 1116 FC_Obj13_HeadingAngle_Vnce "13";
CM_ SG_ 1116 FC_Obj13_WorldinfoYaw "13";
CM_ SG_ 1116 FC_Obj13_WorldinfoYaw_Vnce "13";
CM_ SG_ 1116 FC_Obj13_AbsVx "13";
CM_ SG_ 1116 FC_Obj13_AbsVy "13";
CM_ SG_ 1116 FC_Obj13_CutInFlag "13 cutin";
CM_ SG_ 1116 FC_Obj13_CornerPoint_x "13 cutin";
CM_ SG_ 1116 FC_Obj13_CornerPoint_y "13 cutin";
CM_ SG_ 1116 FC_Obj13_CutInLane "13 cutIn";
CM_ SG_ 1116 FC_Obj13_DistInLane "13 cutin";
CM_ SG_ 1116 FC_RollingCounter_45C "45C";
CM_ SG_ 1116 FC_CRCChecksum_45C "45C";
CM_ SG_ 1117 FC_Obj14_Track_ID "14 ID";
CM_ SG_ 1117 FC_Obj14_Valid "14";
CM_ SG_ 1117 FC_Obj14_Track_Age "14";
CM_ SG_ 1117 FC_Obj14_Confidence "14";
CM_ SG_ 1117 FC_Obj14_MotionCategory "14";
CM_ SG_ 1117 FC_Obj14_MotionType "14";
CM_ SG_ 1117 FC_Obj14_MeasureStatus "14";
CM_ SG_ 1117 FC_Obj14_Class "14";
CM_ SG_ 1117 FC_Obj14_VehSubType "14";
CM_ SG_ 1117 FC_Obj14_PedSubType "14";
CM_ SG_ 1117 FC_Obj14_LaneAssignment "14";
CM_ SG_ 1117 FC_Obj14_Height "14";
CM_ SG_ 1117 FC_Obj14_Height_Vnce "14";
CM_ SG_ 1117 FC_Obj14_Length "14";
CM_ SG_ 1117 FC_Obj14_Length_Vnce "14";
CM_ SG_ 1117 FC_Obj14_Width "14";
CM_ SG_ 1117 FC_Obj14_Width_Vnce "14";
CM_ SG_ 1117 FC_Obj14_TurnLight "14";
CM_ SG_ 1117 FC_Obj14_Brakelight_Info "14";
CM_ SG_ 1117 FC_Obj14_TTC "14TTC";
CM_ SG_ 1117 FC_Obj14_Dx "14";
CM_ SG_ 1117 FC_Obj14_Dx_STD "14";
CM_ SG_ 1117 FC_Obj14_Dy "14";
CM_ SG_ 1117 FC_Obj14_Dy_STD "14";
CM_ SG_ 1117 FC_Obj14_RelVx "14";
CM_ SG_ 1117 FC_Obj14_RelVx_STD "14";
CM_ SG_ 1117 FC_Obj14_RelVy "14";
CM_ SG_ 1117 FC_Obj14_RelVy_STD "14";
CM_ SG_ 1117 FC_Obj14_RelAx "14";
CM_ SG_ 1117 FC_Obj14_RelAx_STD "14";
CM_ SG_ 1117 FC_Obj14_RelAy "14";
CM_ SG_ 1117 FC_Obj14_RelAy_STD "14";
CM_ SG_ 1117 FC_Obj14_HeadingAngle "14";
CM_ SG_ 1117 FC_Obj14_HeadingAngle_Vnce "14";
CM_ SG_ 1117 FC_Obj14_WorldinfoYaw "14";
CM_ SG_ 1117 FC_Obj14_WorldinfoYaw_Vnce "14";
CM_ SG_ 1117 FC_Obj14_AbsVx "14";
CM_ SG_ 1117 FC_Obj14_AbsVy "14";
CM_ SG_ 1117 FC_Obj14_CutInFlag "14 cutin";
CM_ SG_ 1117 FC_Obj14_CornerPoint_x "14 cutin";
CM_ SG_ 1117 FC_Obj14_CornerPoint_y "14 cutin";
CM_ SG_ 1117 FC_Obj14_CutInLane "14 cutIn";
CM_ SG_ 1117 FC_Obj14_DistInLane "14 cutin";
CM_ SG_ 1117 FC_RollingCounter_45D "45D";
CM_ SG_ 1117 FC_CRCChecksum_45D "45D";
CM_ SG_ 1118 FC_Obj15_Track_ID "15 ID";
CM_ SG_ 1118 FC_Obj15_Valid "15";
CM_ SG_ 1118 FC_Obj15_Track_Age "15";
CM_ SG_ 1118 FC_Obj15_Confidence "15";
CM_ SG_ 1118 FC_Obj15_MotionCategory "15";
CM_ SG_ 1118 FC_Obj15_MotionType "15";
CM_ SG_ 1118 FC_Obj15_MeasureStatus "15";
CM_ SG_ 1118 FC_Obj15_Class "15";
CM_ SG_ 1118 FC_Obj15_VehSubType "15";
CM_ SG_ 1118 FC_Obj15_PedSubType "15";
CM_ SG_ 1118 FC_Obj15_LaneAssignment "15";
CM_ SG_ 1118 FC_Obj15_Height "15";
CM_ SG_ 1118 FC_Obj15_Height_Vnce "15";
CM_ SG_ 1118 FC_Obj15_Length "15";
CM_ SG_ 1118 FC_Obj15_Length_Vnce "15";
CM_ SG_ 1118 FC_Obj15_Width "15";
CM_ SG_ 1118 FC_Obj15_Width_Vnce "15";
CM_ SG_ 1118 FC_Obj15_TurnLight "15";
CM_ SG_ 1118 FC_Obj15_Brakelight_Info "15";
CM_ SG_ 1118 FC_Obj15_TTC "15TTC";
CM_ SG_ 1118 FC_Obj15_Dx "15";
CM_ SG_ 1118 FC_Obj15_Dx_STD "15";
CM_ SG_ 1118 FC_Obj15_Dy "15";
CM_ SG_ 1118 FC_Obj15_Dy_STD "15";
CM_ SG_ 1118 FC_Obj15_RelVx "15";
CM_ SG_ 1118 FC_Obj15_RelVx_STD "15";
CM_ SG_ 1118 FC_Obj15_RelVy "15";
CM_ SG_ 1118 FC_Obj15_RelVy_STD "15";
CM_ SG_ 1118 FC_Obj15_RelAx "15";
CM_ SG_ 1118 FC_Obj15_RelAx_STD "15";
CM_ SG_ 1118 FC_Obj15_RelAy "15";
CM_ SG_ 1118 FC_Obj15_RelAy_STD "15";
CM_ SG_ 1118 FC_Obj15_HeadingAngle "15";
CM_ SG_ 1118 FC_Obj15_HeadingAngle_Vnce "15";
CM_ SG_ 1118 FC_Obj15_WorldinfoYaw "15";
CM_ SG_ 1118 FC_Obj15_WorldinfoYaw_Vnce "15";
CM_ SG_ 1118 FC_Obj15_AbsVx "15";
CM_ SG_ 1118 FC_Obj15_AbsVy "15";
CM_ SG_ 1118 FC_Obj15_CutInFlag "15 cutin";
CM_ SG_ 1118 FC_Obj15_CornerPoint_x "15 cutin";
CM_ SG_ 1118 FC_Obj15_CornerPoint_y "15 cutin";
CM_ SG_ 1118 FC_Obj15_CutInLane "15 cutIn";
CM_ SG_ 1118 FC_Obj15_DistInLane "15 cutin";
CM_ SG_ 1118 FC_RollingCounter_45E "45E";
CM_ SG_ 1118 FC_CRCChecksum_45E "45E";
CM_ SG_ 1119 FC_Obj16_Track_ID "16 ID";
CM_ SG_ 1119 FC_Obj16_Valid "16";
CM_ SG_ 1119 FC_Obj16_Track_Age "16";
CM_ SG_ 1119 FC_Obj16_Confidence "16";
CM_ SG_ 1119 FC_Obj16_MotionCategory "16";
CM_ SG_ 1119 FC_Obj16_MotionType "16";
CM_ SG_ 1119 FC_Obj16_MeasureStatus "16";
CM_ SG_ 1119 FC_Obj16_Class "16";
CM_ SG_ 1119 FC_Obj16_VehSubType "16";
CM_ SG_ 1119 FC_Obj16_PedSubType "16";
CM_ SG_ 1119 FC_Obj16_LaneAssignment "16";
CM_ SG_ 1119 FC_Obj16_Height "16";
CM_ SG_ 1119 FC_Obj16_Height_Vnce "16";
CM_ SG_ 1119 FC_Obj16_Length "16";
CM_ SG_ 1119 FC_Obj16_Length_Vnce "16";
CM_ SG_ 1119 FC_Obj16_Width "16";
CM_ SG_ 1119 FC_Obj16_Width_Vnce "16";
CM_ SG_ 1119 FC_Obj16_TurnLight "16";
CM_ SG_ 1119 FC_Obj16_Brakelight_Info "16";
CM_ SG_ 1119 FC_Obj16_TTC "16TTC";
CM_ SG_ 1119 FC_Obj16_Dx "16";
CM_ SG_ 1119 FC_Obj16_Dx_STD "16";
CM_ SG_ 1119 FC_Obj16_Dy "16";
CM_ SG_ 1119 FC_Obj16_Dy_STD "16";
CM_ SG_ 1119 FC_Obj16_RelVx "16";
CM_ SG_ 1119 FC_Obj16_RelVx_STD "16";
CM_ SG_ 1119 FC_Obj16_RelVy "16";
CM_ SG_ 1119 FC_Obj16_RelVy_STD "16";
CM_ SG_ 1119 FC_Obj16_RelAx "16";
CM_ SG_ 1119 FC_Obj16_RelAx_STD "16";
CM_ SG_ 1119 FC_Obj16_RelAy "16";
CM_ SG_ 1119 FC_Obj16_RelAy_STD "16";
CM_ SG_ 1119 FC_Obj16_HeadingAngle "16";
CM_ SG_ 1119 FC_Obj16_HeadingAngle_Vnce "16";
CM_ SG_ 1119 FC_Obj16_WorldinfoYaw "16";
CM_ SG_ 1119 FC_Obj16_WorldinfoYaw_Vnce "16";
CM_ SG_ 1119 FC_Obj16_AbsVx "16";
CM_ SG_ 1119 FC_Obj16_AbsVy "16";
CM_ SG_ 1119 FC_Obj16_CutInFlag "16 cutin";
CM_ SG_ 1119 FC_Obj16_CornerPoint_x "16 cutin";
CM_ SG_ 1119 FC_Obj16_CornerPoint_y "16 cutin";
CM_ SG_ 1119 FC_Obj16_CutInLane "16 cutIn";
CM_ SG_ 1119 FC_Obj16_DistInLane "16 cutin";
CM_ SG_ 1119 FC_RollingCounter_45F "45F";
CM_ SG_ 1119 FC_CRCChecksum_45F "45F";
CM_ SG_ 1120 FC_Obj17_Track_ID "17 ID";
CM_ SG_ 1120 FC_Obj17_Valid "17";
CM_ SG_ 1120 FC_Obj17_Track_Age "17";
CM_ SG_ 1120 FC_Obj17_Confidence "17";
CM_ SG_ 1120 FC_Obj17_MotionCategory "17";
CM_ SG_ 1120 FC_Obj17_MotionType "17";
CM_ SG_ 1120 FC_Obj17_MeasureStatus "17";
CM_ SG_ 1120 FC_Obj17_Class "17";
CM_ SG_ 1120 FC_Obj17_VehSubType "17";
CM_ SG_ 1120 FC_Obj17_PedSubType "17";
CM_ SG_ 1120 FC_Obj17_LaneAssignment "17";
CM_ SG_ 1120 FC_Obj17_Height "17";
CM_ SG_ 1120 FC_Obj17_Height_Vnce "17";
CM_ SG_ 1120 FC_Obj17_Length "17";
CM_ SG_ 1120 FC_Obj17_Length_Vnce "17";
CM_ SG_ 1120 FC_Obj17_Width "17";
CM_ SG_ 1120 FC_Obj17_Width_Vnce "17";
CM_ SG_ 1120 FC_Obj17_TurnLight "17";
CM_ SG_ 1120 FC_Obj17_Brakelight_Info "17";
CM_ SG_ 1120 FC_Obj17_TTC "17TTC";
CM_ SG_ 1120 FC_Obj17_Dx "17";
CM_ SG_ 1120 FC_Obj17_Dx_STD "17";
CM_ SG_ 1120 FC_Obj17_Dy "17";
CM_ SG_ 1120 FC_Obj17_Dy_STD "17";
CM_ SG_ 1120 FC_Obj17_RelVx "17";
CM_ SG_ 1120 FC_Obj17_RelVx_STD "17";
CM_ SG_ 1120 FC_Obj17_RelVy "17";
CM_ SG_ 1120 FC_Obj17_RelVy_STD "17";
CM_ SG_ 1120 FC_Obj17_RelAx "17";
CM_ SG_ 1120 FC_Obj17_RelAx_STD "17";
CM_ SG_ 1120 FC_Obj17_RelAy "17";
CM_ SG_ 1120 FC_Obj17_RelAy_STD "17";
CM_ SG_ 1120 FC_Obj17_HeadingAngle "17";
CM_ SG_ 1120 FC_Obj17_HeadingAngle_Vnce "17";
CM_ SG_ 1120 FC_Obj17_WorldinfoYaw "17";
CM_ SG_ 1120 FC_Obj17_WorldinfoYaw_Vnce "17";
CM_ SG_ 1120 FC_Obj17_AbsVx "17";
CM_ SG_ 1120 FC_Obj17_AbsVy "17";
CM_ SG_ 1120 FC_Obj17_CutInFlag "17 cutin";
CM_ SG_ 1120 FC_Obj17_CornerPoint_x "17 cutin";
CM_ SG_ 1120 FC_Obj17_CornerPoint_y "17 cutin";
CM_ SG_ 1120 FC_Obj17_CutInLane "17 cutIn";
CM_ SG_ 1120 FC_Obj17_DistInLane "17 cutin";
CM_ SG_ 1120 FC_RollingCounter_460 "460";
CM_ SG_ 1120 FC_CRCChecksum_460 "460";
CM_ SG_ 1121 FC_Obj18_Track_ID "18 ID";
CM_ SG_ 1121 FC_Obj18_Valid "18";
CM_ SG_ 1121 FC_Obj18_Track_Age "18";
CM_ SG_ 1121 FC_Obj18_Confidence "18";
CM_ SG_ 1121 FC_Obj18_MotionCategory "18";
CM_ SG_ 1121 FC_Obj18_MotionType "18";
CM_ SG_ 1121 FC_Obj18_MeasureStatus "18";
CM_ SG_ 1121 FC_Obj18_Class "18";
CM_ SG_ 1121 FC_Obj18_VehSubType "18";
CM_ SG_ 1121 FC_Obj18_PedSubType "18";
CM_ SG_ 1121 FC_Obj18_LaneAssignment "18";
CM_ SG_ 1121 FC_Obj18_Height "18";
CM_ SG_ 1121 FC_Obj18_Height_Vnce "18";
CM_ SG_ 1121 FC_Obj18_Length "18";
CM_ SG_ 1121 FC_Obj18_Length_Vnce "18";
CM_ SG_ 1121 FC_Obj18_Width "18";
CM_ SG_ 1121 FC_Obj18_Width_Vnce "18";
CM_ SG_ 1121 FC_Obj18_TurnLight "18";
CM_ SG_ 1121 FC_Obj18_Brakelight_Info "18";
CM_ SG_ 1121 FC_Obj18_TTC "18TTC";
CM_ SG_ 1121 FC_Obj18_Dx "18";
CM_ SG_ 1121 FC_Obj18_Dx_STD "18";
CM_ SG_ 1121 FC_Obj18_Dy "18";
CM_ SG_ 1121 FC_Obj18_Dy_STD "18";
CM_ SG_ 1121 FC_Obj18_RelVx "18";
CM_ SG_ 1121 FC_Obj18_RelVx_STD "18";
CM_ SG_ 1121 FC_Obj18_RelVy "18";
CM_ SG_ 1121 FC_Obj18_RelVy_STD "18";
CM_ SG_ 1121 FC_Obj18_RelAx "18";
CM_ SG_ 1121 FC_Obj18_RelAx_STD "18";
CM_ SG_ 1121 FC_Obj18_RelAy "18";
CM_ SG_ 1121 FC_Obj18_RelAy_STD "18";
CM_ SG_ 1121 FC_Obj18_HeadingAngle "18";
CM_ SG_ 1121 FC_Obj18_HeadingAngle_Vnce "18";
CM_ SG_ 1121 FC_Obj18_WorldinfoYaw "18";
CM_ SG_ 1121 FC_Obj18_WorldinfoYaw_Vnce "18";
CM_ SG_ 1121 FC_Obj18_AbsVx "18";
CM_ SG_ 1121 FC_Obj18_AbsVy "18";
CM_ SG_ 1121 FC_Obj18_CutInFlag "18 cutin";
CM_ SG_ 1121 FC_Obj18_CornerPoint_x "18 cutin";
CM_ SG_ 1121 FC_Obj18_CornerPoint_y "18 cutin";
CM_ SG_ 1121 FC_Obj18_CutInLane "18 cutIn";
CM_ SG_ 1121 FC_Obj18_DistInLane "18 cutin";
CM_ SG_ 1121 FC_RollingCounter_461 "461";
CM_ SG_ 1121 FC_CRCChecksum_461 "461";
CM_ SG_ 1122 FC_Obj19_Track_ID "19 ID";
CM_ SG_ 1122 FC_Obj19_Valid "19";
CM_ SG_ 1122 FC_Obj19_Track_Age "19";
CM_ SG_ 1122 FC_Obj19_Confidence "19";
CM_ SG_ 1122 FC_Obj19_MotionCategory "19";
CM_ SG_ 1122 FC_Obj19_MotionType "19";
CM_ SG_ 1122 FC_Obj19_MeasureStatus "19";
CM_ SG_ 1122 FC_Obj19_Class "19";
CM_ SG_ 1122 FC_Obj19_VehSubType "19";
CM_ SG_ 1122 FC_Obj19_PedSubType "19";
CM_ SG_ 1122 FC_Obj19_LaneAssignment "19";
CM_ SG_ 1122 FC_Obj19_Height "19";
CM_ SG_ 1122 FC_Obj19_Height_Vnce "19";
CM_ SG_ 1122 FC_Obj19_Length "19";
CM_ SG_ 1122 FC_Obj19_Length_Vnce "19";
CM_ SG_ 1122 FC_Obj19_Width "19";
CM_ SG_ 1122 FC_Obj19_Width_Vnce "19";
CM_ SG_ 1122 FC_Obj19_TurnLight "19";
CM_ SG_ 1122 FC_Obj19_Brakelight_Info "19";
CM_ SG_ 1122 FC_Obj19_TTC "19TTC";
CM_ SG_ 1122 FC_Obj19_Dx "19";
CM_ SG_ 1122 FC_Obj19_Dx_STD "19";
CM_ SG_ 1122 FC_Obj19_Dy "19";
CM_ SG_ 1122 FC_Obj19_Dy_STD "19";
CM_ SG_ 1122 FC_Obj19_RelVx "19";
CM_ SG_ 1122 FC_Obj19_RelVx_STD "19";
CM_ SG_ 1122 FC_Obj19_RelVy "19";
CM_ SG_ 1122 FC_Obj19_RelVy_STD "19";
CM_ SG_ 1122 FC_Obj19_RelAx "19";
CM_ SG_ 1122 FC_Obj19_RelAx_STD "19";
CM_ SG_ 1122 FC_Obj19_RelAy "19";
CM_ SG_ 1122 FC_Obj19_RelAy_STD "19";
CM_ SG_ 1122 FC_Obj19_HeadingAngle "19";
CM_ SG_ 1122 FC_Obj19_HeadingAngle_Vnce "19";
CM_ SG_ 1122 FC_Obj19_WorldinfoYaw "19";
CM_ SG_ 1122 FC_Obj19_WorldinfoYaw_Vnce "19";
CM_ SG_ 1122 FC_Obj19_AbsVx "19";
CM_ SG_ 1122 FC_Obj19_AbsVy "19";
CM_ SG_ 1122 FC_Obj19_CutInFlag "19 cutin";
CM_ SG_ 1122 FC_Obj19_CornerPoint_x "19 cutin";
CM_ SG_ 1122 FC_Obj19_CornerPoint_y "19 cutin";
CM_ SG_ 1122 FC_Obj19_CutInLane "19 cutIn";
CM_ SG_ 1122 FC_Obj19_DistInLane "19 cutin";
CM_ SG_ 1122 FC_RollingCounter_462 "462";
CM_ SG_ 1122 FC_CRCChecksum_462 "462";
CM_ SG_ 1123 FC_Obj20_Track_ID "20 ID";
CM_ SG_ 1123 FC_Obj20_Valid "20";
CM_ SG_ 1123 FC_Obj20_Track_Age "20";
CM_ SG_ 1123 FC_Obj20_Confidence "20";
CM_ SG_ 1123 FC_Obj20_MotionCategory "20";
CM_ SG_ 1123 FC_Obj20_MotionType "20";
CM_ SG_ 1123 FC_Obj20_MeasureStatus "20";
CM_ SG_ 1123 FC_Obj20_Class "20";
CM_ SG_ 1123 FC_Obj20_VehSubType "20";
CM_ SG_ 1123 FC_Obj20_PedSubType "20";
CM_ SG_ 1123 FC_Obj20_LaneAssignment "20";
CM_ SG_ 1123 FC_Obj20_Height "20";
CM_ SG_ 1123 FC_Obj20_Height_Vnce "20";
CM_ SG_ 1123 FC_Obj20_Length "20";
CM_ SG_ 1123 FC_Obj20_Length_Vnce "20";
CM_ SG_ 1123 FC_Obj20_Width "20";
CM_ SG_ 1123 FC_Obj20_Width_Vnce "20";
CM_ SG_ 1123 FC_Obj20_TurnLight "20";
CM_ SG_ 1123 FC_Obj20_Brakelight_Info "20";
CM_ SG_ 1123 FC_Obj20_TTC "20TTC";
CM_ SG_ 1123 FC_Obj20_Dx "20";
CM_ SG_ 1123 FC_Obj20_Dx_STD "20";
CM_ SG_ 1123 FC_Obj20_Dy "20";
CM_ SG_ 1123 FC_Obj20_Dy_STD "20";
CM_ SG_ 1123 FC_Obj20_RelVx "20";
CM_ SG_ 1123 FC_Obj20_RelVx_STD "20";
CM_ SG_ 1123 FC_Obj20_RelVy "20";
CM_ SG_ 1123 FC_Obj20_RelVy_STD "20";
CM_ SG_ 1123 FC_Obj20_RelAx "20";
CM_ SG_ 1123 FC_Obj20_RelAx_STD "20";
CM_ SG_ 1123 FC_Obj20_RelAy "20";
CM_ SG_ 1123 FC_Obj20_RelAy_STD "20";
CM_ SG_ 1123 FC_Obj20_HeadingAngle "20";
CM_ SG_ 1123 FC_Obj20_HeadingAngle_Vnce "20";
CM_ SG_ 1123 FC_Obj20_WorldinfoYaw "20";
CM_ SG_ 1123 FC_Obj20_WorldinfoYaw_Vnce "20";
CM_ SG_ 1123 FC_Obj20_AbsVx "20";
CM_ SG_ 1123 FC_Obj20_AbsVy "20";
CM_ SG_ 1123 FC_Obj20_CutInFlag "20 cutin";
CM_ SG_ 1123 FC_Obj20_CornerPoint_x "20 cutin";
CM_ SG_ 1123 FC_Obj20_CornerPoint_y "20 cutin";
CM_ SG_ 1123 FC_Obj20_CutInLane "20 cutIn";
CM_ SG_ 1123 FC_Obj20_DistInLane "20 cutin";
CM_ SG_ 1123 FC_RollingCounter_463 "463";
CM_ SG_ 1123 FC_CRCChecksum_463 "463";
CM_ SG_ 1136 FC_Line1_ID "1 ID";
CM_ SG_ 1136 FC_Line1_Confidence "1";
CM_ SG_ 1136 FC_Line1_MeasureStauts "1";
CM_ SG_ 1136 FC_Line1_Type "1";
CM_ SG_ 1136 FC_Line1_color "1";
CM_ SG_ 1136 FC_Line1_Width "1";
CM_ SG_ 1136 FC_Line1_dx_Start "1";
CM_ SG_ 1136 FC_Line1_dx_End "1";
CM_ SG_ 1136 FC_Line1_ModelC0 "1C0";
CM_ SG_ 1136 FC_Line1_ModelC1 "1C1";
CM_ SG_ 1136 FC_Line1_ModelC2 "1C2";
CM_ SG_ 1136 FC_Line1_ModelC3 "1C3";
CM_ SG_ 1136 FC_Line1_ParseConf "1";
CM_ SG_ 1136 FC_Line2_ID "2 ID";
CM_ SG_ 1136 FC_Line2_Confidence "2";
CM_ SG_ 1136 FC_Line2_MeasureStauts "2";
CM_ SG_ 1136 FC_Line2_Type "2";
CM_ SG_ 1136 FC_Line2_color "2";
CM_ SG_ 1136 FC_Line2_Width "2";
CM_ SG_ 1136 FC_Line2_dx_Start "2";
CM_ SG_ 1136 FC_Line2_dx_End "2";
CM_ SG_ 1136 FC_Line2_ModelC0 "2C0";
CM_ SG_ 1136 FC_Line2_ModelC1 "2C1";
CM_ SG_ 1136 FC_Line2_ModelC2 "2C2";
CM_ SG_ 1136 FC_Line2_ModelC3 "2C3";
CM_ SG_ 1136 FC_Line2_ParseConf "2";
CM_ SG_ 1136 FC_RollingCounter_470 "470";
CM_ SG_ 1136 FC_CRCChecksum_470 "470";
CM_ SG_ 1137 FC_Line3_ID "3 ID";
CM_ SG_ 1137 FC_Line3_Confidence "3";
CM_ SG_ 1137 FC_Line3_MeasureStauts "3";
CM_ SG_ 1137 FC_Line3_Type "3";
CM_ SG_ 1137 FC_Line3_color "3";
CM_ SG_ 1137 FC_Line3_Width "3";
CM_ SG_ 1137 FC_Line3_dx_Start "3";
CM_ SG_ 1137 FC_Line3_dx_End "3";
CM_ SG_ 1137 FC_Line3_ModelC0 "3C0";
CM_ SG_ 1137 FC_Line3_ModelC1 "3C1";
CM_ SG_ 1137 FC_Line3_ModelC2 "3C2";
CM_ SG_ 1137 FC_Line3_ModelC3 "3C3";
CM_ SG_ 1137 FC_Line3_ParseConf "3";
CM_ SG_ 1137 FC_Line4_ID "4 ID";
CM_ SG_ 1137 FC_Line4_Confidence "4";
CM_ SG_ 1137 FC_Line4_MeasureStauts "4";
CM_ SG_ 1137 FC_Line4_Type "4";
CM_ SG_ 1137 FC_Line4_color "4";
CM_ SG_ 1137 FC_Line4_Width "4";
CM_ SG_ 1137 FC_Line4_dx_Start "4";
CM_ SG_ 1137 FC_Line4_dx_End "4";
CM_ SG_ 1137 FC_Line4_ModelC0 "4C0";
CM_ SG_ 1137 FC_Line4_ModelC1 "4C1";
CM_ SG_ 1137 FC_Line4_ModelC2 "4C2";
CM_ SG_ 1137 FC_Line4_ModelC3 "4C3";
CM_ SG_ 1137 FC_Line4_ParseConf "4";
CM_ SG_ 1137 FC_RollingCounter_471 "471";
CM_ SG_ 1137 FC_CRCChecksum_471 "471";
CM_ SG_ 1138 FC_Line5_ID "5 ID";
CM_ SG_ 1138 FC_Line5_Confidence "5";
CM_ SG_ 1138 FC_Line5_MeasureStauts "5";
CM_ SG_ 1138 FC_Line5_Type "5";
CM_ SG_ 1138 FC_Line5_color "5";
CM_ SG_ 1138 FC_Line5_dx_Start "5";
CM_ SG_ 1138 FC_Line5_dx_End "5";
CM_ SG_ 1138 FC_Line5_ModelC0 "5C0";
CM_ SG_ 1138 FC_Line5_ModelC1 "5C1";
CM_ SG_ 1138 FC_Line5_ModelC2 "5C2";
CM_ SG_ 1138 FC_Line5_ModelC3 "5C3";
CM_ SG_ 1138 FC_Line5_ParseConf "5";
CM_ SG_ 1138 FC_Line6_ID "6 ID";
CM_ SG_ 1138 FC_Line6_Confidence "6";
CM_ SG_ 1138 FC_Line6_MeasureStauts "6";
CM_ SG_ 1138 FC_Line6_Type "6";
CM_ SG_ 1138 FC_Line6_color "6";
CM_ SG_ 1138 FC_Line6_dx_Start "6";
CM_ SG_ 1138 FC_Line6_dx_End "6";
CM_ SG_ 1138 FC_Line6_ModelC0 "6C0";
CM_ SG_ 1138 FC_Line6_ModelC1 "6C1";
CM_ SG_ 1138 FC_Line6_ModelC2 "6C2";
CM_ SG_ 1138 FC_Line6_ModelC3 "6C3";
CM_ SG_ 1138 FC_Line6_ParseConf "6";
CM_ SG_ 1138 FC_RollingCounter_472 "472";
CM_ SG_ 1138 FC_CRCChecksum_472 "472";
CM_ SG_ 1168 FC_RollingCounter_490 "490";
CM_ SG_ 1168 FC_CRCChecksum_490 "490";
CM_ SG_ 1172 FC_IHBC_Decision "IHBC";
CM_ SG_ 1172 FC_ISA_Value "ISA";
CM_ SG_ 1172 FC_ISA_Sign_Type "ISA";
CM_ SG_ 1172 FC_ISA_Popup_text "ISA";
CM_ SG_ 1172 FC_RollingCounter_494 "494";
CM_ SG_ 1172 FC_CRCChecksum_494 "494";
CM_ SG_ 1173 FC_FrameID "ID";
CM_ SG_ 1173 FC_RollingCounter_495 "495";
CM_ SG_ 1173 FC_CRCChecksum_495 "495";
CM_ SG_ 1139 FC_StaticObj1_Type "1";
CM_ SG_ 1139 FC_StaticObj2_Type "2";
CM_ SG_ 1139 FC_StaticObj3_Type "3";
CM_ SG_ 1139 FC_StaticObj4_Type "4";
CM_ SG_ 1139 FC_StaticObj5_Type "5";
CM_ SG_ 1139 FC_StaticObj6_Type "6";
CM_ SG_ 1139 FC_StaticObj7_Type "7";
CM_ SG_ 1139 FC_StaticObj8_Type "8";
CM_ SG_ 1139 FC_StaticObj9_Type "9";
CM_ SG_ 1139 FC_StaticObj10_Type "10";
CM_ SG_ 1139 FC_StaticObj11_Type "11";
CM_ SG_ 1139 FC_StaticObj12_Type "12";
CM_ SG_ 1139 FC_StaticObj13_Type "13";
CM_ SG_ 1139 FC_StaticObj14_Type "14";
CM_ SG_ 1139 FC_StaticObj15_Type "15";
CM_ SG_ 1139 FC_StaticObj16_Type "16";
CM_ SG_ 1139 FC_StaticObj17_Type "17";
CM_ SG_ 1139 FC_StaticObj18_Type "18";
CM_ SG_ 1139 FC_StaticObj19_Type "19";
CM_ SG_ 1139 FC_StaticObj20_Type "20";
CM_ SG_ 1139 FC_StaticObj1_Dx "1";
CM_ SG_ 1139 FC_StaticObj2_Dx "2";
CM_ SG_ 1139 FC_StaticObj3_Dx "3";
CM_ SG_ 1139 FC_StaticObj4_Dx "4";
CM_ SG_ 1139 FC_StaticObj5_Dx "5";
CM_ SG_ 1139 FC_StaticObj6_Dx "6";
CM_ SG_ 1139 FC_StaticObj7_Dx "7";
CM_ SG_ 1139 FC_StaticObj8_Dx "8";
CM_ SG_ 1139 FC_StaticObj9_Dx "9";
CM_ SG_ 1139 FC_StaticObj10_Dx "10";
CM_ SG_ 1139 FC_StaticObj11_Dx "11";
CM_ SG_ 1139 FC_StaticObj12_Dx "12";
CM_ SG_ 1139 FC_StaticObj13_Dx "13";
CM_ SG_ 1139 FC_StaticObj14_Dx "14";
CM_ SG_ 1139 FC_StaticObj15_Dx "15";
CM_ SG_ 1139 FC_StaticObj16_Dx "16";
CM_ SG_ 1139 FC_StaticObj17_Dx "17";
CM_ SG_ 1139 FC_StaticObj18_Dx "18";
CM_ SG_ 1139 FC_StaticObj19_Dx "19";
CM_ SG_ 1139 FC_StaticObj20_Dx "20";
CM_ SG_ 1139 FC_StaticObj1_Dy "1";
CM_ SG_ 1139 FC_StaticObj2_Dy "2";
CM_ SG_ 1139 FC_StaticObj3_Dy "3";
CM_ SG_ 1139 FC_StaticObj4_Dy "4";
CM_ SG_ 1139 FC_StaticObj5_Dy "5";
CM_ SG_ 1139 FC_StaticObj6_Dy "6";
CM_ SG_ 1139 FC_StaticObj7_Dy "7";
CM_ SG_ 1139 FC_StaticObj8_Dy "8";
CM_ SG_ 1139 FC_StaticObj9_Dy "9";
CM_ SG_ 1139 FC_StaticObj10_Dy "10";
CM_ SG_ 1139 FC_StaticObj11_Dy "11";
CM_ SG_ 1139 FC_StaticObj12_Dy "12";
CM_ SG_ 1139 FC_StaticObj13_Dy "13";
CM_ SG_ 1139 FC_StaticObj14_Dy "14";
CM_ SG_ 1139 FC_StaticObj15_Dy "15";
CM_ SG_ 1139 FC_StaticObj16_Dy "16";
CM_ SG_ 1139 FC_StaticObj17_Dy "17";
CM_ SG_ 1139 FC_StaticObj18_Dy "18";
CM_ SG_ 1139 FC_StaticObj19_Dy "19";
CM_ SG_ 1139 FC_StaticObj20_Dy "20";
CM_ SG_ 1139 FC_RollingCounter_473 "473";
CM_ SG_ 1139 FC_CRCChecksum_473 "473";

BA_DEF_ BO_ "CANFD_BRS" ENUM  "0","1";
BA_DEF_ BO_ "E2EDataId" INT 0 0;
BA_DEF_ BO_ "GenMsgCycleTime" INT 0 0;
BA_DEF_ BO_ "GenMsgILSupport" ENUM  "No","Yes";
BA_DEF_ BO_ "GenMsgSendType" ENUM  "Cyclic","Event","not_used","not_used","not_used","Cyclic","not_used","IfActive","NoMsgSendType";
BA_DEF_ BO_ "MsgType" ENUM  "Application","NM ","NMH","TP2.0","ISO-TP ","BAP","EID","KS";
BA_DEF_ BO_ "VFrameFormat" ENUM  "StandardCAN","ExtendedCAN","reserved","reserved","reserved","reserved","reserved","reserved","reserved","reserved","reserved","reserved","reserved","reserved","StandardCAN_FD","ExtendedCAN_FD";
BA_DEF_ SG_ "GenSigFuncType" ENUM  "NoFunction","MsgCounter","CRC-8","XOR","XOR-2","DatedBit","SW-Kl15","CHK","Constant","Protocol","CRC-8-SAE_J1850","CRC-32","DataLength","DataID","MsgCounter16","SOK-Signatur";
BA_DEF_ SG_ "GenSigSendType" ENUM  "Cyclic","OnWrite","OnWriteWithRepetition","OnChange","OnChangeWithRepetition","IfActive","IfActiveWithRepetition","NoSigSendType";
BA_DEF_ SG_ "GenSigStartValue" INT -2147483648 2147483647;
BA_DEF_ SG_ "GenSigSwitchedByIgnition" ENUM  "No","Yes";
BA_DEF_ BU_ "ECUVariantDefault" ENUM  "No","Yes";
BA_DEF_ BU_ "GenNodAutoGenDsp" ENUM  "No","Yes";
BA_DEF_ BU_ "GenNodAutoGenSnd" ENUM  "No","Yes";
BA_DEF_ BU_ "ILUsed" ENUM  "No","Yes";
BA_DEF_ BU_ "NmhNode" ENUM  "No","Yes";
BA_DEF_ BU_ "SSPOffsetCANFDMax" FLOAT 50 99.9;
BA_DEF_ BU_ "SSPOffsetCANFDMin" FLOAT 50 99.9;
BA_DEF_ BU_ "SamplePointCANFDMax" FLOAT 50 99.9;
BA_DEF_ BU_ "SamplePointCANFDMin" FLOAT 50 99.9;
BA_DEF_ BU_ "SamplePointMax" FLOAT 50 99.9;
BA_DEF_ BU_ "SamplePointMin" FLOAT 50 99.9;
BA_DEF_ BU_ "SyncJumpWidthCANFDMax" FLOAT 0 50;
BA_DEF_ BU_ "SyncJumpWidthCANFDMin" FLOAT 0 50;
BA_DEF_ BU_ "SyncJumpWidthMax" FLOAT 0 50;
BA_DEF_ BU_ "SyncJumpWidthMin" FLOAT 0 50;
BA_DEF_ BU_ "TimeQuantaCANFDMax" INT 4 257;
BA_DEF_ BU_ "TimeQuantaCANFDMin" INT 4 257;
BA_DEF_ BU_ "TimeQuantaMax" INT 4 257;
BA_DEF_ BU_ "TimeQuantaMin" INT 4 257;
BA_DEF_  "Baudrate" INT 1 1000000;
BA_DEF_  "BaudrateCANFD" INT 1 16000000;
BA_DEF_  "BusType" STRING;
BA_DEF_  "NmhMessageCount" INT 0 1024;
BA_DEF_  "ProtocolType" STRING;
BA_DEF_  "VersionDay" INT 1 31;
BA_DEF_  "VersionMonth" INT 1 12;
BA_DEF_  "VersionWeek" INT 1 52;
BA_DEF_  "VersionYear" INT 0 99;
BA_DEF_DEF_ "Baudrate" 500000;
BA_DEF_DEF_ "BaudrateCANFD" 2000000;
BA_DEF_DEF_ "BusType" "CAN";
BA_DEF_DEF_ "CANFD_BRS" "1";
BA_DEF_DEF_ "E2EDataId" 1;
BA_DEF_DEF_ "ECUVariantDefault" "Yes";
BA_DEF_DEF_ "GenMsgCycleTime" 0;
BA_DEF_DEF_ "GenMsgILSupport" "No";
BA_DEF_DEF_ "GenMsgSendType" "NoMsgSendType";
BA_DEF_DEF_ "GenNodAutoGenDsp" "Yes";
BA_DEF_DEF_ "GenNodAutoGenSnd" "Yes";
BA_DEF_DEF_ "GenSigFuncType" "NoFunction";
BA_DEF_DEF_ "GenSigSendType" "Cyclic";
BA_DEF_DEF_ "GenSigStartValue" 0;
BA_DEF_DEF_ "GenSigSwitchedByIgnition" "Yes";
BA_DEF_DEF_ "ILUsed" "Yes";
BA_DEF_DEF_ "MsgType" "Application";
BA_DEF_DEF_ "NmhMessageCount" 1;
BA_DEF_DEF_ "NmhNode" "Yes";
BA_DEF_DEF_ "ProtocolType" "J1939";
BA_DEF_DEF_ "SSPOffsetCANFDMax" 75;
BA_DEF_DEF_ "SSPOffsetCANFDMin" 75;
BA_DEF_DEF_ "SamplePointCANFDMax" 75;
BA_DEF_DEF_ "SamplePointCANFDMin" 75;
BA_DEF_DEF_ "SamplePointMax" 75;
BA_DEF_DEF_ "SamplePointMin" 75;
BA_DEF_DEF_ "SyncJumpWidthCANFDMax" 50;
BA_DEF_DEF_ "SyncJumpWidthCANFDMin" 50;
BA_DEF_DEF_ "SyncJumpWidthMax" 50;
BA_DEF_DEF_ "SyncJumpWidthMin" 50;
BA_DEF_DEF_ "TimeQuantaCANFDMax" 40;
BA_DEF_DEF_ "TimeQuantaCANFDMin" 40;
BA_DEF_DEF_ "TimeQuantaMax" 160;
BA_DEF_DEF_ "TimeQuantaMin" 160;
BA_DEF_DEF_ "VFrameFormat" "";
BA_DEF_DEF_ "VersionDay" 27;
BA_DEF_DEF_ "VersionMonth" 4;
BA_DEF_DEF_ "VersionWeek" 17;
BA_DEF_DEF_ "VersionYear" 18;

BA_ "BusType"   "CAN FD";

BA_ "GenMsgCycleTime" BO_ 1152 30;
BA_ "GenMsgILSupport" BO_ 1152 1;
BA_ "GenMsgSendType" BO_ 1152 0;
BA_ "VFrameFormat" BO_ 1152 14;
BA_ "GenMsgCycleTime" BO_ 1153 30;
BA_ "GenMsgILSupport" BO_ 1153 1;
BA_ "GenMsgSendType" BO_ 1153 0;
BA_ "VFrameFormat" BO_ 1153 14;
BA_ "GenMsgCycleTime" BO_ 1154 30;
BA_ "GenMsgILSupport" BO_ 1154 1;
BA_ "GenMsgSendType" BO_ 1154 0;
BA_ "VFrameFormat" BO_ 1154 14;
BA_ "GenMsgCycleTime" BO_ 1155 30;
BA_ "GenMsgILSupport" BO_ 1155 1;
BA_ "GenMsgSendType" BO_ 1155 0;
BA_ "VFrameFormat" BO_ 1155 14;
BA_ "GenMsgCycleTime" BO_ 1124 30;
BA_ "GenMsgILSupport" BO_ 1124 1;
BA_ "GenMsgSendType" BO_ 1124 0;
BA_ "VFrameFormat" BO_ 1124 14;
BA_ "GenMsgCycleTime" BO_ 1104 30;
BA_ "GenMsgILSupport" BO_ 1104 1;
BA_ "GenMsgSendType" BO_ 1104 0;
BA_ "VFrameFormat" BO_ 1104 14;
BA_ "GenMsgCycleTime" BO_ 1105 30;
BA_ "GenMsgILSupport" BO_ 1105 1;
BA_ "GenMsgSendType" BO_ 1105 0;
BA_ "VFrameFormat" BO_ 1105 14;
BA_ "GenMsgCycleTime" BO_ 1106 30;
BA_ "GenMsgILSupport" BO_ 1106 1;
BA_ "GenMsgSendType" BO_ 1106 0;
BA_ "VFrameFormat" BO_ 1106 14;
BA_ "GenMsgCycleTime" BO_ 1107 30;
BA_ "GenMsgILSupport" BO_ 1107 1;
BA_ "GenMsgSendType" BO_ 1107 0;
BA_ "VFrameFormat" BO_ 1107 14;
BA_ "GenMsgCycleTime" BO_ 1108 30;
BA_ "GenMsgILSupport" BO_ 1108 1;
BA_ "GenMsgSendType" BO_ 1108 0;
BA_ "VFrameFormat" BO_ 1108 14;
BA_ "GenMsgCycleTime" BO_ 1109 30;
BA_ "GenMsgILSupport" BO_ 1109 1;
BA_ "GenMsgSendType" BO_ 1109 0;
BA_ "VFrameFormat" BO_ 1109 14;
BA_ "GenMsgCycleTime" BO_ 1110 30;
BA_ "GenMsgILSupport" BO_ 1110 1;
BA_ "GenMsgSendType" BO_ 1110 0;
BA_ "VFrameFormat" BO_ 1110 14;
BA_ "GenMsgCycleTime" BO_ 1111 30;
BA_ "GenMsgILSupport" BO_ 1111 1;
BA_ "GenMsgSendType" BO_ 1111 0;
BA_ "VFrameFormat" BO_ 1111 14;
BA_ "GenMsgCycleTime" BO_ 1112 30;
BA_ "GenMsgILSupport" BO_ 1112 1;
BA_ "GenMsgSendType" BO_ 1112 0;
BA_ "VFrameFormat" BO_ 1112 14;
BA_ "GenMsgCycleTime" BO_ 1113 30;
BA_ "GenMsgILSupport" BO_ 1113 1;
BA_ "GenMsgSendType" BO_ 1113 0;
BA_ "VFrameFormat" BO_ 1113 14;
BA_ "GenMsgCycleTime" BO_ 1114 30;
BA_ "GenMsgILSupport" BO_ 1114 1;
BA_ "GenMsgSendType" BO_ 1114 0;
BA_ "VFrameFormat" BO_ 1114 14;
BA_ "GenMsgCycleTime" BO_ 1115 30;
BA_ "GenMsgILSupport" BO_ 1115 1;
BA_ "GenMsgSendType" BO_ 1115 0;
BA_ "VFrameFormat" BO_ 1115 14;
BA_ "GenMsgCycleTime" BO_ 1116 30;
BA_ "GenMsgILSupport" BO_ 1116 1;
BA_ "GenMsgSendType" BO_ 1116 0;
BA_ "VFrameFormat" BO_ 1116 14;
BA_ "GenMsgCycleTime" BO_ 1117 30;
BA_ "GenMsgILSupport" BO_ 1117 1;
BA_ "GenMsgSendType" BO_ 1117 0;
BA_ "VFrameFormat" BO_ 1117 14;
BA_ "GenMsgCycleTime" BO_ 1118 30;
BA_ "GenMsgILSupport" BO_ 1118 1;
BA_ "GenMsgSendType" BO_ 1118 0;
BA_ "VFrameFormat" BO_ 1118 14;
BA_ "GenMsgCycleTime" BO_ 1119 30;
BA_ "GenMsgILSupport" BO_ 1119 1;
BA_ "GenMsgSendType" BO_ 1119 0;
BA_ "VFrameFormat" BO_ 1119 14;
BA_ "GenMsgCycleTime" BO_ 1120 30;
BA_ "GenMsgILSupport" BO_ 1120 1;
BA_ "GenMsgSendType" BO_ 1120 0;
BA_ "VFrameFormat" BO_ 1120 14;
BA_ "GenMsgCycleTime" BO_ 1121 30;
BA_ "GenMsgILSupport" BO_ 1121 1;
BA_ "GenMsgSendType" BO_ 1121 0;
BA_ "VFrameFormat" BO_ 1121 14;
BA_ "GenMsgCycleTime" BO_ 1122 30;
BA_ "GenMsgILSupport" BO_ 1122 1;
BA_ "GenMsgSendType" BO_ 1122 0;
BA_ "VFrameFormat" BO_ 1122 14;
BA_ "GenMsgCycleTime" BO_ 1123 30;
BA_ "GenMsgILSupport" BO_ 1123 1;
BA_ "GenMsgSendType" BO_ 1123 0;
BA_ "VFrameFormat" BO_ 1123 14;
BA_ "GenMsgCycleTime" BO_ 1136 30;
BA_ "GenMsgILSupport" BO_ 1136 1;
BA_ "GenMsgSendType" BO_ 1136 0;
BA_ "VFrameFormat" BO_ 1136 14;
BA_ "GenMsgCycleTime" BO_ 1137 30;
BA_ "GenMsgILSupport" BO_ 1137 1;
BA_ "GenMsgSendType" BO_ 1137 0;
BA_ "VFrameFormat" BO_ 1137 14;
BA_ "GenMsgCycleTime" BO_ 1138 30;
BA_ "GenMsgILSupport" BO_ 1138 1;
BA_ "GenMsgSendType" BO_ 1138 0;
BA_ "VFrameFormat" BO_ 1138 14;
BA_ "GenMsgCycleTime" BO_ 1168 30;
BA_ "GenMsgILSupport" BO_ 1168 1;
BA_ "GenMsgSendType" BO_ 1168 0;
BA_ "VFrameFormat" BO_ 1168 14;
BA_ "GenMsgCycleTime" BO_ 1172 30;
BA_ "GenMsgILSupport" BO_ 1172 1;
BA_ "GenMsgSendType" BO_ 1172 0;
BA_ "VFrameFormat" BO_ 1172 14;
BA_ "GenMsgCycleTime" BO_ 1173 30;
BA_ "GenMsgILSupport" BO_ 1173 1;
BA_ "GenMsgSendType" BO_ 1173 0;
BA_ "VFrameFormat" BO_ 1173 14;
BA_ "GenMsgCycleTime" BO_ 1139 30;
BA_ "GenMsgILSupport" BO_ 1139 1;
BA_ "GenMsgSendType" BO_ 1139 0;
BA_ "VFrameFormat" BO_ 1139 14;

BA_ "GenSigStartValue" SG_ 1152 FC_lateral1 512;
BA_ "GenSigStartValue" SG_ 1152 FC_longitudinal1 1024;
BA_ "GenSigStartValue" SG_ 1152 FC_lateral2 512;
BA_ "GenSigStartValue" SG_ 1152 FC_longitudinal2 1024;
BA_ "GenSigStartValue" SG_ 1152 FC_lateral3 512;
BA_ "GenSigStartValue" SG_ 1152 FC_longitudinal3 1024;
BA_ "GenSigStartValue" SG_ 1152 FC_lateral4 512;
BA_ "GenSigStartValue" SG_ 1152 FC_longitudinal4 1024;
BA_ "GenSigStartValue" SG_ 1152 FC_lateral5 512;
BA_ "GenSigStartValue" SG_ 1152 FC_longitudinal5 1024;
BA_ "GenSigStartValue" SG_ 1152 FC_lateral6 512;
BA_ "GenSigStartValue" SG_ 1152 FC_longitudinal6 1024;
BA_ "GenSigStartValue" SG_ 1152 FC_lateral7 512;
BA_ "GenSigStartValue" SG_ 1152 FC_longitudinal7 1024;
BA_ "GenSigStartValue" SG_ 1152 FC_lateral8 512;
BA_ "GenSigStartValue" SG_ 1152 FC_longitudinal8 1024;
BA_ "GenSigStartValue" SG_ 1152 FC_lateral9 512;
BA_ "GenSigStartValue" SG_ 1152 FC_longitudinal9 1024;
BA_ "GenSigStartValue" SG_ 1152 FC_lateral10 512;
BA_ "GenSigStartValue" SG_ 1152 FC_longitudinal10 1024;
BA_ "GenSigStartValue" SG_ 1152 FC_lateral11 512;
BA_ "GenSigStartValue" SG_ 1152 FC_longitudinal11 1024;
BA_ "GenSigStartValue" SG_ 1152 FC_lateral12 512;
BA_ "GenSigStartValue" SG_ 1152 FC_longitudinal12 1024;
BA_ "GenSigStartValue" SG_ 1152 FC_lateral13 512;
BA_ "GenSigStartValue" SG_ 1152 FC_longitudinal13 1024;
BA_ "GenSigStartValue" SG_ 1152 FC_lateral14 512;
BA_ "GenSigStartValue" SG_ 1152 FC_longitudinal14 1024;
BA_ "GenSigStartValue" SG_ 1152 FC_lateral15 512;
BA_ "GenSigStartValue" SG_ 1152 FC_longitudinal15 1024;
BA_ "GenSigStartValue" SG_ 1152 FC_lateral16 512;
BA_ "GenSigStartValue" SG_ 1152 FC_longitudinal16 1024;
BA_ "GenSigStartValue" SG_ 1152 FC_lateral17 512;
BA_ "GenSigStartValue" SG_ 1152 FC_longitudinal17 1024;
BA_ "GenSigStartValue" SG_ 1152 FC_lateral18 512;
BA_ "GenSigStartValue" SG_ 1152 FC_longitudinal18 1024;
BA_ "GenSigStartValue" SG_ 1152 FC_lateral19 512;
BA_ "GenSigStartValue" SG_ 1152 FC_longitudinal19 1024;
BA_ "GenSigStartValue" SG_ 1152 FC_lateral20 512;
BA_ "GenSigStartValue" SG_ 1152 FC_longitudinal20 1024;
BA_ "GenSigStartValue" SG_ 1152 FC_lateral21 512;
BA_ "GenSigStartValue" SG_ 1152 FC_longitudinal21 1024;
BA_ "GenSigStartValue" SG_ 1153 FC_lateral22 512;
BA_ "GenSigStartValue" SG_ 1153 FC_longitudinal22 1024;
BA_ "GenSigStartValue" SG_ 1153 FC_lateral23 512;
BA_ "GenSigStartValue" SG_ 1153 FC_longitudinal23 1024;
BA_ "GenSigStartValue" SG_ 1153 FC_lateral24 512;
BA_ "GenSigStartValue" SG_ 1153 FC_longitudinal24 1024;
BA_ "GenSigStartValue" SG_ 1153 FC_lateral25 512;
BA_ "GenSigStartValue" SG_ 1153 FC_longitudinal25 1024;
BA_ "GenSigStartValue" SG_ 1153 FC_lateral26 512;
BA_ "GenSigStartValue" SG_ 1153 FC_longitudinal26 1024;
BA_ "GenSigStartValue" SG_ 1153 FC_lateral27 512;
BA_ "GenSigStartValue" SG_ 1153 FC_longitudinal27 1024;
BA_ "GenSigStartValue" SG_ 1153 FC_lateral28 512;
BA_ "GenSigStartValue" SG_ 1153 FC_longitudinal28 1024;
BA_ "GenSigStartValue" SG_ 1153 FC_lateral29 512;
BA_ "GenSigStartValue" SG_ 1153 FC_longitudinal29 1024;
BA_ "GenSigStartValue" SG_ 1153 FC_lateral30 512;
BA_ "GenSigStartValue" SG_ 1153 FC_longitudinal30 1024;
BA_ "GenSigStartValue" SG_ 1153 FC_lateral31 512;
BA_ "GenSigStartValue" SG_ 1153 FC_longitudinal31 1024;
BA_ "GenSigStartValue" SG_ 1153 FC_lateral32 512;
BA_ "GenSigStartValue" SG_ 1153 FC_longitudinal32 1024;
BA_ "GenSigStartValue" SG_ 1153 FC_lateral33 512;
BA_ "GenSigStartValue" SG_ 1153 FC_longitudinal33 1024;
BA_ "GenSigStartValue" SG_ 1153 FC_lateral34 512;
BA_ "GenSigStartValue" SG_ 1153 FC_longitudinal34 1024;
BA_ "GenSigStartValue" SG_ 1153 FC_lateral35 512;
BA_ "GenSigStartValue" SG_ 1153 FC_longitudinal35 1024;
BA_ "GenSigStartValue" SG_ 1153 FC_lateral36 512;
BA_ "GenSigStartValue" SG_ 1153 FC_longitudinal36 1024;
BA_ "GenSigStartValue" SG_ 1153 FC_lateral37 512;
BA_ "GenSigStartValue" SG_ 1153 FC_longitudinal37 1024;
BA_ "GenSigStartValue" SG_ 1153 FC_lateral38 512;
BA_ "GenSigStartValue" SG_ 1153 FC_longitudinal38 1024;
BA_ "GenSigStartValue" SG_ 1153 FC_lateral39 512;
BA_ "GenSigStartValue" SG_ 1153 FC_longitudinal39 1024;
BA_ "GenSigStartValue" SG_ 1153 FC_lateral40 512;
BA_ "GenSigStartValue" SG_ 1153 FC_longitudinal40 1024;
BA_ "GenSigStartValue" SG_ 1153 FC_lateral41 512;
BA_ "GenSigStartValue" SG_ 1153 FC_longitudinal41 1024;
BA_ "GenSigStartValue" SG_ 1153 FC_lateral42 512;
BA_ "GenSigStartValue" SG_ 1153 FC_longitudinal42 1024;
BA_ "GenSigStartValue" SG_ 1154 FC_lateral43 512;
BA_ "GenSigStartValue" SG_ 1154 FC_longitudinal43 1024;
BA_ "GenSigStartValue" SG_ 1154 FC_lateral44 512;
BA_ "GenSigStartValue" SG_ 1154 FC_longitudinal44 1024;
BA_ "GenSigStartValue" SG_ 1154 FC_lateral45 512;
BA_ "GenSigStartValue" SG_ 1154 FC_longitudinal45 1024;
BA_ "GenSigStartValue" SG_ 1154 FC_lateral46 512;
BA_ "GenSigStartValue" SG_ 1154 FC_longitudinal46 1024;
BA_ "GenSigStartValue" SG_ 1154 FC_lateral47 512;
BA_ "GenSigStartValue" SG_ 1154 FC_longitudinal47 1024;
BA_ "GenSigStartValue" SG_ 1154 FC_lateral48 512;
BA_ "GenSigStartValue" SG_ 1154 FC_longitudinal48 1024;
BA_ "GenSigStartValue" SG_ 1154 FC_lateral49 512;
BA_ "GenSigStartValue" SG_ 1154 FC_longitudinal49 1024;
BA_ "GenSigStartValue" SG_ 1154 FC_lateral50 512;
BA_ "GenSigStartValue" SG_ 1154 FC_longitudinal50 1024;
BA_ "GenSigStartValue" SG_ 1154 FC_lateral51 512;
BA_ "GenSigStartValue" SG_ 1154 FC_longitudinal51 1024;
BA_ "GenSigStartValue" SG_ 1154 FC_lateral52 512;
BA_ "GenSigStartValue" SG_ 1154 FC_longitudinal52 1024;
BA_ "GenSigStartValue" SG_ 1154 FC_lateral53 512;
BA_ "GenSigStartValue" SG_ 1154 FC_longitudinal53 1024;
BA_ "GenSigStartValue" SG_ 1154 FC_lateral54 512;
BA_ "GenSigStartValue" SG_ 1154 FC_longitudinal54 1024;
BA_ "GenSigStartValue" SG_ 1154 FC_lateral55 512;
BA_ "GenSigStartValue" SG_ 1154 FC_longitudinal55 1024;
BA_ "GenSigStartValue" SG_ 1154 FC_lateral56 512;
BA_ "GenSigStartValue" SG_ 1154 FC_longitudinal56 1024;
BA_ "GenSigStartValue" SG_ 1154 FC_lateral57 512;
BA_ "GenSigStartValue" SG_ 1154 FC_longitudinal57 1024;
BA_ "GenSigStartValue" SG_ 1154 FC_lateral58 512;
BA_ "GenSigStartValue" SG_ 1154 FC_longitudinal58 1024;
BA_ "GenSigStartValue" SG_ 1154 FC_lateral59 512;
BA_ "GenSigStartValue" SG_ 1154 FC_longitudinal59 1024;
BA_ "GenSigStartValue" SG_ 1154 FC_lateral60 512;
BA_ "GenSigStartValue" SG_ 1154 FC_longitudinal60 1024;
BA_ "GenSigStartValue" SG_ 1154 FC_lateral61 512;
BA_ "GenSigStartValue" SG_ 1154 FC_longitudinal61 1024;
BA_ "GenSigStartValue" SG_ 1154 FC_lateral62 512;
BA_ "GenSigStartValue" SG_ 1154 FC_longitudinal62 1024;
BA_ "GenSigStartValue" SG_ 1154 FC_lateral63 512;
BA_ "GenSigStartValue" SG_ 1154 FC_longitudinal63 1024;
BA_ "GenSigStartValue" SG_ 1154 FC_lateral64 512;
BA_ "GenSigStartValue" SG_ 1154 FC_longitudinal64 1024;
BA_ "GenSigStartValue" SG_ 1104 FC_Obj1_Dx 4000;
BA_ "GenSigStartValue" SG_ 1104 FC_Obj1_Dy 4000;
BA_ "GenSigStartValue" SG_ 1104 FC_Obj1_RelVx 2048;
BA_ "GenSigStartValue" SG_ 1104 FC_Obj1_RelVy 1000;
BA_ "GenSigStartValue" SG_ 1104 FC_Obj1_RelAx 499;
BA_ "GenSigStartValue" SG_ 1104 FC_Obj1_RelAy 499;
BA_ "GenSigStartValue" SG_ 1104 FC_Obj1_HeadingAngle 32768;
BA_ "GenSigStartValue" SG_ 1104 FC_Obj1_WorldinfoYaw 32768;
BA_ "GenSigStartValue" SG_ 1104 FC_Obj1_AbsVx 2048;
BA_ "GenSigStartValue" SG_ 1104 FC_Obj1_AbsVy 1000;
BA_ "GenSigStartValue" SG_ 1104 FC_Obj1_CornerPoint_x 4000;
BA_ "GenSigStartValue" SG_ 1104 FC_Obj1_CornerPoint_y 4000;
BA_ "GenSigStartValue" SG_ 1104 FC_Obj1_CutInLane 4096;
BA_ "GenSigStartValue" SG_ 1104 FC_Obj1_DistInLane 1000;
BA_ "GenSigStartValue" SG_ 1105 FC_Obj2_Dx 4000;
BA_ "GenSigStartValue" SG_ 1105 FC_Obj2_Dy 4000;
BA_ "GenSigStartValue" SG_ 1105 FC_Obj2_RelVx 2048;
BA_ "GenSigStartValue" SG_ 1105 FC_Obj2_RelVy 1000;
BA_ "GenSigStartValue" SG_ 1105 FC_Obj2_RelAx 499;
BA_ "GenSigStartValue" SG_ 1105 FC_Obj2_RelAy 499;
BA_ "GenSigStartValue" SG_ 1105 FC_Obj2_HeadingAngle 32768;
BA_ "GenSigStartValue" SG_ 1105 FC_Obj2_WorldinfoYaw 32768;
BA_ "GenSigStartValue" SG_ 1105 FC_Obj2_AbsVx 2048;
BA_ "GenSigStartValue" SG_ 1105 FC_Obj2_AbsVy 1000;
BA_ "GenSigStartValue" SG_ 1105 FC_Obj2_CornerPoint_x 4000;
BA_ "GenSigStartValue" SG_ 1105 FC_Obj2_CornerPoint_y 4000;
BA_ "GenSigStartValue" SG_ 1105 FC_Obj2_CutInLane 4096;
BA_ "GenSigStartValue" SG_ 1105 FC_Obj2_DistInLane 1000;
BA_ "GenSigStartValue" SG_ 1106 FC_Obj3_Dx 4000;
BA_ "GenSigStartValue" SG_ 1106 FC_Obj3_Dy 4000;
BA_ "GenSigStartValue" SG_ 1106 FC_Obj3_RelVx 2048;
BA_ "GenSigStartValue" SG_ 1106 FC_Obj3_RelVy 1000;
BA_ "GenSigStartValue" SG_ 1106 FC_Obj3_RelAx 499;
BA_ "GenSigStartValue" SG_ 1106 FC_Obj3_RelAy 499;
BA_ "GenSigStartValue" SG_ 1106 FC_Obj3_HeadingAngle 32768;
BA_ "GenSigStartValue" SG_ 1106 FC_Obj3_WorldinfoYaw 32768;
BA_ "GenSigStartValue" SG_ 1106 FC_Obj3_AbsVx 2048;
BA_ "GenSigStartValue" SG_ 1106 FC_Obj3_AbsVy 1000;
BA_ "GenSigStartValue" SG_ 1106 FC_Obj3_CornerPoint_x 4000;
BA_ "GenSigStartValue" SG_ 1106 FC_Obj3_CornerPoint_y 4000;
BA_ "GenSigStartValue" SG_ 1106 FC_Obj3_CutInLane 4096;
BA_ "GenSigStartValue" SG_ 1106 FC_Obj3_DistInLane 1000;
BA_ "GenSigStartValue" SG_ 1107 FC_Obj4_Dx 4000;
BA_ "GenSigStartValue" SG_ 1107 FC_Obj4_Dy 4000;
BA_ "GenSigStartValue" SG_ 1107 FC_Obj4_RelVx 2048;
BA_ "GenSigStartValue" SG_ 1107 FC_Obj4_RelVy 1000;
BA_ "GenSigStartValue" SG_ 1107 FC_Obj4_RelAx 499;
BA_ "GenSigStartValue" SG_ 1107 FC_Obj4_RelAy 499;
BA_ "GenSigStartValue" SG_ 1107 FC_Obj4_HeadingAngle 32768;
BA_ "GenSigStartValue" SG_ 1107 FC_Obj4_WorldinfoYaw 32768;
BA_ "GenSigStartValue" SG_ 1107 FC_Obj4_AbsVx 2048;
BA_ "GenSigStartValue" SG_ 1107 FC_Obj4_AbsVy 1000;
BA_ "GenSigStartValue" SG_ 1107 FC_Obj4_CornerPoint_x 4000;
BA_ "GenSigStartValue" SG_ 1107 FC_Obj4_CornerPoint_y 4000;
BA_ "GenSigStartValue" SG_ 1107 FC_Obj4_CutInLane 4096;
BA_ "GenSigStartValue" SG_ 1107 FC_Obj4_DistInLane 1000;
BA_ "GenSigStartValue" SG_ 1108 FC_Obj5_Dx 4000;
BA_ "GenSigStartValue" SG_ 1108 FC_Obj5_Dy 4000;
BA_ "GenSigStartValue" SG_ 1108 FC_Obj5_RelVx 2048;
BA_ "GenSigStartValue" SG_ 1108 FC_Obj5_RelVy 1000;
BA_ "GenSigStartValue" SG_ 1108 FC_Obj5_RelAx 499;
BA_ "GenSigStartValue" SG_ 1108 FC_Obj5_RelAy 499;
BA_ "GenSigStartValue" SG_ 1108 FC_Obj5_HeadingAngle 32768;
BA_ "GenSigStartValue" SG_ 1108 FC_Obj5_WorldinfoYaw 32768;
BA_ "GenSigStartValue" SG_ 1108 FC_Obj5_AbsVx 2048;
BA_ "GenSigStartValue" SG_ 1108 FC_Obj5_AbsVy 1000;
BA_ "GenSigStartValue" SG_ 1108 FC_Obj5_CornerPoint_x 4000;
BA_ "GenSigStartValue" SG_ 1108 FC_Obj5_CornerPoint_y 4000;
BA_ "GenSigStartValue" SG_ 1108 FC_Obj5_CutInLane 4096;
BA_ "GenSigStartValue" SG_ 1108 FC_Obj5_DistInLane 1000;
BA_ "GenSigStartValue" SG_ 1109 FC_Obj6_Dx 4000;
BA_ "GenSigStartValue" SG_ 1109 FC_Obj6_Dy 4000;
BA_ "GenSigStartValue" SG_ 1109 FC_Obj6_RelVx 2048;
BA_ "GenSigStartValue" SG_ 1109 FC_Obj6_RelVy 1000;
BA_ "GenSigStartValue" SG_ 1109 FC_Obj6_RelAx 499;
BA_ "GenSigStartValue" SG_ 1109 FC_Obj6_RelAy 499;
BA_ "GenSigStartValue" SG_ 1109 FC_Obj6_HeadingAngle 32768;
BA_ "GenSigStartValue" SG_ 1109 FC_Obj6_WorldinfoYaw 32768;
BA_ "GenSigStartValue" SG_ 1109 FC_Obj6_AbsVx 2048;
BA_ "GenSigStartValue" SG_ 1109 FC_Obj6_AbsVy 1000;
BA_ "GenSigStartValue" SG_ 1109 FC_Obj6_CornerPoint_x 4000;
BA_ "GenSigStartValue" SG_ 1109 FC_Obj6_CornerPoint_y 4000;
BA_ "GenSigStartValue" SG_ 1109 FC_Obj6_CutInLane 4096;
BA_ "GenSigStartValue" SG_ 1109 FC_Obj6_DistInLane 1000;
BA_ "GenSigStartValue" SG_ 1110 FC_Obj7_Dx 4000;
BA_ "GenSigStartValue" SG_ 1110 FC_Obj7_Dy 4000;
BA_ "GenSigStartValue" SG_ 1110 FC_Obj7_RelVx 2048;
BA_ "GenSigStartValue" SG_ 1110 FC_Obj7_RelVy 1000;
BA_ "GenSigStartValue" SG_ 1110 FC_Obj7_RelAx 499;
BA_ "GenSigStartValue" SG_ 1110 FC_Obj7_RelAy 499;
BA_ "GenSigStartValue" SG_ 1110 FC_Obj7_HeadingAngle 32768;
BA_ "GenSigStartValue" SG_ 1110 FC_Obj7_WorldinfoYaw 32768;
BA_ "GenSigStartValue" SG_ 1110 FC_Obj7_AbsVx 2048;
BA_ "GenSigStartValue" SG_ 1110 FC_Obj7_AbsVy 1000;
BA_ "GenSigStartValue" SG_ 1110 FC_Obj7_CornerPoint_x 4000;
BA_ "GenSigStartValue" SG_ 1110 FC_Obj7_CornerPoint_y 4000;
BA_ "GenSigStartValue" SG_ 1110 FC_Obj7_CutInLane 4096;
BA_ "GenSigStartValue" SG_ 1110 FC_Obj7_DistInLane 1000;
BA_ "GenSigStartValue" SG_ 1111 FC_Obj8_Dx 4000;
BA_ "GenSigStartValue" SG_ 1111 FC_Obj8_Dy 4000;
BA_ "GenSigStartValue" SG_ 1111 FC_Obj8_RelVx 2048;
BA_ "GenSigStartValue" SG_ 1111 FC_Obj8_RelVy 1000;
BA_ "GenSigStartValue" SG_ 1111 FC_Obj8_RelAx 499;
BA_ "GenSigStartValue" SG_ 1111 FC_Obj8_RelAy 499;
BA_ "GenSigStartValue" SG_ 1111 FC_Obj8_HeadingAngle 32768;
BA_ "GenSigStartValue" SG_ 1111 FC_Obj8_WorldinfoYaw 32768;
BA_ "GenSigStartValue" SG_ 1111 FC_Obj8_AbsVx 2048;
BA_ "GenSigStartValue" SG_ 1111 FC_Obj8_AbsVy 1000;
BA_ "GenSigStartValue" SG_ 1111 FC_Obj8_CornerPoint_x 4000;
BA_ "GenSigStartValue" SG_ 1111 FC_Obj8_CornerPoint_y 4000;
BA_ "GenSigStartValue" SG_ 1111 FC_Obj8_CutInLane 4096;
BA_ "GenSigStartValue" SG_ 1111 FC_Obj8_DistInLane 1000;
BA_ "GenSigStartValue" SG_ 1112 FC_Obj9_Dx 4000;
BA_ "GenSigStartValue" SG_ 1112 FC_Obj9_Dy 4000;
BA_ "GenSigStartValue" SG_ 1112 FC_Obj9_RelVx 2048;
BA_ "GenSigStartValue" SG_ 1112 FC_Obj9_RelVy 1000;
BA_ "GenSigStartValue" SG_ 1112 FC_Obj9_RelAx 499;
BA_ "GenSigStartValue" SG_ 1112 FC_Obj9_RelAy 499;
BA_ "GenSigStartValue" SG_ 1112 FC_Obj9_HeadingAngle 32768;
BA_ "GenSigStartValue" SG_ 1112 FC_Obj9_WorldinfoYaw 32768;
BA_ "GenSigStartValue" SG_ 1112 FC_Obj9_AbsVx 2048;
BA_ "GenSigStartValue" SG_ 1112 FC_Obj9_AbsVy 1000;
BA_ "GenSigStartValue" SG_ 1112 FC_Obj9_CornerPoint_x 4000;
BA_ "GenSigStartValue" SG_ 1112 FC_Obj9_CornerPoint_y 4000;
BA_ "GenSigStartValue" SG_ 1112 FC_Obj9_CutInLane 4096;
BA_ "GenSigStartValue" SG_ 1112 FC_Obj9_DistInLane 1000;
BA_ "GenSigStartValue" SG_ 1113 FC_Obj10_Dx 4000;
BA_ "GenSigStartValue" SG_ 1113 FC_Obj10_Dy 4000;
BA_ "GenSigStartValue" SG_ 1113 FC_Obj10_RelVx 2048;
BA_ "GenSigStartValue" SG_ 1113 FC_Obj10_RelVy 1000;
BA_ "GenSigStartValue" SG_ 1113 FC_Obj10_RelAx 499;
BA_ "GenSigStartValue" SG_ 1113 FC_Obj10_RelAy 499;
BA_ "GenSigStartValue" SG_ 1113 FC_Obj10_HeadingAngle 32768;
BA_ "GenSigStartValue" SG_ 1113 FC_Obj10_WorldinfoYaw 32768;
BA_ "GenSigStartValue" SG_ 1113 FC_Obj10_AbsVx 2048;
BA_ "GenSigStartValue" SG_ 1113 FC_Obj10_AbsVy 1000;
BA_ "GenSigStartValue" SG_ 1113 FC_Obj10_CornerPoint_x 4000;
BA_ "GenSigStartValue" SG_ 1113 FC_Obj10_CornerPoint_y 4000;
BA_ "GenSigStartValue" SG_ 1113 FC_Obj10_CutInLane 4096;
BA_ "GenSigStartValue" SG_ 1113 FC_Obj10_DistInLane 1000;
BA_ "GenSigStartValue" SG_ 1114 FC_Obj11_Dx 4000;
BA_ "GenSigStartValue" SG_ 1114 FC_Obj11_Dy 4000;
BA_ "GenSigStartValue" SG_ 1114 FC_Obj11_RelVx 2048;
BA_ "GenSigStartValue" SG_ 1114 FC_Obj11_RelVy 1000;
BA_ "GenSigStartValue" SG_ 1114 FC_Obj11_RelAx 499;
BA_ "GenSigStartValue" SG_ 1114 FC_Obj11_RelAy 499;
BA_ "GenSigStartValue" SG_ 1114 FC_Obj11_HeadingAngle 32768;
BA_ "GenSigStartValue" SG_ 1114 FC_Obj11_WorldinfoYaw 32768;
BA_ "GenSigStartValue" SG_ 1114 FC_Obj11_AbsVx 2048;
BA_ "GenSigStartValue" SG_ 1114 FC_Obj11_AbsVy 1000;
BA_ "GenSigStartValue" SG_ 1114 FC_Obj11_CornerPoint_x 4000;
BA_ "GenSigStartValue" SG_ 1114 FC_Obj11_CornerPoint_y 4000;
BA_ "GenSigStartValue" SG_ 1114 FC_Obj11_CutInLane 4096;
BA_ "GenSigStartValue" SG_ 1114 FC_Obj11_DistInLane 1000;
BA_ "GenSigStartValue" SG_ 1115 FC_Obj12_Dx 4000;
BA_ "GenSigStartValue" SG_ 1115 FC_Obj12_Dy 4000;
BA_ "GenSigStartValue" SG_ 1115 FC_Obj12_RelVx 2048;
BA_ "GenSigStartValue" SG_ 1115 FC_Obj12_RelVy 1000;
BA_ "GenSigStartValue" SG_ 1115 FC_Obj12_RelAx 499;
BA_ "GenSigStartValue" SG_ 1115 FC_Obj12_RelAy 499;
BA_ "GenSigStartValue" SG_ 1115 FC_Obj12_HeadingAngle 32768;
BA_ "GenSigStartValue" SG_ 1115 FC_Obj12_WorldinfoYaw 32768;
BA_ "GenSigStartValue" SG_ 1115 FC_Obj12_AbsVx 2048;
BA_ "GenSigStartValue" SG_ 1115 FC_Obj12_AbsVy 1000;
BA_ "GenSigStartValue" SG_ 1115 FC_Obj12_CornerPoint_x 4000;
BA_ "GenSigStartValue" SG_ 1115 FC_Obj12_CornerPoint_y 4000;
BA_ "GenSigStartValue" SG_ 1115 FC_Obj12_CutInLane 4096;
BA_ "GenSigStartValue" SG_ 1115 FC_Obj12_DistInLane 1000;
BA_ "GenSigStartValue" SG_ 1116 FC_Obj13_Dx 4000;
BA_ "GenSigStartValue" SG_ 1116 FC_Obj13_Dy 4000;
BA_ "GenSigStartValue" SG_ 1116 FC_Obj13_RelVx 2048;
BA_ "GenSigStartValue" SG_ 1116 FC_Obj13_RelVy 1000;
BA_ "GenSigStartValue" SG_ 1116 FC_Obj13_RelAx 499;
BA_ "GenSigStartValue" SG_ 1116 FC_Obj13_RelAy 499;
BA_ "GenSigStartValue" SG_ 1116 FC_Obj13_HeadingAngle 32768;
BA_ "GenSigStartValue" SG_ 1116 FC_Obj13_WorldinfoYaw 32768;
BA_ "GenSigStartValue" SG_ 1116 FC_Obj13_AbsVx 2048;
BA_ "GenSigStartValue" SG_ 1116 FC_Obj13_AbsVy 1000;
BA_ "GenSigStartValue" SG_ 1116 FC_Obj13_CornerPoint_x 4000;
BA_ "GenSigStartValue" SG_ 1116 FC_Obj13_CornerPoint_y 4000;
BA_ "GenSigStartValue" SG_ 1116 FC_Obj13_CutInLane 4096;
BA_ "GenSigStartValue" SG_ 1116 FC_Obj13_DistInLane 1000;
BA_ "GenSigStartValue" SG_ 1117 FC_Obj14_Dx 4000;
BA_ "GenSigStartValue" SG_ 1117 FC_Obj14_Dy 4000;
BA_ "GenSigStartValue" SG_ 1117 FC_Obj14_RelVx 2048;
BA_ "GenSigStartValue" SG_ 1117 FC_Obj14_RelVy 1000;
BA_ "GenSigStartValue" SG_ 1117 FC_Obj14_RelAx 499;
BA_ "GenSigStartValue" SG_ 1117 FC_Obj14_RelAy 499;
BA_ "GenSigStartValue" SG_ 1117 FC_Obj14_HeadingAngle 32768;
BA_ "GenSigStartValue" SG_ 1117 FC_Obj14_WorldinfoYaw 32768;
BA_ "GenSigStartValue" SG_ 1117 FC_Obj14_AbsVx 2048;
BA_ "GenSigStartValue" SG_ 1117 FC_Obj14_AbsVy 1000;
BA_ "GenSigStartValue" SG_ 1117 FC_Obj14_CornerPoint_x 4000;
BA_ "GenSigStartValue" SG_ 1117 FC_Obj14_CornerPoint_y 4000;
BA_ "GenSigStartValue" SG_ 1117 FC_Obj14_CutInLane 4096;
BA_ "GenSigStartValue" SG_ 1117 FC_Obj14_DistInLane 1000;
BA_ "GenSigStartValue" SG_ 1118 FC_Obj15_Dx 4000;
BA_ "GenSigStartValue" SG_ 1118 FC_Obj15_Dy 4000;
BA_ "GenSigStartValue" SG_ 1118 FC_Obj15_RelVx 2048;
BA_ "GenSigStartValue" SG_ 1118 FC_Obj15_RelVy 1000;
BA_ "GenSigStartValue" SG_ 1118 FC_Obj15_RelAx 499;
BA_ "GenSigStartValue" SG_ 1118 FC_Obj15_RelAy 499;
BA_ "GenSigStartValue" SG_ 1118 FC_Obj15_HeadingAngle 32768;
BA_ "GenSigStartValue" SG_ 1118 FC_Obj15_WorldinfoYaw 32768;
BA_ "GenSigStartValue" SG_ 1118 FC_Obj15_AbsVx 2048;
BA_ "GenSigStartValue" SG_ 1118 FC_Obj15_AbsVy 1000;
BA_ "GenSigStartValue" SG_ 1118 FC_Obj15_CornerPoint_x 4000;
BA_ "GenSigStartValue" SG_ 1118 FC_Obj15_CornerPoint_y 4000;
BA_ "GenSigStartValue" SG_ 1118 FC_Obj15_CutInLane 4096;
BA_ "GenSigStartValue" SG_ 1118 FC_Obj15_DistInLane 1000;
BA_ "GenSigStartValue" SG_ 1119 FC_Obj16_Dx 4000;
BA_ "GenSigStartValue" SG_ 1119 FC_Obj16_Dy 4000;
BA_ "GenSigStartValue" SG_ 1119 FC_Obj16_RelVx 2048;
BA_ "GenSigStartValue" SG_ 1119 FC_Obj16_RelVy 1000;
BA_ "GenSigStartValue" SG_ 1119 FC_Obj16_RelAx 499;
BA_ "GenSigStartValue" SG_ 1119 FC_Obj16_RelAy 499;
BA_ "GenSigStartValue" SG_ 1119 FC_Obj16_HeadingAngle 32768;
BA_ "GenSigStartValue" SG_ 1119 FC_Obj16_WorldinfoYaw 32768;
BA_ "GenSigStartValue" SG_ 1119 FC_Obj16_AbsVx 2048;
BA_ "GenSigStartValue" SG_ 1119 FC_Obj16_AbsVy 1000;
BA_ "GenSigStartValue" SG_ 1119 FC_Obj16_CornerPoint_x 4000;
BA_ "GenSigStartValue" SG_ 1119 FC_Obj16_CornerPoint_y 4000;
BA_ "GenSigStartValue" SG_ 1119 FC_Obj16_CutInLane 4096;
BA_ "GenSigStartValue" SG_ 1119 FC_Obj16_DistInLane 1000;
BA_ "GenSigStartValue" SG_ 1120 FC_Obj17_Dx 4000;
BA_ "GenSigStartValue" SG_ 1120 FC_Obj17_Dy 4000;
BA_ "GenSigStartValue" SG_ 1120 FC_Obj17_RelVx 2048;
BA_ "GenSigStartValue" SG_ 1120 FC_Obj17_RelVy 1000;
BA_ "GenSigStartValue" SG_ 1120 FC_Obj17_RelAx 499;
BA_ "GenSigStartValue" SG_ 1120 FC_Obj17_RelAy 499;
BA_ "GenSigStartValue" SG_ 1120 FC_Obj17_HeadingAngle 32768;
BA_ "GenSigStartValue" SG_ 1120 FC_Obj17_WorldinfoYaw 32768;
BA_ "GenSigStartValue" SG_ 1120 FC_Obj17_AbsVx 2048;
BA_ "GenSigStartValue" SG_ 1120 FC_Obj17_AbsVy 1000;
BA_ "GenSigStartValue" SG_ 1120 FC_Obj17_CornerPoint_x 4000;
BA_ "GenSigStartValue" SG_ 1120 FC_Obj17_CornerPoint_y 4000;
BA_ "GenSigStartValue" SG_ 1120 FC_Obj17_CutInLane 4096;
BA_ "GenSigStartValue" SG_ 1120 FC_Obj17_DistInLane 1000;
BA_ "GenSigStartValue" SG_ 1121 FC_Obj18_Dx 4000;
BA_ "GenSigStartValue" SG_ 1121 FC_Obj18_Dy 4000;
BA_ "GenSigStartValue" SG_ 1121 FC_Obj18_RelVx 2048;
BA_ "GenSigStartValue" SG_ 1121 FC_Obj18_RelVy 1000;
BA_ "GenSigStartValue" SG_ 1121 FC_Obj18_RelAx 499;
BA_ "GenSigStartValue" SG_ 1121 FC_Obj18_RelAy 499;
BA_ "GenSigStartValue" SG_ 1121 FC_Obj18_HeadingAngle 32768;
BA_ "GenSigStartValue" SG_ 1121 FC_Obj18_WorldinfoYaw 32768;
BA_ "GenSigStartValue" SG_ 1121 FC_Obj18_AbsVx 2048;
BA_ "GenSigStartValue" SG_ 1121 FC_Obj18_AbsVy 1000;
BA_ "GenSigStartValue" SG_ 1121 FC_Obj18_CornerPoint_x 4000;
BA_ "GenSigStartValue" SG_ 1121 FC_Obj18_CornerPoint_y 4000;
BA_ "GenSigStartValue" SG_ 1121 FC_Obj18_CutInLane 4096;
BA_ "GenSigStartValue" SG_ 1121 FC_Obj18_DistInLane 1000;
BA_ "GenSigStartValue" SG_ 1122 FC_Obj19_Dx 4000;
BA_ "GenSigStartValue" SG_ 1122 FC_Obj19_Dy 4000;
BA_ "GenSigStartValue" SG_ 1122 FC_Obj19_RelVx 2048;
BA_ "GenSigStartValue" SG_ 1122 FC_Obj19_RelVy 1000;
BA_ "GenSigStartValue" SG_ 1122 FC_Obj19_RelAx 499;
BA_ "GenSigStartValue" SG_ 1122 FC_Obj19_RelAy 499;
BA_ "GenSigStartValue" SG_ 1122 FC_Obj19_HeadingAngle 32768;
BA_ "GenSigStartValue" SG_ 1122 FC_Obj19_WorldinfoYaw 32768;
BA_ "GenSigStartValue" SG_ 1122 FC_Obj19_AbsVx 2048;
BA_ "GenSigStartValue" SG_ 1122 FC_Obj19_AbsVy 1000;
BA_ "GenSigStartValue" SG_ 1122 FC_Obj19_CornerPoint_x 4000;
BA_ "GenSigStartValue" SG_ 1122 FC_Obj19_CornerPoint_y 4000;
BA_ "GenSigStartValue" SG_ 1122 FC_Obj19_CutInLane 4096;
BA_ "GenSigStartValue" SG_ 1122 FC_Obj19_DistInLane 1000;
BA_ "GenSigStartValue" SG_ 1123 FC_Obj20_Dx 4000;
BA_ "GenSigStartValue" SG_ 1123 FC_Obj20_Dy 4000;
BA_ "GenSigStartValue" SG_ 1123 FC_Obj20_RelVx 2048;
BA_ "GenSigStartValue" SG_ 1123 FC_Obj20_RelVy 1000;
BA_ "GenSigStartValue" SG_ 1123 FC_Obj20_RelAx 499;
BA_ "GenSigStartValue" SG_ 1123 FC_Obj20_RelAy 499;
BA_ "GenSigStartValue" SG_ 1123 FC_Obj20_HeadingAngle 32768;
BA_ "GenSigStartValue" SG_ 1123 FC_Obj20_WorldinfoYaw 32768;
BA_ "GenSigStartValue" SG_ 1123 FC_Obj20_AbsVx 2048;
BA_ "GenSigStartValue" SG_ 1123 FC_Obj20_AbsVy 1000;
BA_ "GenSigStartValue" SG_ 1123 FC_Obj20_CornerPoint_x 4000;
BA_ "GenSigStartValue" SG_ 1123 FC_Obj20_CornerPoint_y 4000;
BA_ "GenSigStartValue" SG_ 1123 FC_Obj20_CutInLane 4096;
BA_ "GenSigStartValue" SG_ 1123 FC_Obj20_DistInLane 1000;
BA_ "GenSigStartValue" SG_ 1139 FC_StaticObj1_Dy 1020;
BA_ "GenSigStartValue" SG_ 1139 FC_StaticObj2_Dy 1020;
BA_ "GenSigStartValue" SG_ 1139 FC_StaticObj3_Dy 1020;
BA_ "GenSigStartValue" SG_ 1139 FC_StaticObj4_Dy 1020;
BA_ "GenSigStartValue" SG_ 1139 FC_StaticObj5_Dy 1020;
BA_ "GenSigStartValue" SG_ 1139 FC_StaticObj6_Dy 1020;
BA_ "GenSigStartValue" SG_ 1139 FC_StaticObj7_Dy 1020;
BA_ "GenSigStartValue" SG_ 1139 FC_StaticObj8_Dy 1020;
BA_ "GenSigStartValue" SG_ 1139 FC_StaticObj9_Dy 1020;
BA_ "GenSigStartValue" SG_ 1139 FC_StaticObj10_Dy 1020;
BA_ "GenSigStartValue" SG_ 1139 FC_StaticObj11_Dy 1020;
BA_ "GenSigStartValue" SG_ 1139 FC_StaticObj12_Dy 1020;
BA_ "GenSigStartValue" SG_ 1139 FC_StaticObj13_Dy 1020;
BA_ "GenSigStartValue" SG_ 1139 FC_StaticObj14_Dy 1020;
BA_ "GenSigStartValue" SG_ 1139 FC_StaticObj15_Dy 1020;
BA_ "GenSigStartValue" SG_ 1139 FC_StaticObj16_Dy 1020;
BA_ "GenSigStartValue" SG_ 1139 FC_StaticObj17_Dy 1020;
BA_ "GenSigStartValue" SG_ 1139 FC_StaticObj18_Dy 1020;
BA_ "GenSigStartValue" SG_ 1139 FC_StaticObj19_Dy 1020;
BA_ "GenSigStartValue" SG_ 1139 FC_StaticObj20_Dy 1020;
